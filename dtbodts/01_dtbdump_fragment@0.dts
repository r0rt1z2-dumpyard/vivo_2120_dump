/dts-v1/;

/ {

	__fixups__ {
		audgpio = "/fragment@26:target:0";
		auxadc = "/fragment@44:target:0", "/fragment@66/__overlay__:io-channels:0", "/fragment@67/__overlay__:io-channels:0", "/fragment@67/__overlay__:io-channels:8", "/fragment@67/__overlay__:io-channels:16";
		battery = "/fragment@67:target:0";
		battery_id = "/fragment@66:target:0";
		board_info = "/fragment@91:target:0";
		boards_version = "/fragment@92:target:0";
		camera_af_hw_node = "/fragment@87:target:0";
		charge = "/fragment@68:target:0";
		chipone_sidefp = "/fragment@40:target:0";
		chosen = "/fragment@0:target:0";
		cms_v2 = "/fragment@70:target:0";
		consys = "/fragment@11:target:0", "/fragment@90:target:0";
		dsi_te = "/fragment@76:target:0";
		flashlights_lm3644 = "/fragment@34:target:0", "/fragment@88:target:0";
		focaltech_fp = "/fragment@39:target:0";
		fp_id = "/fragment@43:target:0";
		fpsensor_fp_eint = "/fragment@75:target:0";
		fuelsummary = "/fragment@72:target:0";
		goodix_fp = "/fragment@74:target:0";
		goodix_sidefp = "/fragment@41:target:0";
		gpio = "/fragment@57:target:0";
		gpio_usage_mapping = "/fragment@56:target:0";
		i2c0 = "/fragment@46:target:0", "/fragment@98:target:0";
		i2c1 = "/fragment@47:target:0";
		i2c2 = "/fragment@48:target:0";
		i2c3 = "/fragment@6:target:0", "/fragment@17:target:0", "/fragment@49:target:0";
		i2c4 = "/fragment@50:target:0";
		i2c5 = "/fragment@51:target:0", "/fragment@73:target:0";
		i2c6 = "/fragment@7:target:0", "/fragment@21:target:0", "/fragment@52:target:0";
		i2c7 = "/fragment@53:target:0";
		i2c8 = "/fragment@54:target:0";
		i2c9 = "/fragment@55:target:0";
		infracfg_ao = "/fragment@35/__overlay__:clocks:0", "/fragment@35/__overlay__:clocks:8", "/fragment@35/__overlay__:clocks:16";
		irq_nfc = "/fragment@62:target:0";
		irtx_pwm = "/fragment@24:target:0";
		kd_camera_hw1 = "/fragment@32:target:0", "/fragment@86:target:0";
		keypad = "/fragment@12:target:0", "/fragment@89:target:0";
		main_pmic = "/fragment@77:target:0", "/fragment@86/__overlay__:pmic:0";
		md1_sim1_hot_plug_eint = "/fragment@78:target:0";
		meter = "/fragment@69:target:0";
		mrdump_ext_rst = "/fragment@60:target:0";
		msdc0 = "/fragment@35:target:0";
		msdc1 = "/fragment@36:target:0";
		msdc1_ins = "/fragment@59:target:0";
		mt6370_chg = "/fragment@30:target:0";
		mt6370_pmu = "/fragment@28:target:0";
		mt6370_typec = "/fragment@29:target:0";
		mt_pmic_vcama_ldo_reg = "/fragment@39/__overlay__:vfp-supply:0", "/fragment@40/__overlay__:vfp-supply:0", "/fragment@41/__overlay__:vfp-supply:0", "/fragment@74/__overlay__:vfp-supply:0", "/fragment@79:target:0";
		mt_pmic_vcamd_ldo_reg = "/fragment@82:target:0", "/fragment@86/__overlay__:cam0_vcamd-supply:0", "/fragment@86/__overlay__:cam1_vcamd-supply:0";
		mt_pmic_vcamio_ldo_reg = "/fragment@83:target:0", "/fragment@86/__overlay__:cam0_vcamio-supply:0", "/fragment@86/__overlay__:cam1_vcamio-supply:0", "/fragment@86/__overlay__:cam2_vcamio-supply:0";
		mt_pmic_vemc_ldo_reg = "/fragment@35/__overlay__:vmmc-supply:0";
		mt_pmic_vibr_ldo_reg = "/fragment@3:target:0";
		mt_pmic_vio28_ldo_reg = "/fragment@85:target:0", "/fragment@87/__overlay__:camaf_m1_pmic-supply:0";
		mt_pmic_vldo28_ldo_reg = "/fragment@2:target:0", "/fragment@84:target:0";
		mt_pmic_vsim1_ldo_reg = "/fragment@80:target:0";
		mt_pmic_vsim2_ldo_reg = "/fragment@81:target:0";
		mtkfb = "/fragment@22:target:0";
		nxp_sn100 = "/fragment@19:target:0";
		odm = "/fragment@1:target:0", "/fragment@97:target:0";
		otg_iddig = "/fragment@64:target:0";
		pio = "/fragment@4:target:0", "/fragment@5/__overlay__:sar-power-rf-detect,gpios:0", "/fragment@6/__overlay__/aw87xxx_pa_58@58:reset-gpio:0", "/fragment@8:target:0", "/fragment@9:target:0", "/fragment@10:target:0", "/fragment@13:target:0", "/fragment@15:target:0", "/fragment@16:target:0", "/fragment@17/__overlay__/nq@28:mediatek,nq-irq:0", "/fragment@17/__overlay__/nq@28:mediatek,nq-ven:0", "/fragment@17/__overlay__/nq@28:mediatek,nq-firm:0", "/fragment@17/__overlay__/nq@28:mediatek,nq-pd2139_bad_ven:0", "/fragment@17/__overlay__/nq@28:interrupt-parent:0", "/fragment@20:target:0", "/fragment@23:target:0", "/fragment@25:target:0", "/fragment@27:target:0", "/fragment@28/__overlay__:mt6370,intr_gpio:0", "/fragment@29/__overlay__:mt6370pd,intr_gpio:0", "/fragment@31:target:0", "/fragment@33:target:0", "/fragment@37:target:0", "/fragment@39/__overlay__:interrupt-parent:0", "/fragment@39/__overlay__:fp,reset_gpio:0", "/fragment@39/__overlay__:fp,irq-gpio:0", "/fragment@40/__overlay__:interrupt-parent:0", "/fragment@40/__overlay__:fpsensor,reset_gpio:0", "/fragment@40/__overlay__:fpsensor,irq-gpio:0", "/fragment@41/__overlay__:interrupt-parent:0", "/fragment@41/__overlay__:goodix,gpio_reset:0", "/fragment@41/__overlay__:goodix,gpio_irq:0", "/fragment@42:target:0", "/fragment@56/__overlay__:GPIO_SIM2_SIO:0", "/fragment@56/__overlay__:GPIO_SIM2_SRST:0", "/fragment@56/__overlay__:GPIO_SIM2_SCLK:0", "/fragment@56/__overlay__:GPIO_SIM1_SCLK:0", "/fragment@56/__overlay__:GPIO_SIM1_SRST:0", "/fragment@56/__overlay__:GPIO_SIM1_SIO:0", "/fragment@56/__overlay__:GPIO_SIM1_HOT_PLUG:0", "/fragment@56/__overlay__:GPIO_FDD_BAND_SUPPORT_DETECT_1ST_PIN:0", "/fragment@56/__overlay__:GPIO_FDD_BAND_SUPPORT_DETECT_2ND_PIN:0", "/fragment@56/__overlay__:GPIO_FDD_BAND_SUPPORT_DETECT_3RD_PIN:0", "/fragment@56/__overlay__:GPIO_FDD_BAND_SUPPORT_DETECT_4TH_PIN:0", "/fragment@58/__overlay__:interrupt-parent:0", "/fragment@59/__overlay__:interrupt-parent:0", "/fragment@60/__overlay__:interrupt-parent:0", "/fragment@60/__overlay__:deb-gpios:0", "/fragment@61/__overlay__:interrupt-parent:0", "/fragment@61/__overlay__:deb-gpios:0", "/fragment@61/__overlay__:deb-rgpios:0", "/fragment@62/__overlay__:interrupt-parent:0", "/fragment@63/__overlay__:interrupt-parent:0", "/fragment@64/__overlay__:interrupt-parent:0", "/fragment@64/__overlay__:usbid-num:0", "/fragment@64/__overlay__:usbid2-num:0", "/fragment@64/__overlay__:platform-id:0", "/fragment@68/__overlay__:vivo,usboe-gpio:0", "/fragment@68/__overlay__:vivo,usbsel-gpio:0", "/fragment@70/__overlay__/single_charger_board:vivo,bat-id-gpio:0", "/fragment@70/__overlay__/single_charger_board:vivo,usb-conn-pro-gpio:0", "/fragment@73/__overlay__/bq25890h@6a:vivo,int-gpio:0", "/fragment@73/__overlay__/bq2560x@6B:interrupt-parent:0", "/fragment@73/__overlay__/bq2560x@6B:vivo,int-gpio:0", "/fragment@73/__overlay__/bq2560x@6B:vivo,enable-gpio:0", "/fragment@73/__overlay__/rt9467@5b:vivo,int-gpio:0", "/fragment@74/__overlay__:interrupt-parent:0", "/fragment@75/__overlay__:int-gpios:0", "/fragment@76/__overlay__:interrupt-parent:0", "/fragment@77/__overlay__:interrupt-parent:0", "/fragment@88/__overlay__:interrupt-parent:0", "/fragment@88/__overlay__:deb-gpios:0", "/fragment@90/__overlay__:compatible-gpios:0", "/fragment@93/__overlay__:card-detect-sim1,gpios:0", "/fragment@93/__overlay__:card-detect-sim2,gpios:0", "/fragment@94:target:0", "/fragment@95:target:0", "/fragment@98/__overlay__/aw87xxx_i2c@58:reset-gpio:0", "/fragment@100:target:0", "/fragment@101/__overlay__/vts_device@0/nt36672:novatek,irq-gpio:0", "/fragment@101/__overlay__/vts_device@0/ili9881h:ilitek,reset-gpio:0", "/fragment@101/__overlay__/vts_device@0/ili9881h:ilitek,irq-gpio:0", "/fragment@101/__overlay__/vts_device@0/ft8756:focaltech,reset-gpio:0", "/fragment@101/__overlay__/vts_device@0/ft8756:focaltech,irq-gpio:0", "/fragment@101/__overlay__/vts_device@0/ft8016:focaltech,reset-gpio:0", "/fragment@101/__overlay__/vts_device@0/ft8016:focaltech,irq-gpio:0", "/fragment@101/__overlay__/vts_device@0/nt36525A:novatek,reset-gpio:0", "/fragment@101/__overlay__/vts_device@0/nt36525A:novatek,irq-gpio:0", "/fragment@101/__overlay__/vts_device@0/chipone:chipone,rst-gpio:0", "/fragment@101/__overlay__/vts_device@0/chipone:chipone,irq-gpio:0";
		pmic_accdet = "/fragment@14:target:0", "/fragment@61:target:0";
		pmic_clock_buffer_ctrl = "/fragment@45:target:0";
		pmic_codec = "/fragment@96:target:0";
		power_supply_lite = "/fragment@71:target:0";
		sar_power = "/fragment@5:target:0";
		spi1 = "/fragment@18:target:0", "/fragment@38:target:0";
		spi3 = "/fragment@101:target:0";
		subpmic_pmu_eint = "/fragment@63:target:0";
		tcard_sim_slot = "/fragment@93:target:0";
		touch = "/fragment@58:target:0";
		touchscreencfg = "/fragment@99:target:0";
		usb3_tune = "/fragment@65:target:0";
	};

	__local_fixups__ {

		fragment@101 {

			__overlay__ {

				vts_device@0 {

					nt36525A {
						pinctrl-0 = <0x0>;
					};

					nt36672 {
						pinctrl-0 = <0x0>;
					};
				};
			};
		};

		fragment@11 {

			__overlay__ {
				pinctrl-0 = <0x0>;
				pinctrl-1 = <0x0>;
				pinctrl-2 = <0x0>;
				pinctrl-3 = <0x0>;
			};
		};

		fragment@12 {

			__overlay__ {
				pinctrl-0 = <0x0>;
			};
		};

		fragment@14 {

			__overlay__ {
				pinctrl-0 = <0x0>;
				pinctrl-1 = <0x0>;
				pinctrl-2 = <0x0>;
			};
		};

		fragment@17 {

			__overlay__ {

				nq@28 {
					pinctrl-0 = <0x0 0x4>;
					pinctrl-1 = <0x0 0x4>;
				};
			};
		};

		fragment@19 {

			__overlay__ {
				pinctrl-0 = <0x0>;
				pinctrl-1 = <0x0>;
				pinctrl-2 = <0x0>;
				pinctrl-3 = <0x0>;
			};
		};

		fragment@22 {

			__overlay__ {
				pinctrl-0 = <0x0>;
				pinctrl-1 = <0x0>;
				pinctrl-10 = <0x0>;
				pinctrl-11 = <0x0>;
				pinctrl-2 = <0x0>;
				pinctrl-3 = <0x0>;
				pinctrl-4 = <0x0>;
				pinctrl-5 = <0x0>;
				pinctrl-6 = <0x0>;
				pinctrl-7 = <0x0>;
				pinctrl-8 = <0x0>;
				pinctrl-9 = <0x0>;
			};
		};

		fragment@24 {

			__overlay__ {
				pinctrl-0 = <0x0>;
				pinctrl-1 = <0x0>;
			};
		};

		fragment@26 {

			__overlay__ {
				pinctrl-0 = <0x0>;
				pinctrl-1 = <0x0>;
				pinctrl-2 = <0x0>;
				pinctrl-3 = <0x0>;
			};
		};

		fragment@32 {

			__overlay__ {
				pinctrl-0 = <0x0>;
				pinctrl-1 = <0x0>;
				pinctrl-10 = <0x0>;
				pinctrl-11 = <0x0>;
				pinctrl-12 = <0x0>;
				pinctrl-13 = <0x0>;
				pinctrl-14 = <0x0>;
				pinctrl-15 = <0x0>;
				pinctrl-16 = <0x0>;
				pinctrl-17 = <0x0>;
				pinctrl-18 = <0x0>;
				pinctrl-19 = <0x0>;
				pinctrl-2 = <0x0>;
				pinctrl-20 = <0x0>;
				pinctrl-21 = <0x0>;
				pinctrl-22 = <0x0>;
				pinctrl-23 = <0x0>;
				pinctrl-24 = <0x0>;
				pinctrl-25 = <0x0>;
				pinctrl-26 = <0x0>;
				pinctrl-3 = <0x0>;
				pinctrl-4 = <0x0>;
				pinctrl-5 = <0x0>;
				pinctrl-6 = <0x0>;
				pinctrl-7 = <0x0>;
				pinctrl-8 = <0x0>;
				pinctrl-9 = <0x0>;
			};
		};

		fragment@34 {

			__overlay__ {
				pinctrl-0 = <0x0>;
				pinctrl-1 = <0x0>;
				pinctrl-2 = <0x0>;
				pinctrl-3 = <0x0>;
			};
		};

		fragment@35 {

			__overlay__ {
				pinctl = <0x0>;
				pinctl_hs200 = <0x0>;
				pinctl_hs400 = <0x0>;
				register_setting = <0x0>;
			};
		};

		fragment@36 {

			__overlay__ {
				pinctl = <0x0>;
				pinctl_ddr50 = <0x0>;
				pinctl_sdr50 = <0x0>;
			};
		};

		fragment@39 {

			__overlay__ {
				pinctrl-0 = <0x0>;
				pinctrl-1 = <0x0>;
				pinctrl-10 = <0x0>;
				pinctrl-11 = <0x0>;
				pinctrl-12 = <0x0>;
				pinctrl-13 = <0x0>;
				pinctrl-14 = <0x0>;
				pinctrl-2 = <0x0>;
				pinctrl-3 = <0x0>;
				pinctrl-4 = <0x0>;
				pinctrl-5 = <0x0>;
				pinctrl-6 = <0x0>;
				pinctrl-7 = <0x0>;
				pinctrl-8 = <0x0>;
				pinctrl-9 = <0x0>;
			};
		};

		fragment@40 {

			__overlay__ {
				pinctrl-0 = <0x0>;
				pinctrl-1 = <0x0>;
				pinctrl-10 = <0x0>;
				pinctrl-11 = <0x0>;
				pinctrl-12 = <0x0>;
				pinctrl-13 = <0x0>;
				pinctrl-14 = <0x0>;
				pinctrl-2 = <0x0>;
				pinctrl-3 = <0x0>;
				pinctrl-4 = <0x0>;
				pinctrl-5 = <0x0>;
				pinctrl-6 = <0x0>;
				pinctrl-7 = <0x0>;
				pinctrl-8 = <0x0>;
				pinctrl-9 = <0x0>;
			};
		};

		fragment@41 {

			__overlay__ {
				pinctrl-0 = <0x0>;
				pinctrl-1 = <0x0>;
				pinctrl-10 = <0x0>;
				pinctrl-11 = <0x0>;
				pinctrl-12 = <0x0>;
				pinctrl-13 = <0x0>;
				pinctrl-14 = <0x0>;
				pinctrl-2 = <0x0>;
				pinctrl-3 = <0x0>;
				pinctrl-4 = <0x0>;
				pinctrl-5 = <0x0>;
				pinctrl-6 = <0x0>;
				pinctrl-7 = <0x0>;
				pinctrl-8 = <0x0>;
				pinctrl-9 = <0x0>;
			};
		};

		fragment@5 {

			__overlay__ {
				pinctrl-0 = <0x0>;
			};
		};

		fragment@64 {

			__overlay__ {
				pinctrl-0 = <0x0>;
				pinctrl-1 = <0x0>;
				pinctrl-10 = <0x0>;
				pinctrl-11 = <0x0>;
				pinctrl-12 = <0x0>;
				pinctrl-2 = <0x0>;
				pinctrl-3 = <0x0>;
				pinctrl-4 = <0x0>;
				pinctrl-5 = <0x0>;
				pinctrl-6 = <0x0>;
				pinctrl-7 = <0x0>;
				pinctrl-8 = <0x0>;
				pinctrl-9 = <0x0>;
			};
		};

		fragment@92 {

			__overlay__ {
				pinctrl-0 = <0x0>;
			};
		};

		fragment@93 {

			__overlay__ {
				pinctrl-0 = <0x0>;
			};
		};
	};

	__symbols__ {
		ACCDET_pins_eint_r_int = "/fragment@15/__overlay__/eint_hphr@0";
		accdet_pins_default = "/fragment@15/__overlay__/accdetdefault";
		accdet_pins_eint_as_int = "/fragment@15/__overlay__/accdeteint@0";
		aud_dat_miso_off = "/fragment@27/__overlay__/aud_dat_miso_off";
		aud_dat_miso_on = "/fragment@27/__overlay__/aud_dat_miso_on";
		aud_dat_mosi_off = "/fragment@27/__overlay__/aud_dat_mosi_off";
		aud_dat_mosi_on = "/fragment@27/__overlay__/aud_dat_mosi_on";
		board_version = "/fragment@94/__overlay__/hardware_board_version";
		camera_main_af_mtk = "/fragment@48/__overlay__/camera_main_af@18";
		camera_main_eeprom_mtk = "/fragment@48/__overlay__/camera_main_eeprom@51";
		camera_main_mtk = "/fragment@48/__overlay__/camera_main@62";
		camera_main_three_eeprom_mtk = "/fragment@50/__overlay__/camera_main_three_eeprom@50";
		camera_main_three_mtk = "/fragment@50/__overlay__/camera_main_three@2d";
		camera_main_two_eeprom_mtk = "/fragment@50/__overlay__/camera_main_two_eeprom@a0";
		camera_main_two_mtk = "/fragment@50/__overlay__/camera_main_two@6e";
		camera_pins_cam0_mclk_off = "/fragment@31/__overlay__/camera_pins_cam0_mclk_off";
		camera_pins_cam0_mclk_on = "/fragment@31/__overlay__/camera_pins_cam0_mclk_on";
		camera_pins_cam0_rst0 = "/fragment@31/__overlay__/cam0@0";
		camera_pins_cam0_rst1 = "/fragment@31/__overlay__/cam0@1";
		camera_pins_cam0_vcama_0 = "/fragment@31/__overlay__/cam0@vcama0";
		camera_pins_cam0_vcama_1 = "/fragment@31/__overlay__/cam0@vcama1";
		camera_pins_cam1_mclk_off = "/fragment@31/__overlay__/camera_pins_cam1_mclk_off";
		camera_pins_cam1_mclk_on = "/fragment@31/__overlay__/camera_pins_cam1_mclk_on";
		camera_pins_cam1_rst0 = "/fragment@31/__overlay__/cam1@0";
		camera_pins_cam1_rst1 = "/fragment@31/__overlay__/cam1@1";
		camera_pins_cam1_vcama_0 = "/fragment@31/__overlay__/cam1@vcama0";
		camera_pins_cam1_vcama_1 = "/fragment@31/__overlay__/cam1@vcama1";
		camera_pins_cam1_vcamd_0 = "/fragment@31/__overlay__/cam1@vcamd0";
		camera_pins_cam1_vcamd_1 = "/fragment@31/__overlay__/cam1@vcamd1";
		camera_pins_cam2_mclk_off = "/fragment@31/__overlay__/camera_pins_cam2_mclk_off";
		camera_pins_cam2_mclk_on = "/fragment@31/__overlay__/camera_pins_cam2_mclk_on";
		camera_pins_cam2_rst0 = "/fragment@31/__overlay__/cam2@0";
		camera_pins_cam2_rst1 = "/fragment@31/__overlay__/cam2@1";
		camera_pins_cam2_vcama_0 = "/fragment@31/__overlay__/cam2@vcama0";
		camera_pins_cam2_vcama_1 = "/fragment@31/__overlay__/cam2@vcama1";
		camera_pins_cam3_mclk_off = "/fragment@31/__overlay__/camera_pins_cam3_mclk_off";
		camera_pins_cam3_mclk_on = "/fragment@31/__overlay__/camera_pins_cam3_mclk_on";
		camera_pins_cam3_rst0 = "/fragment@31/__overlay__/cam3@0";
		camera_pins_cam3_rst1 = "/fragment@31/__overlay__/cam3@1";
		camera_pins_cam3_vcama_0 = "/fragment@31/__overlay__/cam3@vcama0";
		camera_pins_cam3_vcama_1 = "/fragment@31/__overlay__/cam3@vcama1";
		camera_pins_default = "/fragment@31/__overlay__/camdefault";
		camera_sub_eeprom_mtk = "/fragment@50/__overlay__/camera_sub_eeprom@20";
		camera_sub_mtk = "/fragment@50/__overlay__/camera_sub@40";
		camera_sub_two_eeprom_mtk = "/fragment@50/__overlay__/camera_sub_two_eeprom@50";
		camera_sub_two_mtk = "/fragment@50/__overlay__/camera_sub_two@2d";
		cap_touch_mtk = "/fragment@46/__overlay__/cap_touch@5d";
		card_detect = "/fragment@94/__overlay__/card_sim_detect";
		ccu_sensor_i2c_2_hw_mtk = "/fragment@48/__overlay__/ccu_sensor_i2c_2_hw@33";
		ccu_sensor_i2c_4_hw_mtk = "/fragment@50/__overlay__/ccu_sensor_i2c_4_hw@36";
		consys_pins_default = "/fragment@10/__overlay__/consys_default";
		default_board = "/fragment@70/__overlay__/single_charger_board";
		ext_buck_lp4_mtk = "/fragment@49/__overlay__/ext_buck_lp4@57";
		ext_buck_lp4x_mtk = "/fragment@49/__overlay__/ext_buck_lp4x@50";
		ext_buck_vgpu_mtk = "/fragment@52/__overlay__/ext_buck_vgpu@55";
		fingerprint_clk_pullhigh = "/fragment@42/__overlay__/state_clk_pullhigh";
		fingerprint_clk_pulllow = "/fragment@42/__overlay__/state_clk_pulllow";
		fingerprint_clk_spi = "/fragment@42/__overlay__/state_clk_spi";
		fingerprint_cs_pullhigh = "/fragment@42/__overlay__/state_cs_pullhigh";
		fingerprint_cs_pulllow = "/fragment@42/__overlay__/state_cs_pulllow";
		fingerprint_cs_spi = "/fragment@42/__overlay__/state_cs_spi";
		fingerprint_irq = "/fragment@42/__overlay__/state_irq";
		fingerprint_miso_pullhigh = "/fragment@42/__overlay__/state_miso_pullhigh";
		fingerprint_miso_pulllow = "/fragment@42/__overlay__/state_miso_pulllow";
		fingerprint_miso_spi = "/fragment@42/__overlay__/state_miso_spi";
		fingerprint_mosi_pullhigh = "/fragment@42/__overlay__/state_mosi_pullhigh";
		fingerprint_mosi_pulllow = "/fragment@42/__overlay__/state_mosi_pulllow";
		fingerprint_mosi_spi = "/fragment@42/__overlay__/state_mosi_spi";
		fingerprint_reset_high = "/fragment@42/__overlay__/state_reset_high";
		fingerprint_reset_low = "/fragment@42/__overlay__/state_reset_low";
		flashlights_lm3644_pins_default = "/fragment@33/__overlay__/flashlight_default";
		flashlights_lm3644_pins_hwen_high = "/fragment@33/__overlay__/hwen_high";
		flashlights_lm3644_pins_hwen_low = "/fragment@33/__overlay__/hwen_low";
		flashlights_lm3644_pins_irq = "/fragment@33/__overlay__/flash_irq";
		gpio164_otg_pull1_high = "/fragment@8/__overlay__/otg_pull1_high";
		gpio164_otg_pull1_in = "/fragment@8/__overlay__/otg_pull1_in";
		gpio164_otg_pull1_low = "/fragment@8/__overlay__/otg_pull1_low";
		gpio165_otg_pull_high = "/fragment@8/__overlay__/otg_pull_high";
		gpio165_otg_pull_in = "/fragment@8/__overlay__/otg_pull_in";
		gpio165_otg_pull_low = "/fragment@8/__overlay__/otg_pull_low";
		gpio167_otg_pull1_high = "/fragment@8/__overlay__/otg167_pull1_high";
		gpio167_otg_pull1_in = "/fragment@8/__overlay__/otg167_pull1_in";
		gpio167_otg_pull1_low = "/fragment@8/__overlay__/otg167_pull1_low";
		gpio41_mode0_gpio = "/fragment@8/__overlay__/iddig_gpio";
		gpio41_mode0_gpio_pull_down = "/fragment@8/__overlay__/iddig_gpio_pull_down";
		gpio41_mode1_iddig = "/fragment@8/__overlay__/iddig_init";
		gpslna_pins_init = "/fragment@10/__overlay__/gpslna@0";
		gpslna_pins_oh = "/fragment@10/__overlay__/gpslna@1";
		gpslna_pins_ol = "/fragment@10/__overlay__/gpslna@2";
		iddig_default = "/fragment@8/__overlay__/iddig_default";
		irtx_gpio_led_default = "/fragment@25/__overlay__/irtx_gpio_led_def@gpio90";
		irtx_gpio_led_set = "/fragment@25/__overlay__/irtx_gpio_led_set@gpio90";
		kpd_pins_default = "/fragment@13/__overlay__/kpdgpiodefault";
		lcm_bkg_en0_gpio = "/fragment@23/__overlay__/lcm_bkg_en0_gpio";
		lcm_bkg_en1_gpio = "/fragment@23/__overlay__/lcm_bkg_en1_gpio";
		lcm_enn_en0_gpio = "/fragment@23/__overlay__/lcm_enn_en0_gpio";
		lcm_enn_en1_gpio = "/fragment@23/__overlay__/lcm_enn_en1_gpio";
		lcm_enp_en0_gpio = "/fragment@23/__overlay__/lcm_enp_en0_gpio";
		lcm_enp_en1_gpio = "/fragment@23/__overlay__/lcm_enp_en1_gpio";
		lcm_rst_out0_gpio = "/fragment@23/__overlay__/lcm_rst_out0_gpio";
		lcm_rst_out1_gpio = "/fragment@23/__overlay__/lcm_rst_out1_gpio";
		lcm_vddi_en0_gpio = "/fragment@23/__overlay__/lcm_vddi_en0_gpio";
		lcm_vddi_en1_gpio = "/fragment@23/__overlay__/lcm_vddi_en1_gpio";
		led0 = "/fragment@1/__overlay__/led@0";
		led1 = "/fragment@1/__overlay__/led@1";
		led2 = "/fragment@1/__overlay__/led@2";
		led3 = "/fragment@1/__overlay__/led@3";
		led4 = "/fragment@1/__overlay__/led@4";
		led5 = "/fragment@1/__overlay__/led@5";
		led6 = "/fragment@1/__overlay__/led@6";
		msdc0_pins_default = "/fragment@95/__overlay__/msdc0@default";
		msdc0_pins_hs200 = "/fragment@95/__overlay__/msdc0@hs200";
		msdc0_pins_hs400 = "/fragment@95/__overlay__/msdc0@hs400";
		msdc0_register_setting_default = "/fragment@95/__overlay__/msdc0@register_default";
		msdc1_pins_ddr50 = "/fragment@37/__overlay__/msdc1@ddr50";
		msdc1_pins_default = "/fragment@37/__overlay__/msdc1@default";
		msdc1_pins_sdr50 = "/fragment@37/__overlay__/msdc1@sdr50";
		nfc_clk_spi = "/fragment@20/__overlay__/sn100_clk_spi";
		nfc_cs_spi = "/fragment@20/__overlay__/sn100_cs_spi";
		nfc_disable_active = "/fragment@16/__overlay__/nfc_disable_active";
		nfc_disable_suspend = "/fragment@16/__overlay__/nfc_disable_suspend";
		nfc_int_active = "/fragment@16/__overlay__/nfc_int_active";
		nfc_int_suspend = "/fragment@16/__overlay__/nfc_int_suspend";
		nfc_miso_spi = "/fragment@20/__overlay__/sn100_miso_spi";
		nfc_mosi_spi = "/fragment@20/__overlay__/sn100_mosi_spi";
		sar_power_state = "/fragment@4/__overlay__/sar_power_rf_detect";
		spi3_clk_set_cfg = "/fragment@100/__overlay__/spi3_clk_set";
		spi3_cs_set_cfg = "/fragment@100/__overlay__/spi3_cs_set";
		spi3_miso_set_cfg = "/fragment@100/__overlay__/spi3_miso_set";
		spi3_mosi_set_cfg = "/fragment@100/__overlay__/spi3_mosi_set";
		spi_driving_set_cfg = "/fragment@9/__overlay__/spi_driving_set";
		spi_pins_pd2036_cfg = "/fragment@100/__overlay__/spi_pins_pd2036";
		subpmic_pmu_mtk = "/fragment@51/__overlay__/subpmic_pmu@34";
		tp_rst_out0_gpio = "/fragment@23/__overlay__/tp_rst_out0_gpio";
		tp_rst_out1_gpio = "/fragment@23/__overlay__/tp_rst_out1_gpio";
		vibrator0 = "/fragment@1/__overlay__/vibrator@0";
	};

	fragment@0 {
		target = <0xffffffff>;

		__overlay__ {
			atag,videolfb-fb_base_h = <0x0>;
			atag,videolfb-fb_base_l = "^`P";
			atag,videolfb-fps = <0x1770>;
			atag,videolfb-islcm_inited = <0x0>;
			atag,videolfb-islcmfound = <0x1>;
			atag,videolfb-lcmname = "pd2140_boe_nt36525b_noflash_hdp_dsi_vdo";
			atag,videolfb-project-name = "PD2140IF_EX";
			atag,videolfb-vramSize = <0x17bb000>;

			vivo,panel_info {
				vivo,panel-materiel-id-list = "1211788", "0x31", "1211792", "0x13", "1211789", "0x66", "1211790", "0x81", "1211791", "0x91", "1211710", "0x27";
			};
		};
	};

	fragment@1 {
		target = <0xffffffff>;

		__overlay__ {

			led@0 {
				compatible = "mediatek,red";
				data = <0x1>;
				led_mode = <0x0>;
				phandle = <0x69>;
				pwm_config = <0x0 0x0 0x0 0x0 0x0>;
			};

			led@1 {
				compatible = "mediatek,green";
				data = <0x1>;
				led_mode = <0x0>;
				phandle = <0x6a>;
				pwm_config = <0x0 0x0 0x0 0x0 0x0>;
			};

			led@2 {
				compatible = "mediatek,blue";
				data = <0x1>;
				led_mode = <0x0>;
				phandle = <0x6b>;
				pwm_config = <0x0 0x0 0x0 0x0 0x0>;
			};

			led@3 {
				compatible = "mediatek,jogball-backlight";
				data = <0x1>;
				led_mode = <0x0>;
				phandle = <0x6c>;
				pwm_config = <0x0 0x0 0x0 0x0 0x0>;
			};

			led@4 {
				compatible = "mediatek,keyboard-backlight";
				data = <0x1>;
				led_mode = <0x0>;
				phandle = <0x6d>;
				pwm_config = <0x0 0x0 0x0 0x0 0x0>;
			};

			led@5 {
				compatible = "mediatek,button-backlight";
				data = <0x1>;
				led_mode = <0x0>;
				phandle = <0x6e>;
				pwm_config = <0x0 0x0 0x0 0x0 0x0>;
			};

			led@6 {
				compatible = "mediatek,lcd-backlight";
				data = <0x1>;
				led_mode = <0x4>;
				phandle = <0x6f>;
				pwm_config = <0x0 0x0 0x0 0x0 0x0>;
			};

			vibrator@0 {
				compatible = "mediatek,vibrator";
				phandle = <0x70>;
				vib_limit = <0x9>;
				vib_timer = <0x19>;
				vib_vol = <0xb>;
			};
		};
	};

	fragment@10 {
		target = <0xffffffff>;

		__overlay__ {

			consys_default {
				phandle = <0x2>;
			};

			gpslna@0 {
				phandle = <0x3>;

				pins_cmd_dat {
					bias-disable;
					output-low;
					pinmux = <0x5b00>;
					slew-rate = <0x0>;
				};
			};

			gpslna@1 {
				phandle = <0x4>;

				pins_cmd_dat {
					output-high;
					pinmux = <0x5b00>;
					slew-rate = <0x1>;
				};
			};

			gpslna@2 {
				phandle = <0x5>;

				pins_cmd_dat {
					output-low;
					pinmux = <0x5b00>;
					slew-rate = <0x1>;
				};
			};
		};
	};

	fragment@100 {
		target = <0xffffffff>;

		__overlay__ {

			spi3_clk_set {
				phandle = <0x68>;

				pins_cmd_dat {
					bias-disable;
					drive-strength = <0x3>;
					pinmux = <0x1801>;
				};
			};

			spi3_cs_set {
				phandle = <0x85>;

				pins_cmd_dat {
					bias-disable;
					drive-strength = <0x3>;
					pinmux = <0x1600>;
				};
			};

			spi3_miso_set {
				phandle = <0x86>;

				pins_cmd_dat {
					bias-disable;
					drive-strength = <0x3>;
					pinmux = <0x1500>;
				};
			};

			spi3_mosi_set {
				phandle = <0x87>;

				pins_cmd_dat {
					bias-disable;
					drive-strength = <0x3>;
					pinmux = <0x1701>;
				};
			};

			spi_pins_pd2036 {
				phandle = <0x88>;

				pins_cmd_dat {
					bias-disable;
					drive-strength = <0x3>;
					pinmux = <0x1501 0x1601 0x1701 0x1801>;
				};
			};
		};
	};

	fragment@101 {
		target = <0xffffffff>;

		__overlay__ {
			#address-cells = <0x1>;
			#size-cells = <0x0>;

			vts_device@0 {
				compatible = "vivo,ts-spi";
				reg = <0x0>;
				spi-max-frequency = <0x493e00>;
				status = "okay";

				chipone {
					chipone,irq-gpio = <0xffffffff 0x0 0x2>;
					chipone,rst-gpio = <0xffffffff 0xb2 0x0>;
					chipone,x-res = <0x2d0>;
					chipone,y-res = <0x640>;
					compatible = "chipone,cts_nl9911c_spi";
					lcm-noise-test-key = "com.touchscreen.chipone.vivo_noise:NoiseActivity:null:null:null";
					rawdata-test-key = "com.touchscreen.chipone.icnl9911c:DataShowActivity:null:null:null";
					rf-noise-test-key = "com.touchscreen.chipone.vivo_noise:BspTestActivity:action_noise_test:0:result";
					sensor-test-key = "com.touchscreen.chipone:MainActivity:android.intent.action.chipone:0:testResult";
					spi-max-frequency = <0x927c00>;
					status = "ok";
					vts-ic-number = <0x6e>;
					vts-type = <0x0>;
				};

				ft8016 {
					compatible = "focaltech,ft8756_v2";
					focaltech,display-coords = <0x0 0x0 0x2d0 0x640>;
					focaltech,ic_name = "ft8016";
					focaltech,irq-gpio = <0xffffffff 0x0 0x2>;
					focaltech,max-touch-number = <0xa>;
					focaltech,reset-gpio = <0xffffffff 0xb2 0x0>;
					lcm-noise-test-key = "com.focaltech.deltadiff:MainActivity:null:null:null";
					rawdata-test-key = "com.focaltech.deltadiff:DataActivity:null:null:null";
					rf-noise-test-key = "com.focaltech.deltadiff:BspTestActivity:com.focaltech.deltadiff:0:testResult";
					sensor-test-key = "com.focaltouchscreen.sensortest:MainActivity:com.focaltouchscreen.sensortest:0:focal_test_result";
					spi-max-frequency = <0x5b8d80>;
					vts-ic-number = <0x25>;
					vts-type = <0x0>;
				};

				ft8756 {
					compatible = "focaltech,ft8756_v2";
					focaltech,display-coords = <0x0 0x0 0x2d0 0x640>;
					focaltech,ic_name = "ft8756";
					focaltech,irq-gpio = <0xffffffff 0x0 0x2>;
					focaltech,max-touch-number = <0xa>;
					focaltech,reset-gpio = <0xffffffff 0xb2 0x0>;
					lcm-noise-test-key = "com.focaltech.deltadiff:MainActivity:null:null:null";
					rawdata-test-key = "com.focaltech.deltadiff:DataActivity:null:null:null";
					rf-noise-test-key = "com.focaltech.deltadiff:BspTestActivity:com.focaltech.deltadiff:0:testResult";
					sensor-test-key = "com.focaltouchscreen.sensortest:MainActivity:com.focaltouchscreen.sensortest:0:focal_test_result";
					spi-max-frequency = <0x5b8d80>;
					vts-ic-number = <0x27>;
					vts-type = <0x0>;
				};

				ili9881h {
					compatible = "ilitek,ILI-ts-spi-v2";
					ilitek,irq-gpio = <0xffffffff 0x0 0x2>;
					ilitek,reset-gpio = <0xffffffff 0xb2 0x0>;
					lcm-noise-test-key = "com.ilitek.touchscreen.noisev2:MainActivity:null:null:null";
					rawdata-test-key = "com.ilitek.touchscreen.noisev2:DataShowActivity:null:null:null";
					rf-noise-test-key = "com.ilitek.touchscreen.noisev2:BspTestActivity:com.ilitek.touchscreen.action.noisetest:0:ILITEK_TpTestResult";
					sensor-test-key = "com.ilitek.touchscreen.tptest:MainActivity:com.ilitek.touchscreen.action.tptest:0:ILITEK_TpTestResult";
					spi-max-frequency = <0x927c00>;
					status = "ok";
					vts-ic-number = <0x5a>;
					vts-type = <0x0>;
				};

				nt36525A {
					compatible = "novatek,NVT-ts-spi-v2";
					lcm-noise-test-key = "com.nt36xxxtouchscreen.deltadiff:MainActivity:null:null:null";
					novatek,irq-gpio = <0xffffffff 0x0 0x2>;
					novatek,reset-gpio = <0xffffffff 0xb2 0x0>;
					novatek,swrst-n8-addr = <0x3f0fe>;
					pinctrl-0 = <0x68>;
					pinctrl-names = "spi_clk_active", "spi_mosi_active";
					rawdata-test-key = "com.nttouchscreen.getdata:MainActivity:null:null:null";
					rf-noise-test-key = "com.nt36xxxtouchscreen.deltadiff:BspTest:android.intent.action.nvtdeltadiff:0:testResult";
					sensor-test-key = "com.nttouchscreen.mptest:MainActivity:android.intent.action.novatek:0:testResult";
					spi-max-frequency = <0x927c00>;
					status = "ok";
					vts-ic-number = <0x54>;
					vts-type = <0x0>;
				};

				nt36672 {
					compatible = "novatek,NVT-ts-spi-v2";
					lcm-noise-test-key = "com.nt36xxxtouchscreen.deltadiff:MainActivity:null:null:null";
					novatek,irq-gpio = <0xffffffff 0x0 0x2>;
					novatek,swrst-n8-addr = <0x3f0fe>;
					pinctrl-0 = <0x68>;
					pinctrl-names = "spi_clk_active", "spi_mosi_active";
					rawdata-test-key = "com.nttouchscreen.getdata:MainActivity:null:null:null";
					rf-noise-test-key = "com.nt36xxxtouchscreen.deltadiff:BspTest:android.intent.action.nvtdeltadiff:0:testResult";
					sensor-test-key = "com.nttouchscreen.mptest:MainActivity:android.intent.action.novatek:0:testResult";
					spi-max-frequency = <0x927c00>;
					status = "ok";
					vts-ic-number = <0x52>;
					vts-type = <0x0>;
				};
			};
		};
	};

	fragment@11 {
		target = <0xffffffff>;

		__overlay__ {
			pinctrl-0 = <0x2>;
			pinctrl-1 = <0x3>;
			pinctrl-2 = <0x4>;
			pinctrl-3 = <0x5>;
			pinctrl-names = "default", "gps_lna_state_init", "gps_lna_state_oh", "gps_lna_state_ol";
			status = "okay";
		};
	};

	fragment@12 {
		target = <0xffffffff>;

		__overlay__ {
			pinctrl-0 = <0x6>;
			pinctrl-names = "default";
		};
	};

	fragment@13 {
		target = <0xffffffff>;

		__overlay__ {

			kpdgpiodefault {
				phandle = <0x6>;

				pins_cmd_dat {
					bias-pull-up = <0x66>;
					input-schmitt-enable;
					output-low;
					pinmux = <0x5d01>;
				};
			};
		};
	};

	fragment@14 {
		target = <0xffffffff>;

		__overlay__ {
			accdet-mic-mode = <0x1>;
			accdet-mic-vol = <0x7>;
			accdet-plugout-debounce = <0x10>;
			headset-eint-level-pol = <0x8>;
			headset-four-key-threshold = <0x0 0x36 0x5a 0xbe 0x186>;
			headset-mode-setting = <0x500 0x500 0x1 0x1f0 0x800 0x800 0x2000 0x44>;
			headset-three-key-threshold = <0x0 0x51 0xbe 0x186>;
			headset-three-key-threshold-CDD = <0x0 0x79 0xc0 0x258>;
			pinctrl-0 = <0x7>;
			pinctrl-1 = <0x8>;
			pinctrl-2 = <0x9>;
			pinctrl-names = "default", "state_eint_as_int", "state_eint_r_as_int";
			status = "okay";
		};
	};

	fragment@15 {
		target = <0xffffffff>;

		__overlay__ {

			accdetdefault {
				phandle = <0x7>;
			};

			accdeteint@0 {
				phandle = <0x8>;

				pins_cmd_dat {
					bias-disable;
					pinmux = <0x400>;
					slew-rate = <0x0>;
				};
			};

			eint_hphr@0 {
				phandle = <0x9>;

				pins_cmd_dat {
					bias-disable;
					pinmux = <0x300>;
					slew-rate = <0x0>;
				};
			};
		};
	};

	fragment@16 {
		target = <0xffffffff>;

		__overlay__ {

			nfc_disable_active {
				phandle = <0xb>;

				pins_cmd0_dat {
					bias-pull-up;
					pinmux = <0xa00>;
				};

				pins_cmd1_dat {
					bias-pull-up;
					pinmux = <0xa800>;
				};
			};

			nfc_disable_suspend {
				phandle = <0xd>;

				pins_cmd0_dat {
					bias-disable;
					pinmux = <0xa00>;
				};

				pins_cmd1_dat {
					bias-disable;
					pinmux = <0xa800>;
				};
			};

			nfc_int_active {
				phandle = <0xa>;

				pins_cmd0_dat {
					bias-pull-up;
					pinmux = <0x900>;
				};
			};

			nfc_int_suspend {
				phandle = <0xc>;

				pins_cmd0_dat {
					bias-pull-up;
					pinmux = <0x900>;
				};
			};
		};
	};

	fragment@17 {
		target = <0xffffffff>;

		__overlay__ {
			#address-cells = <0x1>;
			#size-cells = <0x0>;
			clock-frequency = <0x61a80>;
			mediatek,use-open-drain;
			status = "okay";

			nq@28 {
				compatible = "mediatek,sn100";
				interrupt-names = "nfc_irq";
				interrupt-parent = <0xffffffff>;
				interrupts = <0x9 0x0>;
				mediatek,nq-firm = <0xffffffff 0xa8 0x0>;
				mediatek,nq-irq = <0xffffffff 0x9 0x0>;
				mediatek,nq-pd2139_bad_ven = <0xffffffff 0x96 0x0>;
				mediatek,nq-ven = <0xffffffff 0xa 0x0>;
				pinctrl-0 = <0xa 0xb>;
				pinctrl-1 = <0xc 0xd>;
				pinctrl-names = "nfc_active", "nfc_suspend";
				reg = <0x28>;
				vivo,boardversion_mask = <0x1>;
				vivo,boardversion_num = <0x1>;
				vivo,boardversion_shift = <0x3>;
				vivo,boardversions = [30 00];
				vivo,nfc_support = <0x1>;
				vivo,project-name = "PD2139F_EX";
			};
		};
	};

	fragment@18 {
		target = <0xffffffff>;

		__overlay__ {
			#address-cells = <0x1>;
			#size-cells = <0x0>;

			nfc@0 {
				compatible = "mediatek,sn100-spi";
				reg = <0x0>;
				spi-max-frequency = <0x989680>;
				status = "disabled";
			};
		};
	};

	fragment@19 {
		target = <0xffffffff>;

		__overlay__ {
			pinctrl-0 = <0xe>;
			pinctrl-1 = <0xf>;
			pinctrl-2 = <0x10>;
			pinctrl-3 = <0x11>;
			pinctrl-names = "miso_spi", "mosi_spi", "cs_spi", "clk_spi";
			status = "disabled";
		};
	};

	fragment@2 {
		target = <0xffffffff>;

		__overlay__ {
			regulator-always-on;
			regulator-max-microvolt = <0x2dc6c0>;
			regulator-min-microvolt = <0x2dc6c0>;
		};
	};

	fragment@20 {
		target = <0xffffffff>;

		__overlay__ {

			sn100_clk_spi {
				phandle = <0x11>;

				pins_cmd_dat {
					drive-strength = <0x4>;
					pinmux = <0x1c01>;
				};
			};

			sn100_cs_spi {
				phandle = <0x10>;

				pins_cmd_dat {
					drive-strength = <0x4>;
					pinmux = <0x1a01>;
				};
			};

			sn100_miso_spi {
				phandle = <0xe>;

				pins_cmd_dat {
					drive-strength = <0x4>;
					pinmux = <0x1901>;
				};
			};

			sn100_mosi_spi {
				phandle = <0xf>;

				pins_cmd_dat {
					drive-strength = <0x4>;
					pinmux = <0x1b01>;
				};
			};
		};
	};

	fragment@21 {
		target = <0xffffffff>;

		__overlay__ {
			#address-cells = <0x1>;
			#size-cells = <0x0>;
			clock-frequency = <0x61a80>;
			mediatek,use-open-drain;
		};
	};

	fragment@22 {
		target = <0xffffffff>;

		__overlay__ {
			pinctrl-0 = <0x12>;
			pinctrl-1 = <0x13>;
			pinctrl-10 = <0x1c>;
			pinctrl-11 = <0x1d>;
			pinctrl-2 = <0x14>;
			pinctrl-3 = <0x15>;
			pinctrl-4 = <0x16>;
			pinctrl-5 = <0x17>;
			pinctrl-6 = <0x18>;
			pinctrl-7 = <0x19>;
			pinctrl-8 = <0x1a>;
			pinctrl-9 = <0x1b>;
			pinctrl-names = "lcm_rst_out0_gpio", "lcm_rst_out1_gpio", "lcm_vddi_en0_gpio", "lcm_vddi_en1_gpio", "lcm_enp_en0_gpio", "lcm_enp_en1_gpio", "lcm_enn_en0_gpio", "lcm_enn_en1_gpio", "lcm_bkg_en0_gpio", "lcm_bkg_en1_gpio", "tp_rst_out0_gpio", "tp_rst_out1_gpio";
			status = "okay";
		};
	};

	fragment@23 {
		target = <0xffffffff>;

		__overlay__ {

			lcm_bkg_en0_gpio {
				phandle = <0x1a>;
			};

			lcm_bkg_en1_gpio {
				phandle = <0x1b>;
			};

			lcm_enn_en0_gpio {
				phandle = <0x18>;

				pins_cmd_dat {
					output-low;
					pinmux = <0xa500>;
					slew-rate = <0x1>;
				};
			};

			lcm_enn_en1_gpio {
				phandle = <0x19>;

				pins_cmd_dat {
					output-high;
					pinmux = <0xa500>;
					slew-rate = <0x1>;
				};
			};

			lcm_enp_en0_gpio {
				phandle = <0x16>;

				pins_cmd_dat {
					output-low;
					pinmux = <0xa600>;
					slew-rate = <0x1>;
				};
			};

			lcm_enp_en1_gpio {
				phandle = <0x17>;

				pins_cmd_dat {
					output-high;
					pinmux = <0xa600>;
					slew-rate = <0x1>;
				};
			};

			lcm_rst_out0_gpio {
				phandle = <0x12>;

				pins_cmd_dat {
					output-low;
					pinmux = <0x2d00>;
					slew-rate = <0x1>;
				};
			};

			lcm_rst_out1_gpio {
				phandle = <0x13>;

				pins_cmd_dat {
					output-high;
					pinmux = <0x2d00>;
					slew-rate = <0x1>;
				};
			};

			lcm_vddi_en0_gpio {
				phandle = <0x14>;
			};

			lcm_vddi_en1_gpio {
				phandle = <0x15>;
			};

			tp_rst_out0_gpio {
				phandle = <0x1c>;

				pins_cmd_dat {
					output-low;
					pinmux = <0xb200>;
					slew-rate = <0x1>;
				};
			};

			tp_rst_out1_gpio {
				phandle = <0x1d>;

				pins_cmd_dat {
					output-high;
					pinmux = <0xb200>;
					slew-rate = <0x1>;
				};
			};
		};
	};

	fragment@24 {
		target = <0xffffffff>;

		__overlay__ {
			pinctrl-0 = <0x1e>;
			pinctrl-1 = <0x1f>;
			pinctrl-names = "irtx_gpio_led_default", "irtx_gpio_led_set";
			status = "okay";
		};
	};

	fragment@25 {
		target = <0xffffffff>;

		__overlay__ {

			irtx_gpio_led_def@gpio90 {
				phandle = <0x1e>;

				pins_cmd_dat {
					bias-disable;
					input-schmitt-enable = <0x0>;
					output-low;
					pinmux = <0x5a00>;
					slew-rate = <0x1>;
				};
			};

			irtx_gpio_led_set@gpio90 {
				phandle = <0x1f>;

				pins_cmd_dat {
					output-high;
					pinmux = <0x5a02>;
					slew-rate = <0x1>;
				};
			};
		};
	};

	fragment@26 {
		target = <0xffffffff>;

		__overlay__ {
			pinctrl-0 = <0x20>;
			pinctrl-1 = <0x21>;
			pinctrl-2 = <0x22>;
			pinctrl-3 = <0x23>;
			pinctrl-names = "aud_dat_mosi_off", "aud_dat_mosi_on", "aud_dat_miso_off", "aud_dat_miso_on", "aud_smartpa_off", "aud_smartpa_on";
			status = "okay";
		};
	};

	fragment@27 {
		target = <0xffffffff>;

		__overlay__ {

			aud_dat_miso_off {
				phandle = <0x22>;

				pins_cmd0_dat {
					drive-strength = <0x0>;
					pinmux = <0x8c00>;
				};

				pins_cmd1_dat {
					drive-strength = <0x0>;
					pinmux = <0x8d00>;
				};

				pins_cmd2_dat {
					bias-disable;
					drive-strength = <0x0>;
					input-enable;
					pinmux = <0x8e00>;
					slew-rate = <0x0>;
				};

				pins_cmd3_dat {
					bias-disable;
					drive-strength = <0x0>;
					input-enable;
					pinmux = <0x8f00>;
					slew-rate = <0x0>;
				};
			};

			aud_dat_miso_on {
				phandle = <0x23>;

				pins_cmd0_dat {
					drive-strength = <0x3>;
					input-schmitt-enable;
					pinmux = <0x8c01>;
				};

				pins_cmd1_dat {
					drive-strength = <0x3>;
					input-schmitt-enable;
					pinmux = <0x8d01>;
				};

				pins_cmd2_dat {
					drive-strength = <0x3>;
					input-schmitt-enable;
					pinmux = <0x8e01>;
				};

				pins_cmd3_dat {
					drive-strength = <0x3>;
					input-schmitt-enable;
					pinmux = <0x8f01>;
				};
			};

			aud_dat_mosi_off {
				phandle = <0x20>;

				pins_cmd0_dat {
					drive-strength = <0x0>;
					pinmux = <0x8800>;
				};

				pins_cmd1_dat {
					drive-strength = <0x0>;
					pinmux = <0x8900>;
				};

				pins_cmd2_dat {
					bias-disable;
					drive-strength = <0x0>;
					input-enable;
					pinmux = <0x8a00>;
					slew-rate = <0x0>;
				};

				pins_cmd3_dat {
					bias-disable;
					drive-strength = <0x0>;
					input-enable;
					pinmux = <0x8b00>;
					slew-rate = <0x0>;
				};
			};

			aud_dat_mosi_on {
				phandle = <0x21>;

				pins_cmd0_dat {
					drive-strength = <0x3>;
					input-schmitt-enable;
					pinmux = <0x8801>;
				};

				pins_cmd1_dat {
					drive-strength = <0x3>;
					input-schmitt-enable;
					pinmux = <0x8901>;
				};

				pins_cmd2_dat {
					drive-strength = <0x3>;
					input-schmitt-enable;
					pinmux = <0x8a01>;
				};

				pins_cmd3_dat {
					drive-strength = <0x3>;
					input-schmitt-enable;
					pinmux = <0x8b01>;
				};
			};
		};
	};

	fragment@28 {
		target = <0xffffffff>;

		__overlay__ {
			mt6370,intr_gpio = <0xffffffff 0xb 0x0>;
			mt6370,intr_gpio_num = <0xb>;
		};
	};

	fragment@29 {
		target = <0xffffffff>;

		__overlay__ {
			mt6370pd,intr_gpio = <0xffffffff 0x29 0x0>;
			mt6370pd,intr_gpio_num = <0x29>;
		};
	};

	fragment@3 {
		target = <0xffffffff>;

		__overlay__ {
			regulator-max-microvolt = <0x2dc6c0>;
			regulator-min-microvolt = <0x2dc6c0>;
		};
	};

	fragment@30 {
		target = <0xffffffff>;

		__overlay__ {
			bc12_sel = <0x1>;
		};
	};

	fragment@31 {
		target = <0xffffffff>;

		__overlay__ {

			cam0@0 {
				phandle = <0x25>;

				pins_cmd_dat {
					output-low;
					pinmux = <0x6500>;
					slew-rate = <0x1>;
				};
			};

			cam0@1 {
				phandle = <0x26>;

				pins_cmd_dat {
					output-high;
					pinmux = <0x6500>;
					slew-rate = <0x1>;
				};
			};

			cam0@vcama0 {
				phandle = <0x2d>;

				pins_cmd_dat {
					output-low;
					pinmux = <0x9c00>;
					slew-rate = <0x1>;
				};
			};

			cam0@vcama1 {
				phandle = <0x2e>;

				pins_cmd_dat {
					output-high;
					pinmux = <0x9c00>;
					slew-rate = <0x1>;
				};
			};

			cam1@0 {
				phandle = <0x27>;

				pins_cmd_dat {
					output-low;
					pinmux = <0x6600>;
					slew-rate = <0x1>;
				};
			};

			cam1@1 {
				phandle = <0x28>;

				pins_cmd_dat {
					output-high;
					pinmux = <0x6600>;
					slew-rate = <0x1>;
				};
			};

			cam1@vcama0 {
				phandle = <0x31>;

				pins_cmd_dat {
					output-low;
					pinmux = <0x9c00>;
					slew-rate = <0x1>;
				};
			};

			cam1@vcama1 {
				phandle = <0x32>;

				pins_cmd_dat {
					output-high;
					pinmux = <0x9c00>;
					slew-rate = <0x1>;
				};
			};

			cam1@vcamd0 {
				phandle = <0x2f>;

				pins_cmd_dat {
					output-low;
					pinmux = <0x6200>;
					slew-rate = <0x1>;
				};
			};

			cam1@vcamd1 {
				phandle = <0x30>;

				pins_cmd_dat {
					output-high;
					pinmux = <0x6200>;
					slew-rate = <0x1>;
				};
			};

			cam2@0 {
				phandle = <0x29>;

				pins_cmd_dat {
					output-low;
					pinmux = <0x6d00>;
					slew-rate = <0x1>;
				};
			};

			cam2@1 {
				phandle = <0x2a>;

				pins_cmd_dat {
					output-high;
					pinmux = <0x6d00>;
					slew-rate = <0x1>;
				};
			};

			cam2@vcama0 {
				phandle = <0x33>;

				pins_cmd_dat {
					output-low;
					pinmux = <0x9c00>;
					slew-rate = <0x1>;
				};
			};

			cam2@vcama1 {
				phandle = <0x34>;

				pins_cmd_dat {
					output-high;
					pinmux = <0x9c00>;
					slew-rate = <0x1>;
				};
			};

			cam3@0 {
				phandle = <0x2b>;

				pins_cmd_dat {
					output-low;
					pinmux = <0x6600>;
					slew-rate = <0x1>;
				};
			};

			cam3@1 {
				phandle = <0x2c>;

				pins_cmd_dat {
					output-high;
					pinmux = <0x6600>;
					slew-rate = <0x1>;
				};
			};

			cam3@vcama0 {
				phandle = <0x35>;

				pins_cmd_dat {
					output-low;
					pinmux = <0x6100>;
					slew-rate = <0x1>;
				};
			};

			cam3@vcama1 {
				phandle = <0x36>;

				pins_cmd_dat {
					output-high;
					pinmux = <0x6100>;
					slew-rate = <0x1>;
				};
			};

			camdefault {
				phandle = <0x24>;
			};

			camera_pins_cam0_mclk_off {
				phandle = <0x38>;

				pins_cmd_dat {
					pinmux = <0x6300>;
				};
			};

			camera_pins_cam0_mclk_on {
				phandle = <0x37>;

				pins_cmd_dat {
					pinmux = <0x6301>;
				};
			};

			camera_pins_cam1_mclk_off {
				phandle = <0x3a>;

				pins_cmd_dat {
					pinmux = <0x6400>;
				};
			};

			camera_pins_cam1_mclk_on {
				phandle = <0x39>;

				pins_cmd_dat {
					pinmux = <0x6401>;
				};
			};

			camera_pins_cam2_mclk_off {
				phandle = <0x3c>;

				pins_cmd_dat {
					pinmux = <0x6c00>;
				};
			};

			camera_pins_cam2_mclk_on {
				phandle = <0x3b>;

				pins_cmd_dat {
					pinmux = <0x6c01>;
				};
			};

			camera_pins_cam3_mclk_off {
				phandle = <0x3e>;

				pins_cmd_dat {
					pinmux = <0x6400>;
				};
			};

			camera_pins_cam3_mclk_on {
				phandle = <0x3d>;

				pins_cmd_dat {
					pinmux = <0x6401>;
				};
			};
		};
	};

	fragment@32 {
		target = <0xffffffff>;

		__overlay__ {
			pinctrl-0 = <0x24>;
			pinctrl-1 = <0x25>;
			pinctrl-10 = <0x2e>;
			pinctrl-11 = <0x2f>;
			pinctrl-12 = <0x30>;
			pinctrl-13 = <0x31>;
			pinctrl-14 = <0x32>;
			pinctrl-15 = <0x33>;
			pinctrl-16 = <0x34>;
			pinctrl-17 = <0x35>;
			pinctrl-18 = <0x36>;
			pinctrl-19 = <0x37>;
			pinctrl-2 = <0x26>;
			pinctrl-20 = <0x38>;
			pinctrl-21 = <0x39>;
			pinctrl-22 = <0x3a>;
			pinctrl-23 = <0x3b>;
			pinctrl-24 = <0x3c>;
			pinctrl-25 = <0x3d>;
			pinctrl-26 = <0x3e>;
			pinctrl-3 = <0x27>;
			pinctrl-4 = <0x28>;
			pinctrl-5 = <0x29>;
			pinctrl-6 = <0x2a>;
			pinctrl-7 = <0x2b>;
			pinctrl-8 = <0x2c>;
			pinctrl-9 = <0x2d>;
			pinctrl-names = "default", "cam0_rst0", "cam0_rst1", "cam1_rst0", "cam1_rst1", "cam2_rst0", "cam2_rst1", "cam3_rst0", "cam3_rst1", "cam0_ldo_vcama_0", "cam0_ldo_vcama_1", "cam1_ldo_vcamd_0", "cam1_ldo_vcamd_1", "cam1_ldo_vcama_0", "cam1_ldo_vcama_1", "cam2_ldo_vcama_0", "cam2_ldo_vcama_1", "cam3_ldo_vcama_0", "cam3_ldo_vcama_1", "cam0_mclk_on", "cam0_mclk_off", "cam1_mclk_on", "cam1_mclk_off", "cam2_mclk_on", "cam2_mclk_off", "cam3_mclk_on", "cam3_mclk_off";
			status = "okay";
		};
	};

	fragment@33 {
		target = <0xffffffff>;

		__overlay__ {

			flash_irq {
				phandle = <0x42>;

				pins_cmd_dat {
					bias-disable;
					pinmux = <0x6b00>;
					slew-rate = <0x0>;
				};
			};

			flashlight_default {
				phandle = <0x3f>;
			};

			hwen_high {
				phandle = <0x40>;

				pins_cmd_dat {
					output-high;
					pinmux = <0x9d00>;
					slew-rate = <0x1>;
				};
			};

			hwen_low {
				phandle = <0x41>;

				pins_cmd_dat {
					output-low;
					pinmux = <0x9d00>;
					slew-rate = <0x1>;
				};
			};
		};
	};

	fragment@34 {
		target = <0xffffffff>;

		__overlay__ {
			pinctrl-0 = <0x3f>;
			pinctrl-1 = <0x40>;
			pinctrl-2 = <0x41>;
			pinctrl-3 = <0x42>;
			pinctrl-names = "default", "hwen_high", "hwen_low", "flash_irq";
			status = "okay";
		};
	};

	fragment@35 {
		target = <0xffffffff>;

		__overlay__ {
			bootable;
			bus-width = <0x8>;
			cap-mmc-highspeed;
			clk_src = [01];
			clock-names = "msdc0-clock", "msdc0-hclock", "msdc0-aes-clock";
			clocks = <0xffffffff 0x4c 0xffffffff 0x1c 0xffffffff 0x44>;
			host_function = [00];
			index = [00];
			max-frequency = <0xbebc200>;
			mmc-ddr-1_8v;
			mmc-hs200-1_8v;
			mmc-hs400-1_8v;
			no-sd;
			no-sdio;
			non-removable;
			pinctl = <0x43>;
			pinctl_hs200 = <0x45>;
			pinctl_hs400 = <0x44>;
			register_setting = <0x46>;
			status = "okay";
			vmmc-supply = <0xffffffff>;
		};
	};

	fragment@36 {
		target = <0xffffffff>;

		__overlay__ {
			PD2140IF_EX;
			fast_power_off;
			max-frequency = <0x2faf080>;
			pinctl = <0x47>;
			pinctl_ddr50 = <0x49>;
			pinctl_sdr50 = <0x48>;
		};
	};

	fragment@37 {
		target = <0xffffffff>;

		__overlay__ {

			msdc1@ddr50 {
				phandle = <0x49>;

				pins_clk {
					drive-strength = [03];
				};

				pins_cmd {
					drive-strength = [03];
				};

				pins_dat {
					drive-strength = [03];
				};
			};

			msdc1@default {
				phandle = <0x47>;

				pins_clk {
					drive-strength = [03];
				};

				pins_cmd {
					drive-strength = [03];
				};

				pins_dat {
					drive-strength = [03];
				};
			};

			msdc1@sdr50 {
				phandle = <0x48>;

				pins_clk {
					drive-strength = [03];
				};

				pins_cmd {
					drive-strength = [03];
				};

				pins_dat {
					drive-strength = [03];
				};
			};
		};
	};

	fragment@38 {
		target = <0xffffffff>;

		__overlay__ {
			#address-cells = <0x1>;
			#size-cells = <0x0>;

			fingerprint@0 {
				compatible = "mediatek,fingerprint";
				reg = <0x0>;
				spi-max-frequency = <0x7a1200>;
				status = "okay";
			};
		};
	};

	fragment@39 {
		target = <0xffffffff>;

		__overlay__ {
			fp,irq-gpio = <0xffffffff 0x5 0x0>;
			fp,reset_gpio = <0xffffffff 0xa9 0x0>;
			fp,vdd_use_pmic;
			interrupt-parent = <0xffffffff>;
			interrupts = <0x5 0x1 0x5 0x0>;
			pinctrl-0 = <0x4a>;
			pinctrl-1 = <0x4b>;
			pinctrl-10 = <0x54>;
			pinctrl-11 = <0x55>;
			pinctrl-12 = <0x56>;
			pinctrl-13 = <0x57>;
			pinctrl-14 = <0x58>;
			pinctrl-2 = <0x4c>;
			pinctrl-3 = <0x4d>;
			pinctrl-4 = <0x4e>;
			pinctrl-5 = <0x4f>;
			pinctrl-6 = <0x50>;
			pinctrl-7 = <0x51>;
			pinctrl-8 = <0x52>;
			pinctrl-9 = <0x53>;
			pinctrl-names = "fingerprint_irq", "miso_spi", "miso_pullhigh", "miso_pulllow", "reset_high", "reset_low", "mosi_spi", "mosi_pullhigh", "mosi_pulllow", "cs_spi", "cs_pullhigh", "cs_pulllow", "clk_spi", "clk_pullhigh", "clk_pulllow";
			status = "okay";
			vfp-supply = <0xffffffff>;
		};
	};

	fragment@4 {
		target = <0xffffffff>;

		__overlay__ {

			sar_power_rf_detect {
				phandle = <0x1>;

				pins_cmd0_dat {
					bias-disable;
					pinmux = <0x3600>;
					slew-rate = <0x0>;
				};
			};
		};
	};

	fragment@40 {
		target = <0xffffffff>;

		__overlay__ {
			debounce = <0x5 0x0>;
			fpsensor,irq-gpio = <0xffffffff 0x5 0x0>;
			fpsensor,reset_gpio = <0xffffffff 0xa9 0x0>;
			fpsensor,vdd_use_pmic;
			interrupt-parent = <0xffffffff>;
			interrupts = <0x5 0x1 0x5 0x0>;
			pinctrl-0 = <0x4a>;
			pinctrl-1 = <0x4b>;
			pinctrl-10 = <0x54>;
			pinctrl-11 = <0x55>;
			pinctrl-12 = <0x56>;
			pinctrl-13 = <0x57>;
			pinctrl-14 = <0x58>;
			pinctrl-2 = <0x4c>;
			pinctrl-3 = <0x4d>;
			pinctrl-4 = <0x4e>;
			pinctrl-5 = <0x4f>;
			pinctrl-6 = <0x50>;
			pinctrl-7 = <0x51>;
			pinctrl-8 = <0x52>;
			pinctrl-9 = <0x53>;
			pinctrl-names = "fingerprint_irq", "miso_spi", "miso_pullhigh", "miso_pulllow", "reset_high", "reset_low", "mosi_spi", "mosi_pullhigh", "mosi_pulllow", "cs_spi", "cs_pullhigh", "cs_pulllow", "clk_spi", "clk_pullhigh", "clk_pulllow";
			status = "okay";
			vfp-supply = <0xffffffff>;
		};
	};

	fragment@41 {
		target = <0xffffffff>;

		__overlay__ {
			fp,vdd_use_pmic;
			goodix,gpio_irq = <0xffffffff 0x5 0x0>;
			goodix,gpio_reset = <0xffffffff 0xa9 0x0>;
			interrupt-parent = <0xffffffff>;
			interrupts = <0x5 0x1 0x5 0x0>;
			pinctrl-0 = <0x4a>;
			pinctrl-1 = <0x4b>;
			pinctrl-10 = <0x54>;
			pinctrl-11 = <0x55>;
			pinctrl-12 = <0x56>;
			pinctrl-13 = <0x57>;
			pinctrl-14 = <0x58>;
			pinctrl-2 = <0x4c>;
			pinctrl-3 = <0x4d>;
			pinctrl-4 = <0x4e>;
			pinctrl-5 = <0x4f>;
			pinctrl-6 = <0x50>;
			pinctrl-7 = <0x51>;
			pinctrl-8 = <0x52>;
			pinctrl-9 = <0x53>;
			pinctrl-names = "fingerprint_irq", "miso_spi", "miso_pullhigh", "miso_pulllow", "reset_high", "reset_low", "mosi_spi", "mosi_pullhigh", "mosi_pulllow", "cs_spi", "cs_pullhigh", "cs_pulllow", "clk_spi", "clk_pullhigh", "clk_pulllow";
			status = "okay";
			vfp-supply = <0xffffffff>;
		};
	};

	fragment@42 {
		target = <0xffffffff>;

		__overlay__ {

			state_clk_pullhigh {
				phandle = <0x57>;

				pins_cmd_dat {
					output-high;
					pinmux = <0x1c00>;
					slew-rate = <0x1>;
				};
			};

			state_clk_pulllow {
				phandle = <0x58>;

				pins_cmd_dat {
					output-low;
					pinmux = <0x1c00>;
					slew-rate = <0x1>;
				};
			};

			state_clk_spi {
				phandle = <0x56>;

				pins_cmd_dat {
					drive-strength = <0x2>;
					pinmux = <0x1c01>;
				};
			};

			state_cs_pullhigh {
				phandle = <0x54>;

				pins_cmd_dat {
					output-high;
					pinmux = <0x1a00>;
					slew-rate = <0x1>;
				};
			};

			state_cs_pulllow {
				phandle = <0x55>;

				pins_cmd_dat {
					output-low;
					pinmux = <0x1a00>;
					slew-rate = <0x1>;
				};
			};

			state_cs_spi {
				phandle = <0x53>;

				pins_cmd_dat {
					drive-strength = <0x3>;
					pinmux = <0x1a01>;
				};
			};

			state_irq {
				phandle = <0x4a>;

				pins_cmd_dat {
					bias-disable;
					pinmux = <0x500>;
					slew-rate = <0x0>;
				};
			};

			state_miso_pullhigh {
				phandle = <0x4c>;

				pins_cmd_dat {
					output-high;
					pinmux = <0x1900>;
					slew-rate = <0x1>;
				};
			};

			state_miso_pulllow {
				phandle = <0x4d>;

				pins_cmd_dat {
					output-low;
					pinmux = <0x1900>;
					slew-rate = <0x1>;
				};
			};

			state_miso_spi {
				phandle = <0x4b>;

				pins_cmd_dat {
					pinmux = <0x1901>;
				};
			};

			state_mosi_pullhigh {
				phandle = <0x51>;

				pins_cmd_dat {
					output-high;
					pinmux = <0x1b00>;
					slew-rate = <0x1>;
				};
			};

			state_mosi_pulllow {
				phandle = <0x52>;

				pins_cmd_dat {
					output-low;
					pinmux = <0x1b00>;
					slew-rate = <0x1>;
				};
			};

			state_mosi_spi {
				phandle = <0x50>;

				pins_cmd_dat {
					drive-strength = <0x3>;
					pinmux = <0x1b01>;
				};
			};

			state_reset_high {
				phandle = <0x4e>;

				pins_cmd_dat {
					output-high;
					pinmux = <0xa900>;
					slew-rate = <0x1>;
				};
			};

			state_reset_low {
				phandle = <0x4f>;

				pins_cmd_dat {
					output-low;
					pinmux = <0xa900>;
					slew-rate = <0x1>;
				};
			};
		};
	};

	fragment@43 {
		target = <0xffffffff>;

		__overlay__ {
			status = "okay";
			vivo,project-name = "PD2140IF_EX";
			vivo,soft_fingerprint_id = "sidefp_xxxx_xxxx";
			vivo,support_soft_fingerprint_id;
		};
	};

	fragment@44 {
		target = <0xffffffff>;

		__overlay__ {

			adc_channel@ {
				compatible = "mediatek,adc_channel";
				mediatek,adc_fdd_rf_params_dynamic_custom_ch = <0x2>;
				mediatek,temperature0 = <0x0>;
				mediatek,temperature1 = <0x1>;
				status = "okay";
			};
		};
	};

	fragment@45 {
		target = <0xffffffff>;

		__overlay__ {
			mediatek,clkbuf-config = <0x2 0x1 0x2 0x2 0x0 0x0 0x0>;
			mediatek,clkbuf-driving-current = <0x1 0x1 0x1 0x1 0x1 0x1 0x1>;
			mediatek,clkbuf-quantity = <0x7>;
			status = "okay";
		};
	};

	fragment@46 {
		target = <0xffffffff>;

		__overlay__ {
			#address-cells = <0x1>;
			#size-cells = <0x0>;
			clock-frequency = <0x61a80>;
			mediatek,use-open-drain;

			cap_touch@5d {
				compatible = "mediatek,cap_touch";
				phandle = <0x72>;
				reg = <0x5d>;
				status = "okay";
			};
		};
	};

	fragment@47 {
		target = <0xffffffff>;

		__overlay__ {
			#address-cells = <0x1>;
			#size-cells = <0x0>;
			clock-frequency = <0x61a80>;
			mediatek,use-open-drain;
		};
	};

	fragment@48 {
		target = <0xffffffff>;

		__overlay__ {
			#address-cells = <0x1>;
			#size-cells = <0x0>;
			clock-frequency = <0x61a80>;
			mediatek,use-open-drain;

			camera_main@62 {
				compatible = "mediatek,camera_main";
				phandle = <0x73>;
				reg = <0x62>;
				status = "okay";
			};

			camera_main_af@18 {
				compatible = "mediatek,camera_main_af";
				phandle = <0x75>;
				reg = <0x18>;
				status = "okay";
			};

			camera_main_eeprom@51 {
				compatible = "mediatek,camera_main_eeprom";
				phandle = <0x74>;
				reg = <0x51>;
				status = "okay";
			};

			ccu_sensor_i2c_2_hw@33 {
				compatible = "mediatek,ccu_sensor_i2c_2_hw";
				phandle = <0x76>;
				reg = <0x33>;
				status = "okay";
			};
		};
	};

	fragment@49 {
		target = <0xffffffff>;

		__overlay__ {
			#address-cells = <0x1>;
			#size-cells = <0x0>;
			clock-frequency = <0x61a80>;
			mediatek,use-open-drain;

			SM5109@3e {
				compatible = "mediatek,SM5109";
				reg = <0x3e>;
				status = "okay";
			};

			ext_buck_lp4@57 {
				compatible = "mediatek,ext_buck_lp4";
				phandle = <0x77>;
				reg = <0x57>;
				status = "okay";
			};

			ext_buck_lp4x@50 {
				compatible = "mediatek,ext_buck_lp4x";
				phandle = <0x78>;
				reg = <0x50>;
				status = "okay";
			};

			strobe_main@6b {
				compatible = "mediatek,strobe_main";
				reg = <0x6b>;
				status = "okay";
			};
		};
	};

	fragment@5 {
		target = <0xffffffff>;

		__overlay__ {
			pinctrl-0 = <0x1>;
			pinctrl-names = "default";
			sar-power-rf-detect,gpios = <0xffffffff 0x36 0x0>;
			status = "okay";
		};
	};

	fragment@50 {
		target = <0xffffffff>;

		__overlay__ {
			#address-cells = <0x1>;
			#size-cells = <0x0>;
			clock-frequency = <0x61a80>;
			mediatek,use-open-drain;

			camera_main_three@2d {
				compatible = "mediatek,camera_main_three";
				phandle = <0x7f>;
				reg = <0x2d>;
				status = "okay";
			};

			camera_main_three_eeprom@50 {
				compatible = "mediatek,camera_main_three_eeprom";
				phandle = <0x80>;
				reg = <0x50>;
				status = "okay";
			};

			camera_main_two@6e {
				compatible = "mediatek,camera_main_two";
				phandle = <0x79>;
				reg = <0x6e>;
				status = "okay";
			};

			camera_main_two_eeprom@a0 {
				compatible = "mediatek,camera_main_two_eeprom";
				phandle = <0x7a>;
				reg = <0xa0>;
				status = "okay";
			};

			camera_sub@40 {
				compatible = "mediatek,camera_sub";
				phandle = <0x7b>;
				reg = <0x40>;
				status = "okay";
			};

			camera_sub_eeprom@20 {
				compatible = "mediatek,camera_sub_eeprom";
				phandle = <0x7c>;
				reg = <0x20>;
				status = "okay";
			};

			camera_sub_two@2d {
				compatible = "mediatek,camera_sub_two";
				phandle = <0x7d>;
				reg = <0x2d>;
				status = "okay";
			};

			camera_sub_two_eeprom@50 {
				compatible = "mediatek,camera_sub_two_eeprom";
				phandle = <0x7e>;
				reg = <0x50>;
				status = "okay";
			};

			ccu_sensor_i2c_4_hw@36 {
				compatible = "mediatek,ccu_sensor_i2c_4_hw";
				phandle = <0x81>;
				reg = <0x36>;
				status = "okay";
			};
		};
	};

	fragment@51 {
		target = <0xffffffff>;

		__overlay__ {
			#address-cells = <0x1>;
			#size-cells = <0x0>;
			clock-frequency = <0x61a80>;
			mediatek,use-open-drain;

			subpmic_pmu@34 {
				compatible = "mediatek,subpmic_pmu";
				phandle = <0x82>;
				reg = <0x34>;
				status = "okay";
			};

			usb_type_c@4e {
				compatible = "mediatek,usb_type_c";
				reg = <0x4e>;
				status = "okay";
			};
		};
	};

	fragment@52 {
		target = <0xffffffff>;

		__overlay__ {
			#address-cells = <0x1>;
			#size-cells = <0x0>;
			clock-frequency = <0x61a80>;
			mediatek,use-open-drain;

			ext_buck_vgpu@55 {
				compatible = "mediatek,ext_buck_vgpu";
				phandle = <0x83>;
				reg = <0x55>;
				status = "okay";
			};
		};
	};

	fragment@53 {
		target = <0xffffffff>;

		__overlay__ {
			#address-cells = <0x1>;
			#size-cells = <0x0>;
			clock-frequency = <0x61a80>;
			mediatek,use-open-drain;
		};
	};

	fragment@54 {
		target = <0xffffffff>;

		__overlay__ {
			#address-cells = <0x1>;
			#size-cells = <0x0>;
			clock-frequency = <0x61a80>;
			mediatek,use-open-drain;
		};
	};

	fragment@55 {
		target = <0xffffffff>;

		__overlay__ {
			#address-cells = <0x1>;
			#size-cells = <0x0>;
			clock-frequency = <0x61a80>;
			mediatek,use-open-drain;
		};
	};

	fragment@56 {
		target = <0xffffffff>;

		__overlay__ {
			GPIO_FDD_BAND_SUPPORT_DETECT_1ST_PIN = <0xffffffff 0xac 0x0>;
			GPIO_FDD_BAND_SUPPORT_DETECT_2ND_PIN = <0xffffffff 0x35 0x0>;
			GPIO_FDD_BAND_SUPPORT_DETECT_3RD_PIN = <0xffffffff 0x34 0x0>;
			GPIO_FDD_BAND_SUPPORT_DETECT_4TH_PIN = <0xffffffff 0x2a 0x0>;
			GPIO_SIM1_HOT_PLUG = <0xffffffff 0x2f 0x0>;
			GPIO_SIM1_SCLK = <0xffffffff 0x26 0x0>;
			GPIO_SIM1_SIO = <0xffffffff 0x28 0x0>;
			GPIO_SIM1_SRST = <0xffffffff 0x27 0x0>;
			GPIO_SIM2_SCLK = <0xffffffff 0x25 0x0>;
			GPIO_SIM2_SIO = <0xffffffff 0x23 0x0>;
			GPIO_SIM2_SRST = <0xffffffff 0x24 0x0>;
		};
	};

	fragment@57 {
		target = <0xffffffff>;

		__overlay__ {
			gpio_init_default = <0x0 0x0 0x0 0x0 0x0 0x1 0x1 0x1 0x0 0x0 0x0 0x0 0x0 0x1 0x2 0x0 0x1 0x0 0x0 0x0 0x0 0x3 0x0 0x0 0x0 0x1 0x1 0x1 0x4 0x0 0x0 0x0 0x1 0x1 0x0 0x5 0x0 0x0 0x0 0x1 0x0 0x0 0x6 0x0 0x1 0x0 0x0 0x0 0x0 0x7 0x0 0x0 0x0 0x1 0x1 0x0 0x8 0x0 0x0 0x0 0x0 0x0 0x1 0x9 0x0 0x0 0x0 0x0 0x0 0x0 0xa 0x0 0x0 0x0 0x1 0x1 0x1 0xb 0x0 0x0 0x0 0x1 0x1 0x0 0xc 0x0 0x0 0x0 0x1 0x0 0x0 0xd 0x3 0x0 0x0 0x1 0x1 0x0 0xe 0x3 0x1 0x0 0x0 0x0 0x0 0xf 0x3 0x1 0x0 0x0 0x0 0x0 0x10 0x3 0x1 0x0 0x0 0x0 0x0 0x11 0x2 0x0 0x0 0x1 0x0 0x0 0x12 0x2 0x0 0x0 0x1 0x0 0x0 0x13 0x2 0x0 0x0 0x0 0x0 0x0 0x14 0x2 0x0 0x0 0x1 0x0 0x0 0x15 0x1 0x0 0x0 0x1 0x0 0x0 0x16 0x1 0x0 0x0 0x1 0x0 0x0 0x17 0x1 0x1 0x0 0x0 0x0 0x0 0x18 0x1 0x0 0x0 0x0 0x0 0x0 0x19 0x0 0x1 0x0 0x0 0x0 0x0 0x1a 0x0 0x1 0x0 0x0 0x0 0x0 0x1b 0x0 0x1 0x0 0x0 0x0 0x0 0x1c 0x0 0x1 0x0 0x0 0x0 0x0 0x1d 0x1 0x1 0x0 0x0 0x0 0x1 0x1e 0x1 0x0 0x0 0x1 0x1 0x1 0x1f 0x1 0x0 0x0 0x1 0x1 0x1 0x20 0x1 0x0 0x0 0x1 0x1 0x1 0x21 0x1 0x0 0x0 0x1 0x1 0x1 0x22 0x1 0x0 0x0 0x1 0x1 0x1 0x23 0x1 0x0 0x0 0x1 0x1 0x0 0x24 0x1 0x1 0x0 0x0 0x0 0x0 0x25 0x1 0x1 0x0 0x0 0x0 0x0 0x26 0x1 0x1 0x0 0x0 0x0 0x0 0x27 0x1 0x1 0x0 0x0 0x0 0x0 0x28 0x1 0x0 0x0 0x1 0x1 0x0 0x29 0x0 0x0 0x0 0x1 0x1 0x0 0x2a 0x0 0x0 0x0 0x1 0x1 0x0 0x2b 0x1 0x1 0x0 0x0 0x0 0x0 0x2c 0x1 0x0 0x0 0x1 0x0 0x0 0x2d 0x0 0x1 0x0 0x0 0x0 0x0 0x2e 0x0 0x0 0x0 0x1 0x0 0x1 0x2f 0x0 0x0 0x0 0x1 0x0 0x1 0x30 0x1 0x0 0x0 0x1 0x1 0x1 0x31 0x1 0x0 0x0 0x1 0x1 0x1 0x32 0x1 0x0 0x0 0x1 0x1 0x1 0x33 0x1 0x1 0x0 0x1 0x1 0x1 0x34 0x0 0x0 0x0 0x1 0x1 0x0 0x35 0x0 0x0 0x0 0x1 0x1 0x0 0x36 0x0 0x0 0x0 0x0 0x0 0x1 0x37 0x1 0x1 0x0 0x1 0x0 0x0 0x38 0x1 0x1 0x0 0x1 0x0 0x0 0x39 0x1 0x1 0x0 0x1 0x0 0x0 0x3a 0x0 0x0 0x0 0x1 0x0 0x0 0x3b 0x1 0x0 0x0 0x1 0x0 0x0 0x3c 0x1 0x0 0x0 0x1 0x0 0x0 0x3d 0x1 0x0 0x0 0x1 0x0 0x0 0x3e 0x1 0x0 0x0 0x1 0x0 0x0 0x3f 0x1 0x0 0x0 0x1 0x0 0x0 0x40 0x1 0x0 0x0 0x1 0x0 0x0 0x41 0x1 0x0 0x0 0x1 0x0 0x0 0x42 0x1 0x0 0x0 0x1 0x0 0x0 0x43 0x1 0x0 0x0 0x1 0x0 0x0 0x44 0x1 0x0 0x0 0x1 0x0 0x0 0x45 0x1 0x1 0x0 0x1 0x0 0x0 0x46 0x1 0x1 0x0 0x1 0x0 0x0 0x47 0x1 0x1 0x0 0x1 0x0 0x0 0x48 0x1 0x1 0x0 0x1 0x0 0x0 0x49 0x1 0x1 0x0 0x1 0x0 0x0 0x4a 0x1 0x1 0x0 0x1 0x0 0x0 0x4b 0x0 0x0 0x0 0x1 0x0 0x0 0x4c 0x1 0x1 0x0 0x1 0x0 0x0 0x4d 0x1 0x1 0x0 0x1 0x0 0x0 0x4e 0x0 0x0 0x0 0x1 0x1 0x0 0x4f 0x0 0x0 0x0 0x1 0x0 0x0 0x50 0x0 0x0 0x0 0x1 0x0 0x0 0x51 0x1 0x0 0x0 0x1 0x1 0x1 0x52 0x1 0x0 0x0 0x1 0x1 0x1 0x53 0x1 0x0 0x0 0x1 0x1 0x1 0x54 0x1 0x0 0x0 0x1 0x1 0x1 0x55 0x1 0x1 0x0 0x1 0x0 0x0 0x56 0x1 0x1 0x0 0x1 0x0 0x0 0x57 0x0 0x1 0x0 0x0 0x0 0x0 0x58 0x0 0x0 0x0 0x1 0x0 0x0 0x59 0x1 0x0 0x0 0x1 0x0 0x0 0x5a 0x0 0x0 0x0 0x1 0x0 0x0 0x5b 0x0 0x1 0x0 0x1 0x0 0x0 0x5c 0x0 0x0 0x0 0x1 0x0 0x0 0x5d 0x1 0x0 0x0 0x1 0x1 0x0 0x5e 0x0 0x0 0x0 0x1 0x0 0x0 0x5f 0x1 0x0 0x0 0x1 0x1 0x0 0x60 0x1 0x1 0x0 0x0 0x0 0x0 0x61 0x0 0x1 0x0 0x0 0x0 0x0 0x62 0x0 0x1 0x0 0x0 0x0 0x0 0x63 0x0 0x1 0x0 0x0 0x0 0x0 0x64 0x0 0x1 0x0 0x0 0x0 0x0 0x65 0x0 0x1 0x0 0x0 0x0 0x0 0x66 0x0 0x1 0x0 0x0 0x0 0x0 0x67 0x1 0x0 0x0 0x1 0x1 0x1 0x68 0x1 0x0 0x0 0x1 0x1 0x1 0x69 0x1 0x0 0x0 0x1 0x1 0x1 0x6a 0x1 0x0 0x0 0x1 0x1 0x1 0x6b 0x0 0x0 0x0 0x1 0x1 0x0 0x6c 0x0 0x1 0x0 0x0 0x0 0x0 0x6d 0x0 0x1 0x0 0x0 0x0 0x0 0x6e 0x0 0x0 0x0 0x1 0x1 0x0 0x6f 0x0 0x0 0x0 0x1 0x0 0x0 0x70 0x0 0x0 0x0 0x1 0x0 0x0 0x71 0x0 0x1 0x0 0x0 0x0 0x0 0x72 0x0 0x0 0x0 0x1 0x0 0x0 0x73 0x0 0x0 0x0 0x1 0x0 0x0 0x74 0x0 0x0 0x0 0x1 0x0 0x0 0x75 0x0 0x0 0x0 0x1 0x0 0x0 0x76 0x0 0x0 0x0 0x1 0x0 0x0 0x77 0x0 0x0 0x0 0x1 0x0 0x0 0x78 0x0 0x0 0x0 0x1 0x0 0x0 0x79 0x0 0x0 0x0 0x0 0x0 0x0 0x7a 0x1 0x0 0x0 0x1 0x1 0x1 0x7b 0x1 0x0 0x0 0x1 0x1 0x1 0x7c 0x1 0x1 0x0 0x0 0x0 0x1 0x7d 0x1 0x0 0x0 0x1 0x1 0x1 0x7e 0x1 0x0 0x0 0x1 0x1 0x1 0x7f 0x1 0x0 0x0 0x1 0x1 0x1 0x80 0x1 0x0 0x0 0x1 0x1 0x1 0x81 0x1 0x0 0x0 0x1 0x1 0x1 0x82 0x1 0x0 0x0 0x1 0x1 0x1 0x83 0x1 0x0 0x0 0x1 0x0 0x1 0x84 0x1 0x0 0x0 0x1 0x1 0x1 0x85 0x1 0x1 0x1 0x0 0x0 0x1 0x86 0x1 0x0 0x0 0x1 0x0 0x1 0x87 0x1 0x1 0x0 0x0 0x0 0x0 0x88 0x1 0x1 0x0 0x0 0x0 0x0 0x89 0x1 0x1 0x0 0x0 0x0 0x0 0x8a 0x1 0x1 0x0 0x0 0x0 0x0 0x8b 0x1 0x1 0x0 0x0 0x0 0x0 0x8c 0x1 0x0 0x0 0x1 0x0 0x0 0x8d 0x1 0x0 0x0 0x1 0x0 0x0 0x8e 0x1 0x0 0x0 0x1 0x0 0x0 0x8f 0x1 0x0 0x0 0x1 0x0 0x0 0x90 0x1 0x0 0x0 0x1 0x0 0x0 0x91 0x1 0x1 0x1 0x0 0x0 0x0 0x92 0x1 0x0 0x0 0x1 0x0 0x0 0x93 0x1 0x1 0x0 0x0 0x0 0x0 0x94 0x1 0x1 0x0 0x0 0x0 0x0 0x95 0x1 0x1 0x0 0x0 0x0 0x0 0x96 0x0 0x1 0x0 0x1 0x1 0x1 0x97 0x0 0x1 0x0 0x0 0x0 0x0 0x98 0x0 0x1 0x0 0x0 0x0 0x0 0x99 0x0 0x1 0x0 0x0 0x0 0x0 0x9a 0x0 0x1 0x0 0x0 0x0 0x0 0x9b 0x0 0x1 0x0 0x0 0x0 0x0 0x9c 0x0 0x1 0x0 0x0 0x0 0x0 0x9d 0x0 0x1 0x0 0x0 0x0 0x0 0x9e 0x1 0x0 0x0 0x1 0x0 0x0 0x9f 0x0 0x1 0x1 0x0 0x0 0x0 0xa0 0x0 0x0 0x0 0x1 0x0 0x0 0xa1 0x1 0x0 0x0 0x1 0x1 0x1 0xa2 0x1 0x0 0x0 0x1 0x1 0x1 0xa3 0x0 0x1 0x0 0x0 0x0 0x0 0xa4 0x0 0x0 0x0 0x0 0x0 0x0 0xa5 0x0 0x0 0x0 0x0 0x0 0x0 0xa6 0x0 0x1 0x0 0x1 0x0 0x0 0xa7 0x0 0x0 0x0 0x1 0x0 0x0 0xa8 0x0 0x0 0x0 0x1 0x0 0x0 0xa9 0x0 0x1 0x0 0x0 0x0 0x0 0xaa 0x0 0x1 0x0 0x0 0x0 0x0 0xab 0x0 0x0 0x0 0x1 0x1 0x0 0xac 0x0 0x0 0x0 0x1 0x1 0x0 0xad 0x0 0x0 0x0 0x1 0x1 0x0 0xae 0x0 0x0 0x0 0x1 0x1 0x0 0xaf 0x0 0x0 0x0 0x1 0x1 0x0 0xb0 0x0 0x0 0x0 0x1 0x1 0x0 0xb1 0x0 0x0 0x0 0x1 0x1 0x0 0xb2 0x0 0x1 0x0 0x0 0x0 0x0 0xb3 0x0 0x0 0x0 0x1 0x0 0x0>;
		};
	};

	fragment@58 {
		target = <0xffffffff>;

		__overlay__ {
			interrupt-parent = <0xffffffff>;
			interrupts = <0x0 0x2 0x0 0x0>;
			status = "okay";
		};
	};

	fragment@59 {
		target = <0xffffffff>;

		__overlay__ {
			interrupt-parent = <0xffffffff>;
			interrupts = <0x1 0x2 0x1 0x0>;
			status = "okay";
		};
	};

	fragment@6 {
		target = <0xffffffff>;

		__overlay__ {

			aw87xxx_pa_58@58 {
				compatible = "awinic,aw87xxx_pa";
				monitor-flag = <0x1>;
				monitor-timer-count-max = <0x5>;
				monitor-timer-val = <0xbb8>;
				pa-channel = <0x0>;
				reg = <0x58>;
				reset-gpio = <0xffffffff 0xad 0x0>;
				status = "okay";
			};

			ext_buck_lp4@57 {
				regulator-max-microvolt = <0x13d620>;
				regulator-min-microvolt = <0x493e0>;
				regulator-name = "ext_buck_vdd2";
				vsel_pin = <0x0>;
			};

			ext_buck_lp4x@50 {
				regulator-max-microvolt = <0x13d620>;
				regulator-min-microvolt = <0x493e0>;
				regulator-name = "ext_buck_vddq";
				vsel_pin = <0x1>;
			};
		};
	};

	fragment@60 {
		target = <0xffffffff>;

		__overlay__ {
			deb-gpios = <0xffffffff 0x2 0x0>;
			debounce = <0x7d000>;
			interrupt-parent = <0xffffffff>;
			interrupts = <0x2 0x8 0x2 0x0>;
			status = "okay";
		};
	};

	fragment@61 {
		target = <0xffffffff>;

		__overlay__ {
			deb-gpios = <0xffffffff 0x4 0x0>;
			deb-rgpios = <0xffffffff 0x3 0x0>;
			debounce = <0x3e800>;
			debounce1 = <0x3e800>;
			interrupt-parent = <0xffffffff>;
			interrupts = <0x4 0x8 0x3 0x8>;
			status = "okay";
		};
	};

	fragment@62 {
		target = <0xffffffff>;

		__overlay__ {
			interrupt-parent = <0xffffffff>;
			interrupts = <0xa 0x4 0xa 0x0>;
			status = "okay";
		};
	};

	fragment@63 {
		target = <0xffffffff>;

		__overlay__ {
			interrupt-parent = <0xffffffff>;
			interrupts = <0xb 0x2 0xb 0x0>;
			status = "okay";
		};
	};

	fragment@64 {
		target = <0xffffffff>;

		__overlay__ {
			interrupt-parent = <0xffffffff>;
			interrupts = <0x29 0x8 0x29 0x0>;
			mtk,otg_chip_compatible_mode;
			pinctrl-0 = <0x59>;
			pinctrl-1 = <0x5a>;
			pinctrl-10 = <0x63>;
			pinctrl-11 = <0x64>;
			pinctrl-12 = <0x65>;
			pinctrl-2 = <0x5b>;
			pinctrl-3 = <0x5c>;
			pinctrl-4 = <0x5d>;
			pinctrl-5 = <0x5e>;
			pinctrl-6 = <0x5f>;
			pinctrl-7 = <0x60>;
			pinctrl-8 = <0x61>;
			pinctrl-9 = <0x62>;
			pinctrl-names = "iddig_default", "iddig_otg_gpio", "iddig_otg_gpio_pull_down", "otg_gpio_pull_high", "otg_gpio_pull_low", "otg_gpio_pull_in", "otg_gpio_pull1_high", "otg_gpio_pull1_low", "otg_gpio_pull1_in", "iddig_otg_init", "otg_gpio167_pull_high", "otg_gpio167_pull_low", "otg_gpio167_pull_in";
			platform-id = <0xffffffff 0xab 0x1>;
			status = "okay";
			usbid-num = <0xffffffff 0x29 0x1>;
			usbid2-num = <0xffffffff 0xa7 0x1>;
		};
	};

	fragment@65 {
		target = <0xffffffff>;

		__overlay__ {
			compatible = "mediatek,phy_tuning";
			status = "okay";
			u2_enhance = <0x3>;
			u2_enhance_host = <0x2>;
			u2_hstx_srctrl = <0x4>;
			u2_hstx_srctrl_host = <0x4>;
			u2_term_ref = <0x7>;
			u2_term_ref_host = <0x3>;
			u2_vrt_ref = <0x7>;
			u2_vrt_ref_host = <0x4>;
		};
	};

	fragment@66 {
		target = <0xffffffff>;

		__overlay__ {
			compatible = "vivo,battery_id";
			io-channel-names = "battery_id_adc";
			io-channels = <0xffffffff 0x2>;
			status = "okay";
			vivo,bat-name = "B-S2 ATL 5000", "B-S1 LW 5000", "B-S2 ATL 5000", "B-S3 ATL 5000", "UNKNOWN";
		};
	};

	fragment@67 {
		target = <0xffffffff>;

		__overlay__ {
			compatible = "vivo,battery";
			io-channel-names = "primary_board_therm", "parallel_board_therm", "usb_conn_therm";
			io-channels = <0xffffffff 0x0 0xffffffff 0x1 0xffffffff 0x4>;
			status = "okay";
			vivo,full-sync-cumulative = <0x3>;
			vivo,low-volt-threshold = <0xd48>;
			vivo,percnet-sync-cumulative = <0x9>;
			vivo,percnet-sync-delta = <0x8>;
			vivo,soft-rise-cumulative = <0xa>;
			vivo,soft-rise-keep-cumulative = <0xe>;
			vivo,soft-rise-percent = <0x5c>;
			vivo,soft-term-cumulative = <0x30>;
			vivo,soft-term-percent = <0x63>;
		};
	};

	fragment@68 {
		target = <0xffffffff>;

		__overlay__ {
			compatible = "vivo,charge";
			status = "okay";
			vivo,battery-id-vreg-mv = <0x114e 0x114e 0x114e 0x114e 0x114e 0x114e>;
			vivo,boostv-ilimit-ma = <0x5dc>;
			vivo,boostv-voltage-mv = <0x141e>;
			vivo,charge-scheme = <0x0>;
			vivo,chg-wdt-s = <0x28>;
			vivo,direct-charger-enable;
			vivo,fastchg-spec-ma = <0x7d0 0x834 0xed8>;
			vivo,ffc-full-ibat-table = <0x96 0x15d 0xfffffc2c 0x15e 0x1c1 0xfffffb68>;
			vivo,ffc-full-ibat-table-size = <0x2>;
			vivo,ffc-full-vbat-table = <0x1180 0x118a 0x116c>;
			vivo,ffc-full-vbat-table-size = <0x3>;
			vivo,ffc-iterm-ma = <0xfffffd12>;
			vivo,ffc-temperature-range = <0x96 0x1c2>;
			vivo,ffc-vreg-mv = <0x1194>;
			vivo,flashchg-spec-ma = <0x7d0 0xce4 0x1770>;
			vivo,iprechg-current-ma = <0x12c>;
			vivo,iterm-current-ma_1 = <0x12c>;
			vivo,iterm-current-ma_2 = <0x12c>;
			vivo,normalchg-spec-ma = <0x7d0 0x5dc 0x8fc>;
			vivo,ovp-voltage-mv = <0x3a98>;
			vivo,parallel-ichg-max-ma = <0x690>;
			vivo,prechg-voltage-mv = <0xbb8>;
			vivo,primary-ichg-max-ma = <0x8c0>;
			vivo,re-chg-voltage-mv = <0x64>;
			vivo,supported-adapter = <0x0>;
			vivo,sys-voltage-min-mv = <0xce4>;
			vivo,usboe-gpio = <0xffffffff 0xa3 0x0>;
			vivo,usbsel-gpio = <0xffffffff 0x2 0x0>;
			vivo,vbus-detect-source = <0x0>;
			vivo,vindpm-voltage-mv = <0x11f8>;
			vivo,vreg-voltage-mv = <0x1150>;
		};
	};

	fragment@69 {
		target = <0xffffffff>;

		__overlay__ {
			compatible = "vivo,meter";
			status = "okay";
			vivo,bats-qmax = <0x1222 0x1280 0x1335 0x139e 0x13a1 0x1209 0x126e 0x1318 0x1395 0x13b9 0x1162 0x11e8 0x1219 0x12bf 0x12d0 0x1068 0x111c 0x11a8 0x12de 0x1310 0x992 0xbe4 0xc1c 0xc8e 0xcc4 0x992 0xbe4 0xc1c 0xc8e 0xcc4>;
			vivo,battery-aging-support = <0x2>;
			vivo,capacity-mAh = <0x132e>;
			vivo,car-tune-adjust-size = <0x3>;
			vivo,car-tune-adjust-table = <0x0 0xa 0x168 0x6 0xb 0x14 0xffffffdd 0x7 0x15 0x64 0xffffffd3 0x8>;
			vivo,car-tune-value = <0x3db 0x3e8 0x406 0x3e8 0x3e3 0x41a 0x3f2 0x3e8 0x3c0 0x3e8 0x3d4 0x3e8 0x3e8 0x3e8 0x41a 0x3e8 0x3e8 0x3e8 0x3e8 0x3e8 0x3e8 0x3e8 0x3e8 0x3e8>;
			vivo,car-volt-delta = <0x8>;
			vivo,load-capacity-delta-max = <0x3c>;
			vivo,meter-res-compesate = <0xa>;
			vivo,ocv-board-compesate = <0x0>;
			vivo,poweron-delta-capacity = <0x14>;
			vivo,poweron-low-capacity = <0x3>;
			vivo,volt-car-delta = <0xa>;
			vivo_battery0_profile_t0 = <0x0 0x1127 0xec 0x1 0x1112 0xec 0x2 0x1103 0xec 0x3 0x10f5 0xec 0x4 0x10e8 0xeb 0x5 0x10dc 0xea 0x6 0x10cf 0xea 0x7 0x10c3 0xe9 0x8 0x10b6 0xe8 0x9 0x10b0 0xe8 0xa 0x10aa 0xe7 0xb 0x109d 0xe6 0xc 0x1091 0xe6 0xd 0x1084 0xe4 0xe 0x1078 0xe4 0xf 0x106b 0xe2 0x10 0x105f 0xe2 0x11 0x1054 0xe2 0x12 0x1047 0xe0 0x13 0x103c 0xe1 0x14 0x1030 0xe0 0x15 0x1025 0xdf 0x16 0x1019 0xe0 0x17 0x100e 0xdf 0x18 0x1003 0xdf 0x19 0xff8 0xdf 0x1a 0xfee 0xdf 0x1b 0xfe8 0xdf 0x1c 0xfe3 0xde 0x1d 0xfd8 0xdf 0x1e 0xfcd 0xde 0x1f 0xfc1 0xdf 0x20 0xfb6 0xdf 0x21 0xfab 0xe0 0x22 0xfa1 0xe1 0x23 0xf97 0xe1 0x24 0xf8d 0xe2 0x25 0xf84 0xe3 0x26 0xf7c 0xe3 0x27 0xf72 0xe5 0x28 0xf69 0xe5 0x29 0xf5e 0xe6 0x2a 0xf54 0xe8 0x2b 0xf4a 0xe9 0x2c 0xf3f 0xea 0x2d 0xf3a 0xea 0x2e 0xf35 0xeb 0x2f 0xf2c 0xed 0x30 0xf22 0xee 0x31 0xf1a 0xef 0x32 0xf13 0xf1 0x33 0xf0c 0xf3 0x34 0xf06 0xf5 0x35 0xf00 0xf7 0x36 0xefa 0xfa 0x37 0xef5 0xfc 0x38 0xef1 0xfe 0x39 0xeec 0x101 0x3a 0xee8 0x104 0x3b 0xee4 0x105 0x3c 0xee0 0x10a 0x3d 0xedc 0x10c 0x3e 0xed9 0x10e 0x3f 0xed6 0x112 0x40 0xed4 0x114 0x41 0xed3 0x116 0x42 0xed0 0x119 0x43 0xece 0x11b 0x44 0xecd 0x11e 0x45 0xecb 0x121 0x46 0xeca 0x122 0x47 0xec9 0x125 0x48 0xec7 0x128 0x49 0xec6 0x12a 0x4a 0xec4 0x12d 0x4b 0xec3 0x130 0x4c 0xec1 0x132 0x4d 0xebf 0x136 0x4e 0xebd 0x139 0x4f 0xeba 0x13d 0x50 0xeb7 0x13f 0x51 0xeb3 0x144 0x52 0xeb1 0x146 0x53 0xeaf 0x148 0x54 0xeab 0x14e 0x55 0xea5 0x152 0x56 0xe9f 0x157 0x57 0xe99 0x15d 0x58 0xe91 0x162 0x59 0xe8a 0x169 0x5a 0xe82 0x170 0x5b 0xe7a 0x179 0x5c 0xe70 0x182 0x5d 0xe68 0x18d 0x5e 0xe61 0x19a 0x5f 0xe5b 0x1a8 0x60 0xe53 0x1bb 0x61 0xe43 0x1f8 0x62 0xcac 0x1ba 0x63 0xc83 0x1ab 0x64 0xc80 0x1aa>;
			vivo_battery0_profile_t0_num = <0x65>;
			vivo_battery0_profile_t1 = <0x0 0x1127 0x7a 0x1 0x1112 0x7a 0x2 0x1103 0x7a 0x3 0x10f6 0x7b 0x4 0x10e9 0x7c 0x5 0x10dd 0x7c 0x6 0x10d0 0x7c 0x7 0x10c4 0x7c 0x8 0x10b7 0x7b 0x9 0x10b0 0x7b 0xa 0x10ab 0x7c 0xb 0x109e 0x7b 0xc 0x1091 0x7b 0xd 0x1085 0x7a 0xe 0x1079 0x7b 0xf 0x106c 0x7a 0x10 0x1060 0x7a 0x11 0x1054 0x7a 0x12 0x1048 0x7a 0x13 0x103c 0x79 0x14 0x1031 0x7a 0x15 0x1025 0x7a 0x16 0x101a 0x7a 0x17 0x100f 0x7a 0x18 0x1004 0x7a 0x19 0xff9 0x7a 0x1a 0xfef 0x7a 0x1b 0xfe8 0x7a 0x1c 0xfe4 0x79 0x1d 0xfda 0x7a 0x1e 0xfcf 0x7a 0x1f 0xfc4 0x7b 0x20 0xfba 0x7b 0x21 0xfaf 0x7b 0x22 0xfa6 0x7c 0x23 0xf9c 0x7c 0x24 0xf94 0x7c 0x25 0xf8c 0x7c 0x26 0xf84 0x7d 0x27 0xf7b 0x7d 0x28 0xf73 0x7e 0x29 0xf6a 0x7e 0x2a 0xf61 0x7e 0x2b 0xf56 0x7f 0x2c 0xf4b 0x7f 0x2d 0xf45 0x80 0x2e 0xf3f 0x80 0x2f 0xf33 0x80 0x30 0xf29 0x80 0x31 0xf20 0x82 0x32 0xf17 0x82 0x33 0xf10 0x83 0x34 0xf0a 0x82 0x35 0xf04 0x84 0x36 0xeff 0x85 0x37 0xef9 0x85 0x38 0xef4 0x85 0x39 0xef0 0x87 0x3a 0xeec 0x88 0x3b 0xee8 0x8a 0x3c 0xee4 0x8b 0x3d 0xee0 0x8c 0x3e 0xedc 0x8d 0x3f 0xed9 0x8e 0x40 0xed8 0x8e 0x41 0xed6 0x8f 0x42 0xed3 0x90 0x43 0xed0 0x92 0x44 0xece 0x93 0x45 0xecc 0x95 0x46 0xeca 0x97 0x47 0xec8 0x98 0x48 0xec7 0x99 0x49 0xec6 0x9a 0x4a 0xec5 0x9b 0x4b 0xec4 0x9b 0x4c 0xec3 0x9d 0x4d 0xec1 0x9e 0x4e 0xebf 0x9f 0x4f 0xebd 0xa0 0x50 0xeb9 0xa2 0x51 0xeb5 0xa3 0x52 0xeb3 0xa3 0x53 0xeb0 0xa4 0x54 0xeac 0xa6 0x55 0xea7 0xa7 0x56 0xea2 0xa8 0x57 0xe9c 0xaa 0x58 0xe95 0xab 0x59 0xe8e 0xae 0x5a 0xe87 0xb0 0x5b 0xe7f 0xb4 0x5c 0xe75 0xb8 0x5d 0xe6c 0xbb 0x5e 0xe67 0xc1 0x5f 0xe62 0xcb 0x60 0xe5c 0xd8 0x61 0xe54 0xed 0x62 0xe48 0x110 0x63 0xe20 0x195 0x64 0xc74 0x126>;
			vivo_battery0_profile_t1_num = <0x65>;
			vivo_battery0_profile_t2 = <0x0 0x1133 0x53 0x1 0x111f 0x54 0x2 0x110f 0x54 0x3 0x1102 0x54 0x4 0x10f6 0x54 0x5 0x10e9 0x54 0x6 0x10dd 0x54 0x7 0x10d1 0x54 0x8 0x10c4 0x53 0x9 0x10b8 0x54 0xa 0x10ac 0x54 0xb 0x109f 0x53 0xc 0x1093 0x54 0xd 0x1086 0x54 0xe 0x107a 0x54 0xf 0x106e 0x54 0x10 0x1062 0x54 0x11 0x1055 0x53 0x12 0x104a 0x53 0x13 0x103e 0x54 0x14 0x1032 0x53 0x15 0x1027 0x53 0x16 0x101b 0x53 0x17 0x1010 0x53 0x18 0x1005 0x53 0x19 0xffa 0x54 0x1a 0xff5 0x54 0x1b 0xff0 0x54 0x1c 0xfe5 0x54 0x1d 0xfdc 0x54 0x1e 0xfd1 0x54 0x1f 0xfc7 0x54 0x20 0xfbc 0x54 0x21 0xfb2 0x54 0x22 0xfa9 0x54 0x23 0xfa0 0x54 0x24 0xf98 0x54 0x25 0xf8f 0x55 0x26 0xf87 0x56 0x27 0xf7f 0x55 0x28 0xf77 0x56 0x29 0xf6f 0x55 0x2a 0xf67 0x55 0x2b 0xf5e 0x56 0x2c 0xf54 0x56 0x2d 0xf49 0x57 0x2e 0xf3b 0x57 0x2f 0xf2f 0x56 0x30 0xf24 0x56 0x31 0xf1c 0x57 0x32 0xf14 0x57 0x33 0xf0e 0x57 0x34 0xf08 0x57 0x35 0xf03 0x58 0x36 0xefe 0x58 0x37 0xef9 0x58 0x38 0xef4 0x59 0x39 0xef0 0x59 0x3a 0xeec 0x59 0x3b 0xee8 0x5a 0x3c 0xee4 0x5a 0x3d 0xee0 0x5b 0x3e 0xedd 0x5b 0x3f 0xeda 0x5c 0x40 0xed7 0x5c 0x41 0xed4 0x5d 0x42 0xed1 0x5d 0x43 0xecf 0x5d 0x44 0xecd 0x5f 0x45 0xeca 0x5e 0x46 0xec8 0x5f 0x47 0xec7 0x60 0x48 0xec5 0x60 0x49 0xec4 0x61 0x4a 0xec2 0x61 0x4b 0xec0 0x61 0x4c 0xebe 0x62 0x4d 0xebc 0x63 0x4e 0xeb8 0x63 0x4f 0xeb6 0x63 0x50 0xeb3 0x63 0x51 0xeae 0x63 0x52 0xeab 0x64 0x53 0xea8 0x64 0x54 0xea4 0x65 0x55 0xe9e 0x64 0x56 0xe98 0x65 0x57 0xe91 0x65 0x58 0xe8b 0x66 0x59 0xe84 0x66 0x5a 0xe7b 0x67 0x5b 0xe73 0x68 0x5c 0xe6f 0x69 0x5d 0xe6c 0x69 0x5e 0xe6a 0x6a 0x5f 0xe66 0x6c 0x60 0xe61 0x6f 0x61 0xe58 0x75 0x62 0xe40 0x83 0x63 0xe05 0xab 0x64 0xd78 0x17e>;
			vivo_battery0_profile_t2_num = <0x65>;
			vivo_battery0_profile_t3 = <0x0 0x113e 0x3e 0x1 0x1126 0x3e 0x2 0x1114 0x3e 0x3 0x1105 0x3e 0x4 0x10f8 0x3e 0x5 0x10eb 0x3e 0x6 0x10de 0x3e 0x7 0x10d2 0x3e 0x8 0x10c6 0x3e 0x9 0x10b9 0x3e 0xa 0x10ad 0x3e 0xb 0x10a0 0x3e 0xc 0x1094 0x3e 0xd 0x1088 0x3e 0xe 0x107c 0x3e 0xf 0x1070 0x3f 0x10 0x1063 0x3d 0x11 0x1057 0x3e 0x12 0x104b 0x3e 0x13 0x103f 0x3e 0x14 0x1034 0x3e 0x15 0x1028 0x3e 0x16 0x101d 0x3e 0x17 0x1012 0x3e 0x18 0x1007 0x3e 0x19 0xffc 0x3e 0x1a 0xff1 0x3e 0x1b 0xfe6 0x3e 0x1c 0xfdc 0x3e 0x1d 0xfd2 0x3e 0x1e 0xfc8 0x3e 0x1f 0xfbe 0x3e 0x20 0xfb5 0x3e 0x21 0xfac 0x3e 0x22 0xfa2 0x3e 0x23 0xf9a 0x3e 0x24 0xf91 0x3e 0x25 0xf89 0x3e 0x26 0xf81 0x3e 0x27 0xf7a 0x3e 0x28 0xf72 0x3e 0x29 0xf6a 0x3e 0x2a 0xf63 0x3e 0x2b 0xf5b 0x3f 0x2c 0xf53 0x3f 0x2d 0xf49 0x3e 0x2e 0xf3b 0x3f 0x2f 0xf2c 0x40 0x30 0xf21 0x3e 0x31 0xf19 0x3e 0x32 0xf12 0x3e 0x33 0xf0c 0x3e 0x34 0xf07 0x3f 0x35 0xf02 0x3f 0x36 0xefd 0x3e 0x37 0xef8 0x3e 0x38 0xef4 0x3e 0x39 0xef0 0x40 0x3a 0xeec 0x40 0x3b 0xee8 0x3f 0x3c 0xee5 0x40 0x3d 0xee1 0x40 0x3e 0xede 0x3f 0x3f 0xedb 0x40 0x40 0xed8 0x40 0x41 0xed6 0x40 0x42 0xed3 0x3f 0x43 0xed1 0x40 0x44 0xece 0x40 0x45 0xecc 0x40 0x46 0xeca 0x40 0x47 0xec8 0x41 0x48 0xec6 0x41 0x49 0xec4 0x41 0x4a 0xec0 0x41 0x4b 0xebc 0x41 0x4c 0xeb8 0x41 0x4d 0xeb5 0x41 0x4e 0xeb1 0x41 0x4f 0xead 0x41 0x50 0xea9 0x41 0x51 0xea6 0x42 0x52 0xea2 0x41 0x53 0xe9e 0x41 0x54 0xe99 0x41 0x55 0xe93 0x41 0x56 0xe8c 0x42 0x57 0xe86 0x41 0x58 0xe80 0x41 0x59 0xe77 0x41 0x5a 0xe70 0x41 0x5b 0xe6e 0x42 0x5c 0xe6d 0x42 0x5d 0xe6b 0x42 0x5e 0xe69 0x42 0x5f 0xe66 0x43 0x60 0xe5f 0x42 0x61 0xe44 0x45 0x62 0xe12 0x44 0x63 0xdcf 0x47 0x64 0xd6d 0x4a>;
			vivo_battery0_profile_t3_num = <0x65>;
			vivo_battery0_profile_t4 = <0x0 0x113f 0x3a 0x1 0x1125 0x39 0x2 0x1112 0x39 0x3 0x1102 0x3a 0x4 0x10f3 0x39 0x5 0x10e6 0x39 0x6 0x10d9 0x39 0x7 0x10cd 0x39 0x8 0x10c0 0x39 0x9 0x10b4 0x3a 0xa 0x10a7 0x3a 0xb 0x109b 0x39 0xc 0x108f 0x3a 0xd 0x1082 0x39 0xe 0x1076 0x39 0xf 0x106a 0x3a 0x10 0x105e 0x3a 0x11 0x1052 0x3a 0x12 0x1046 0x3a 0x13 0x103a 0x3a 0x14 0x102f 0x3a 0x15 0x1023 0x3a 0x16 0x1018 0x3a 0x17 0x100d 0x3a 0x18 0x1001 0x3a 0x19 0xff6 0x3a 0x1a 0xfec 0x3a 0x1b 0xfe1 0x3b 0x1c 0xfd7 0x3a 0x1d 0xfcd 0x3a 0x1e 0xfc3 0x3a 0x1f 0xfb9 0x3b 0x20 0xfb0 0x3b 0x21 0xfa7 0x3a 0x22 0xf9e 0x3b 0x23 0xf95 0x3b 0x24 0xf8c 0x3a 0x25 0xf84 0x3b 0x26 0xf7c 0x3a 0x27 0xf74 0x3a 0x28 0xf6d 0x3a 0x29 0xf65 0x3a 0x2a 0xf5e 0x3a 0x2b 0xf57 0x3a 0x2c 0xf4e 0x3b 0x2d 0xf41 0x3b 0x2e 0xf30 0x3b 0x2f 0xf25 0x3a 0x30 0xf1d 0x3b 0x31 0xf16 0x3a 0x32 0xf10 0x3b 0x33 0xf0a 0x3b 0x34 0xf05 0x3a 0x35 0xeff 0x3a 0x36 0xefb 0x3b 0x37 0xef6 0x3a 0x38 0xef2 0x3b 0x39 0xeed 0x3a 0x3a 0xee9 0x3a 0x3b 0xee5 0x3a 0x3c 0xee3 0x3a 0x3d 0xee2 0x3b 0x3e 0xede 0x3a 0x3f 0xedb 0x3b 0x40 0xed8 0x3b 0x41 0xed5 0x3a 0x42 0xed2 0x3b 0x43 0xecf 0x3b 0x44 0xecd 0x3a 0x45 0xeca 0x3b 0x46 0xec8 0x3b 0x47 0xec6 0x3b 0x48 0xec3 0x3b 0x49 0xebe 0x3b 0x4a 0xeb5 0x3b 0x4b 0xead 0x3b 0x4c 0xeaa 0x3c 0x4d 0xea6 0x3b 0x4e 0xea1 0x3b 0x4f 0xe9d 0x3c 0x50 0xe99 0x3b 0x51 0xe95 0x3c 0x52 0xe92 0x3b 0x53 0xe8f 0x3c 0x54 0xe8a 0x3b 0x55 0xe84 0x3b 0x56 0xe7d 0x3c 0x57 0xe77 0x3b 0x58 0xe71 0x3b 0x59 0xe68 0x3c 0x5a 0xe62 0x3b 0x5b 0xe60 0x3b 0x5c 0xe5f 0x3c 0x5d 0xe5e 0x3b 0x5e 0xe5c 0x3c 0x5f 0xe59 0x3c 0x60 0xe4f 0x3c 0x61 0xe2f 0x3d 0x62 0xdfd 0x3c 0x63 0xdbd 0x3f 0x64 0xd62 0x40>;
			vivo_battery0_profile_t4_num = <0x65>;
			vivo_battery1_profile_t0 = <0x0 0x1127 0xec 0x1 0x1112 0xec 0x2 0x1103 0xec 0x3 0x10f5 0xec 0x4 0x10e8 0xeb 0x5 0x10dc 0xea 0x6 0x10cf 0xea 0x7 0x10c3 0xe9 0x8 0x10b6 0xe8 0x9 0x10b0 0xe8 0xa 0x10aa 0xe7 0xb 0x109d 0xe6 0xc 0x1091 0xe6 0xd 0x1084 0xe4 0xe 0x1078 0xe4 0xf 0x106b 0xe2 0x10 0x105f 0xe2 0x11 0x1054 0xe2 0x12 0x1047 0xe0 0x13 0x103c 0xe1 0x14 0x1030 0xe0 0x15 0x1025 0xdf 0x16 0x1019 0xe0 0x17 0x100e 0xdf 0x18 0x1003 0xdf 0x19 0xff8 0xdf 0x1a 0xfee 0xdf 0x1b 0xfe9 0xdf 0x1c 0xfe3 0xde 0x1d 0xfd8 0xdf 0x1e 0xfcd 0xde 0x1f 0xfc1 0xdf 0x20 0xfb6 0xdf 0x21 0xfab 0xe0 0x22 0xfa1 0xe1 0x23 0xf97 0xe1 0x24 0xf8d 0xe2 0x25 0xf84 0xe3 0x26 0xf7c 0xe3 0x27 0xf72 0xe5 0x28 0xf69 0xe5 0x29 0xf5e 0xe6 0x2a 0xf54 0xe8 0x2b 0xf4a 0xe9 0x2c 0xf3f 0xea 0x2d 0xf3a 0xea 0x2e 0xf35 0xeb 0x2f 0xf2c 0xed 0x30 0xf22 0xee 0x31 0xf1a 0xef 0x32 0xf13 0xf1 0x33 0xf0c 0xf3 0x34 0xf06 0xf5 0x35 0xf00 0xf7 0x36 0xefa 0xfa 0x37 0xef5 0xfc 0x38 0xef1 0xfe 0x39 0xeec 0x101 0x3a 0xee8 0x104 0x3b 0xee4 0x105 0x3c 0xee0 0x10a 0x3d 0xedc 0x10c 0x3e 0xed9 0x10e 0x3f 0xed6 0x112 0x40 0xed4 0x114 0x41 0xed3 0x116 0x42 0xed0 0x119 0x43 0xece 0x11b 0x44 0xecd 0x11e 0x45 0xecb 0x121 0x46 0xeca 0x122 0x47 0xec9 0x125 0x48 0xec7 0x128 0x49 0xec6 0x12a 0x4a 0xec4 0x12d 0x4b 0xec3 0x130 0x4c 0xec1 0x132 0x4d 0xebf 0x136 0x4e 0xebd 0x139 0x4f 0xeba 0x13d 0x50 0xeb7 0x13f 0x51 0xeb3 0x144 0x52 0xeb1 0x146 0x53 0xeaf 0x148 0x54 0xeab 0x14e 0x55 0xea5 0x152 0x56 0xe9f 0x157 0x57 0xe99 0x15d 0x58 0xe91 0x162 0x59 0xe8a 0x169 0x5a 0xe82 0x170 0x5b 0xe7a 0x179 0x5c 0xe70 0x182 0x5d 0xe68 0x18d 0x5e 0xe61 0x19a 0x5f 0xe5b 0x1a8 0x60 0xe53 0x1bb 0x61 0xe43 0x1f8 0x62 0xcac 0x1ba 0x63 0xc83 0x1ab 0x64 0xc80 0x1aa>;
			vivo_battery1_profile_t0_num = <0x65>;
			vivo_battery1_profile_t1 = <0x0 0x1127 0x7a 0x1 0x1112 0x7a 0x2 0x1103 0x7a 0x3 0x10f6 0x7b 0x4 0x10e9 0x7c 0x5 0x10dd 0x7c 0x6 0x10d0 0x7c 0x7 0x10c4 0x7c 0x8 0x10b7 0x7b 0x9 0x10b1 0x7b 0xa 0x10ab 0x7c 0xb 0x109e 0x7b 0xc 0x1091 0x7b 0xd 0x1085 0x7a 0xe 0x1079 0x7b 0xf 0x106c 0x7a 0x10 0x1060 0x7a 0x11 0x1054 0x7a 0x12 0x1048 0x7a 0x13 0x103c 0x79 0x14 0x1031 0x7a 0x15 0x1025 0x7a 0x16 0x101a 0x7a 0x17 0x100f 0x7a 0x18 0x1004 0x7a 0x19 0xff9 0x7a 0x1a 0xfef 0x7a 0x1b 0xfe9 0x7a 0x1c 0xfe4 0x79 0x1d 0xfda 0x7a 0x1e 0xfcf 0x7a 0x1f 0xfc4 0x7b 0x20 0xfba 0x7b 0x21 0xfaf 0x7b 0x22 0xfa6 0x7c 0x23 0xf9c 0x7c 0x24 0xf94 0x7c 0x25 0xf8c 0x7c 0x26 0xf84 0x7d 0x27 0xf7b 0x7d 0x28 0xf73 0x7e 0x29 0xf6a 0x7e 0x2a 0xf61 0x7e 0x2b 0xf56 0x7f 0x2c 0xf4b 0x7f 0x2d 0xf45 0x7f 0x2e 0xf3f 0x80 0x2f 0xf33 0x80 0x30 0xf29 0x80 0x31 0xf20 0x82 0x32 0xf17 0x82 0x33 0xf10 0x83 0x34 0xf0a 0x82 0x35 0xf04 0x84 0x36 0xeff 0x85 0x37 0xef9 0x85 0x38 0xef4 0x85 0x39 0xef0 0x87 0x3a 0xeec 0x88 0x3b 0xee8 0x8a 0x3c 0xee4 0x8b 0x3d 0xee0 0x8c 0x3e 0xedc 0x8d 0x3f 0xed9 0x8e 0x40 0xed7 0x8e 0x41 0xed6 0x8f 0x42 0xed3 0x90 0x43 0xed0 0x92 0x44 0xece 0x93 0x45 0xecc 0x95 0x46 0xeca 0x97 0x47 0xec8 0x98 0x48 0xec7 0x99 0x49 0xec6 0x9a 0x4a 0xec5 0x9b 0x4b 0xec4 0x9b 0x4c 0xec3 0x9d 0x4d 0xec1 0x9e 0x4e 0xebf 0x9f 0x4f 0xebd 0xa0 0x50 0xeb9 0xa2 0x51 0xeb5 0xa3 0x52 0xeb3 0xa3 0x53 0xeb0 0xa4 0x54 0xeac 0xa6 0x55 0xea7 0xa7 0x56 0xea2 0xa8 0x57 0xe9c 0xaa 0x58 0xe95 0xab 0x59 0xe8e 0xae 0x5a 0xe87 0xb0 0x5b 0xe7f 0xb4 0x5c 0xe75 0xb8 0x5d 0xe6c 0xbb 0x5e 0xe67 0xc1 0x5f 0xe62 0xcb 0x60 0xe5c 0xd8 0x61 0xe54 0xed 0x62 0xe48 0x110 0x63 0xe20 0x195 0x64 0xe10 0x190>;
			vivo_battery1_profile_t1_num = <0x65>;
			vivo_battery1_profile_t2 = <0x0 0x1133 0x53 0x1 0x111f 0x54 0x2 0x110f 0x54 0x3 0x1102 0x54 0x4 0x10f6 0x54 0x5 0x10e9 0x54 0x6 0x10dd 0x54 0x7 0x10d1 0x54 0x8 0x10c4 0x53 0x9 0x10b8 0x54 0xa 0x10ac 0x54 0xb 0x109f 0x53 0xc 0x1093 0x54 0xd 0x1086 0x54 0xe 0x107a 0x54 0xf 0x106e 0x54 0x10 0x1062 0x54 0x11 0x1055 0x53 0x12 0x104a 0x53 0x13 0x103e 0x54 0x14 0x1032 0x53 0x15 0x1027 0x53 0x16 0x101b 0x53 0x17 0x1010 0x53 0x18 0x1005 0x53 0x19 0xffa 0x54 0x1a 0xff5 0x54 0x1b 0xff0 0x54 0x1c 0xfe5 0x54 0x1d 0xfdc 0x54 0x1e 0xfd1 0x54 0x1f 0xfc7 0x54 0x20 0xfbc 0x54 0x21 0xfb2 0x54 0x22 0xfa9 0x54 0x23 0xfa0 0x54 0x24 0xf98 0x54 0x25 0xf8f 0x55 0x26 0xf87 0x56 0x27 0xf7f 0x55 0x28 0xf77 0x56 0x29 0xf6f 0x55 0x2a 0xf67 0x55 0x2b 0xf5e 0x56 0x2c 0xf54 0x56 0x2d 0xf49 0x57 0x2e 0xf3b 0x57 0x2f 0xf2f 0x56 0x30 0xf24 0x56 0x31 0xf1c 0x57 0x32 0xf14 0x57 0x33 0xf0e 0x57 0x34 0xf08 0x57 0x35 0xf03 0x58 0x36 0xefe 0x58 0x37 0xef9 0x58 0x38 0xef4 0x59 0x39 0xef0 0x59 0x3a 0xeec 0x59 0x3b 0xee8 0x5a 0x3c 0xee4 0x5a 0x3d 0xee0 0x5b 0x3e 0xedd 0x5b 0x3f 0xeda 0x5c 0x40 0xed7 0x5c 0x41 0xed4 0x5d 0x42 0xed1 0x5d 0x43 0xecf 0x5d 0x44 0xecd 0x5f 0x45 0xeca 0x5e 0x46 0xec8 0x5f 0x47 0xec7 0x60 0x48 0xec5 0x60 0x49 0xec4 0x61 0x4a 0xec2 0x61 0x4b 0xec0 0x61 0x4c 0xebe 0x62 0x4d 0xebc 0x63 0x4e 0xeb8 0x63 0x4f 0xeb5 0x63 0x50 0xeb3 0x63 0x51 0xeae 0x63 0x52 0xeab 0x64 0x53 0xea8 0x64 0x54 0xea4 0x65 0x55 0xe9e 0x64 0x56 0xe98 0x65 0x57 0xe91 0x65 0x58 0xe8b 0x66 0x59 0xe84 0x66 0x5a 0xe7b 0x67 0x5b 0xe73 0x68 0x5c 0xe6f 0x69 0x5d 0xe6c 0x69 0x5e 0xe6a 0x6a 0x5f 0xe66 0x6c 0x60 0xe61 0x6f 0x61 0xe58 0x75 0x62 0xe40 0x83 0x63 0xe05 0xab 0x64 0xd78 0x17e>;
			vivo_battery1_profile_t2_num = <0x65>;
			vivo_battery1_profile_t3 = <0x0 0x113e 0x3e 0x1 0x1126 0x3e 0x2 0x1114 0x3e 0x3 0x1105 0x3e 0x4 0x10f8 0x3e 0x5 0x10eb 0x3e 0x6 0x10de 0x3e 0x7 0x10d2 0x3e 0x8 0x10c6 0x3e 0x9 0x10b9 0x3e 0xa 0x10ad 0x3e 0xb 0x10a0 0x3e 0xc 0x1094 0x3e 0xd 0x1088 0x3e 0xe 0x107c 0x3e 0xf 0x1070 0x3f 0x10 0x1063 0x3d 0x11 0x1057 0x3e 0x12 0x104b 0x3e 0x13 0x103f 0x3e 0x14 0x1034 0x3e 0x15 0x1028 0x3e 0x16 0x101d 0x3e 0x17 0x1012 0x3e 0x18 0x1007 0x3e 0x19 0xffc 0x3e 0x1a 0xff1 0x3e 0x1b 0xfe6 0x3e 0x1c 0xfdc 0x3e 0x1d 0xfd2 0x3e 0x1e 0xfc8 0x3e 0x1f 0xfbe 0x3e 0x20 0xfb5 0x3e 0x21 0xfac 0x3e 0x22 0xfa2 0x3e 0x23 0xf9a 0x3e 0x24 0xf91 0x3e 0x25 0xf89 0x3e 0x26 0xf81 0x3e 0x27 0xf7a 0x3e 0x28 0xf72 0x3e 0x29 0xf6a 0x3e 0x2a 0xf63 0x3e 0x2b 0xf5b 0x3f 0x2c 0xf53 0x3f 0x2d 0xf49 0x3e 0x2e 0xf3b 0x3f 0x2f 0xf2c 0x40 0x30 0xf21 0x3e 0x31 0xf19 0x3e 0x32 0xf12 0x3e 0x33 0xf0c 0x3e 0x34 0xf07 0x3f 0x35 0xf02 0x3f 0x36 0xefd 0x3e 0x37 0xef8 0x3e 0x38 0xef4 0x3e 0x39 0xef0 0x40 0x3a 0xeec 0x40 0x3b 0xee8 0x3f 0x3c 0xee5 0x40 0x3d 0xee1 0x40 0x3e 0xede 0x3f 0x3f 0xedb 0x40 0x40 0xed8 0x40 0x41 0xed6 0x40 0x42 0xed3 0x3f 0x43 0xed1 0x40 0x44 0xece 0x40 0x45 0xecc 0x40 0x46 0xeca 0x40 0x47 0xec8 0x41 0x48 0xec6 0x41 0x49 0xec4 0x41 0x4a 0xec0 0x41 0x4b 0xebc 0x41 0x4c 0xeb8 0x41 0x4d 0xeb5 0x41 0x4e 0xeb1 0x41 0x4f 0xead 0x41 0x50 0xea9 0x41 0x51 0xea6 0x42 0x52 0xea2 0x41 0x53 0xe9e 0x41 0x54 0xe99 0x41 0x55 0xe93 0x41 0x56 0xe8c 0x42 0x57 0xe86 0x41 0x58 0xe80 0x41 0x59 0xe77 0x41 0x5a 0xe70 0x41 0x5b 0xe6e 0x42 0x5c 0xe6d 0x42 0x5d 0xe6b 0x42 0x5e 0xe69 0x42 0x5f 0xe66 0x43 0x60 0xe5f 0x42 0x61 0xe44 0x45 0x62 0xe12 0x44 0x63 0xdcf 0x47 0x64 0xd6d 0x4a>;
			vivo_battery1_profile_t3_num = <0x65>;
			vivo_battery1_profile_t4 = <0x0 0x113f 0x3a 0x1 0x1125 0x39 0x2 0x1112 0x39 0x3 0x1102 0x3a 0x4 0x10f3 0x39 0x5 0x10e6 0x39 0x6 0x10d9 0x39 0x7 0x10cd 0x39 0x8 0x10c0 0x39 0x9 0x10b4 0x3a 0xa 0x10a7 0x3a 0xb 0x109b 0x39 0xc 0x108f 0x3a 0xd 0x1082 0x39 0xe 0x1076 0x39 0xf 0x106a 0x3a 0x10 0x105e 0x3a 0x11 0x1052 0x3a 0x12 0x1046 0x3a 0x13 0x103a 0x3a 0x14 0x102f 0x3a 0x15 0x1023 0x3a 0x16 0x1018 0x3a 0x17 0x100d 0x3a 0x18 0x1001 0x3a 0x19 0xff6 0x3a 0x1a 0xfec 0x3a 0x1b 0xfe1 0x3b 0x1c 0xfd7 0x3a 0x1d 0xfcd 0x3a 0x1e 0xfc3 0x3a 0x1f 0xfb9 0x3b 0x20 0xfb0 0x3b 0x21 0xfa7 0x3a 0x22 0xf9e 0x3b 0x23 0xf95 0x3b 0x24 0xf8c 0x3a 0x25 0xf84 0x3b 0x26 0xf7c 0x3a 0x27 0xf74 0x3a 0x28 0xf6d 0x3a 0x29 0xf65 0x3a 0x2a 0xf5e 0x3a 0x2b 0xf57 0x3a 0x2c 0xf4e 0x3b 0x2d 0xf41 0x3b 0x2e 0xf30 0x3b 0x2f 0xf25 0x3a 0x30 0xf1d 0x3b 0x31 0xf16 0x3a 0x32 0xf10 0x3b 0x33 0xf0a 0x3b 0x34 0xf05 0x3a 0x35 0xeff 0x3a 0x36 0xefb 0x3b 0x37 0xef6 0x3a 0x38 0xef2 0x3b 0x39 0xeed 0x3a 0x3a 0xee9 0x3a 0x3b 0xee5 0x3a 0x3c 0xee3 0x3a 0x3d 0xee2 0x3b 0x3e 0xede 0x3a 0x3f 0xedb 0x3b 0x40 0xed8 0x3b 0x41 0xed5 0x3a 0x42 0xed2 0x3b 0x43 0xecf 0x3b 0x44 0xecd 0x3a 0x45 0xeca 0x3b 0x46 0xec8 0x3b 0x47 0xec6 0x3b 0x48 0xec3 0x3b 0x49 0xebe 0x3b 0x4a 0xeb5 0x3b 0x4b 0xead 0x3b 0x4c 0xeaa 0x3c 0x4d 0xea6 0x3b 0x4e 0xea1 0x3b 0x4f 0xe9d 0x3c 0x50 0xe99 0x3b 0x51 0xe95 0x3c 0x52 0xe92 0x3b 0x53 0xe8f 0x3c 0x54 0xe8a 0x3b 0x55 0xe84 0x3b 0x56 0xe7d 0x3c 0x57 0xe77 0x3b 0x58 0xe71 0x3b 0x59 0xe68 0x3c 0x5a 0xe62 0x3b 0x5b 0xe60 0x3b 0x5c 0xe5f 0x3c 0x5d 0xe5e 0x3b 0x5e 0xe5c 0x3c 0x5f 0xe59 0x3c 0x60 0xe4f 0x3c 0x61 0xe2f 0x3d 0x62 0xdfd 0x3c 0x63 0xdbd 0x3f 0x64 0xd62 0x40>;
			vivo_battery1_profile_t4_num = <0x65>;
			vivo_battery2_profile_t0 = <0x0 0x1110 0x13a 0x1 0x10f8 0x13a 0x2 0x10e6 0x13c 0x3 0x10d6 0x13e 0x4 0x10c7 0x13e 0x5 0x10c0 0x13e 0x6 0x10b9 0x13e 0x7 0x10ac 0x140 0x8 0x109e 0x13e 0x9 0x1091 0x13e 0xa 0x1084 0x13d 0xb 0x1077 0x13d 0xc 0x106a 0x13d 0xd 0x105d 0x13c 0xe 0x1057 0x13c 0xf 0x1051 0x13c 0x10 0x1045 0x13a 0x11 0x1039 0x13b 0x12 0x102d 0x13a 0x13 0x1021 0x13a 0x14 0x1015 0x139 0x15 0x1009 0x139 0x16 0xfff 0x13a 0x17 0xffa 0x139 0x18 0xff5 0x139 0x19 0xfea 0x139 0x1a 0xfde 0x139 0x1b 0xfd2 0x138 0x1c 0xfc5 0x138 0x1d 0xfb9 0x138 0x1e 0xfad 0x139 0x1f 0xfa2 0x13a 0x20 0xf9c 0x13a 0x21 0xf97 0x13b 0x22 0xf8c 0x13c 0x23 0xf81 0x13e 0x24 0xf75 0x13e 0x25 0xf67 0x140 0x26 0xf5a 0x142 0x27 0xf4e 0x142 0x28 0xf43 0x143 0x29 0xf3e 0x144 0x2a 0xf39 0x145 0x2b 0xf30 0x147 0x2c 0xf28 0x148 0x2d 0xf20 0x14b 0x2e 0xf19 0x14c 0x2f 0xf13 0x14e 0x30 0xf0c 0x150 0x31 0xf06 0x152 0x32 0xf03 0x154 0x33 0xf01 0x156 0x34 0xefb 0x158 0x35 0xef6 0x15a 0x36 0xef1 0x15d 0x37 0xeed 0x160 0x38 0xee8 0x162 0x39 0xee4 0x165 0x3a 0xee0 0x168 0x3b 0xede 0x16a 0x3c 0xedc 0x16c 0x3d 0xed8 0x170 0x3e 0xed6 0x173 0x3f 0xed3 0x177 0x40 0xed1 0x17a 0x41 0xecf 0x17b 0x42 0xece 0x17e 0x43 0xecc 0x182 0x44 0xecb 0x183 0x45 0xeca 0x185 0x46 0xec8 0x189 0x47 0xec6 0x18c 0x48 0xec3 0x18e 0x49 0xec0 0x192 0x4a 0xebd 0x197 0x4b 0xeb9 0x199 0x4c 0xeb5 0x19e 0x4d 0xeb2 0x1a1 0x4e 0xeb0 0x1a4 0x4f 0xeab 0x1a9 0x50 0xea4 0x1ae 0x51 0xe9e 0x1b3 0x52 0xe97 0x1b8 0x53 0xe90 0x1be 0x54 0xe88 0x1c3 0x55 0xe80 0x1c6 0x56 0xe7c 0x1c8 0x57 0xe78 0x1ca 0x58 0xe71 0x1cf 0x59 0xe6c 0x1d2 0x5a 0xe68 0x1d8 0x5b 0xe65 0x1dd 0x5c 0xe61 0x1e2 0x5d 0xe5d 0x1e7 0x5e 0xe52 0x1f1 0x5f 0xe47 0x1f2 0x60 0xe3b 0x1f4 0x61 0xe15 0x1f9 0x62 0xdcb 0x1f7 0x63 0xdb0 0x1fe 0x64 0xd99 0x20a>;
			vivo_battery2_profile_t0_num = <0x65>;
			vivo_battery2_profile_t1 = <0x0 0x1125 0xb8 0x1 0x1114 0xb8 0x2 0x1107 0xb9 0x3 0x10fa 0xba 0x4 0x10ee 0xbb 0x5 0x10e2 0xbb 0x6 0x10dc 0xbb 0x7 0x10d5 0xbc 0x8 0x10c9 0xba 0x9 0x10bc 0xba 0xa 0x10b0 0xba 0xb 0x10a3 0xb8 0xc 0x1096 0xba 0xd 0x108a 0xb9 0xe 0x107d 0xb8 0xf 0x1071 0xb9 0x10 0x1064 0xb8 0x11 0x1058 0xb8 0x12 0x1052 0xb8 0x13 0x104c 0xb8 0x14 0x1040 0xb8 0x15 0x1034 0xb9 0x16 0x1029 0xb9 0x17 0x101d 0xb8 0x18 0x1011 0xb8 0x19 0x1006 0xb7 0x1a 0xffb 0xb7 0x1b 0xff0 0xb8 0x1c 0xfe6 0xb7 0x1d 0xfdb 0xb8 0x1e 0xfd5 0xb8 0x1f 0xfd0 0xb8 0x20 0xfc4 0xb7 0x21 0xfb9 0xb8 0x22 0xfad 0xb8 0x23 0xfa3 0xb9 0x24 0xf98 0xba 0x25 0xf8d 0xba 0x26 0xf81 0xbb 0x27 0xf73 0xbb 0x28 0xf65 0xbb 0x29 0xf58 0xbc 0x2a 0xf52 0xbc 0x2b 0xf4c 0xbd 0x2c 0xf42 0xbd 0x2d 0xf39 0xbe 0x2e 0xf31 0xbe 0x2f 0xf29 0xbf 0x30 0xf22 0xc0 0x31 0xf1c 0xc0 0x32 0xf15 0xc1 0x33 0xf0f 0xc4 0x34 0xf0a 0xc5 0x35 0xf04 0xc5 0x36 0xf01 0xc5 0x37 0xeff 0xc4 0x38 0xefa 0xc6 0x39 0xef5 0xc7 0x3a 0xef0 0xc9 0x3b 0xeec 0xcb 0x3c 0xee8 0xcc 0x3d 0xee4 0xce 0x3e 0xee0 0xd0 0x3f 0xedc 0xd2 0x40 0xed8 0xd6 0x41 0xed5 0xd9 0x42 0xed3 0xda 0x43 0xed2 0xdb 0x44 0xecf 0xde 0x45 0xecc 0xe0 0x46 0xeca 0xe0 0x47 0xec8 0xe1 0x48 0xec6 0xe3 0x49 0xec4 0xe5 0x4a 0xec1 0xe7 0x4b 0xebe 0xe8 0x4c 0xeba 0xea 0x4d 0xeb6 0xeb 0x4e 0xeb3 0xec 0x4f 0xeb1 0xed 0x50 0xead 0xee 0x51 0xea7 0xf1 0x52 0xea1 0xf4 0x53 0xe9a 0xf6 0x54 0xe93 0xf9 0x55 0xe8c 0xfa 0x56 0xe84 0xfe 0x57 0xe7b 0x101 0x58 0xe74 0x103 0x59 0xe70 0x108 0x5a 0xe6e 0x10a 0x5b 0xe6d 0x10b 0x5c 0xe6a 0x10f 0x5d 0xe67 0x112 0x5e 0xe62 0x118 0x5f 0xe59 0x120 0x60 0xe40 0x129 0x61 0xe17 0x133 0x62 0xddd 0x13d 0x63 0xd8f 0x14a 0x64 0xd1e 0x157>;
			vivo_battery2_profile_t1_num = <0x65>;
			vivo_battery2_profile_t2 = <0x0 0x1129 0xa8 0x1 0x1119 0xa8 0x2 0x110d 0xa9 0x3 0x1101 0xa9 0x4 0x10f5 0xa9 0x5 0x10e9 0xa9 0x6 0x10dd 0xaa 0x7 0x10d7 0xa9 0x8 0x10d1 0xa9 0x9 0x10c4 0xa8 0xa 0x10b8 0xa8 0xb 0x10ac 0xa7 0xc 0x109f 0xa6 0xd 0x1092 0xa6 0xe 0x1086 0xa6 0xf 0x107a 0xa5 0x10 0x106d 0xa5 0x11 0x1061 0xa5 0x12 0x1055 0xa4 0x13 0x1049 0xa4 0x14 0x1043 0xa4 0x15 0x103d 0xa3 0x16 0x1031 0xa2 0x17 0x1026 0xa1 0x18 0x101a 0xa1 0x19 0x100f 0xa1 0x1a 0x1004 0xa2 0x1b 0xff8 0xa0 0x1c 0xfee 0xa1 0x1d 0xfe4 0xa0 0x1e 0xfd9 0xa0 0x1f 0xfce 0xa0 0x20 0xfc2 0xa1 0x21 0xfb7 0xa0 0x22 0xfb2 0xa0 0x23 0xfad 0xa0 0x24 0xfa2 0xa0 0x25 0xf97 0xa0 0x26 0xf8d 0xa0 0x27 0xf80 0xa2 0x28 0xf72 0xa1 0x29 0xf64 0xa2 0x2a 0xf58 0xa2 0x2b 0xf4c 0xa2 0x2c 0xf42 0xa2 0x2d 0xf39 0xa3 0x2e 0xf31 0xa3 0x2f 0xf2a 0xa4 0x30 0xf26 0xa4 0x31 0xf23 0xa5 0x32 0xf1d 0xa5 0x33 0xf16 0xa6 0x34 0xf11 0xa6 0x35 0xf0b 0xa7 0x36 0xf05 0xa7 0x37 0xf00 0xa8 0x38 0xefb 0xa9 0x39 0xef6 0xaa 0x3a 0xef2 0xaa 0x3b 0xeed 0xac 0x3c 0xee9 0xac 0x3d 0xee7 0xad 0x3e 0xee5 0xae 0x3f 0xee1 0xae 0x40 0xede 0xaf 0x41 0xeda 0xb0 0x42 0xed7 0xb2 0x43 0xed3 0xb3 0x44 0xed0 0xb4 0x45 0xecd 0xb6 0x46 0xecb 0xb7 0x47 0xec8 0xb8 0x48 0xec6 0xb9 0x49 0xec4 0xbb 0x4a 0xec1 0xbd 0x4b 0xebf 0xbd 0x4c 0xebe 0xbd 0x4d 0xeb9 0xbe 0x4e 0xeb5 0xc0 0x4f 0xeb1 0xc1 0x50 0xeac 0xc2 0x51 0xea7 0xc3 0x52 0xea1 0xc4 0x53 0xe9a 0xc6 0x54 0xe94 0xc7 0x55 0xe8d 0xc9 0x56 0xe85 0xca 0x57 0xe7c 0xcc 0x58 0xe75 0xce 0x59 0xe73 0xcf 0x5a 0xe72 0xd0 0x5b 0xe6f 0xd2 0x5c 0xe6c 0xd4 0x5d 0xe6a 0xd7 0x5e 0xe66 0xd9 0x5f 0xe5e 0xdd 0x60 0xe47 0xe3 0x61 0xe1c 0xe8 0x62 0xde2 0xef 0x63 0xd94 0xf9 0x64 0xd22 0x107>;
			vivo_battery2_profile_t2_num = <0x65>;
			vivo_battery2_profile_t3 = <0x0 0x113b 0x60 0x1 0x112f 0x60 0x2 0x1125 0x60 0x3 0x111b 0x5f 0x4 0x1111 0x60 0x5 0x1107 0x60 0x6 0x10fc 0x60 0x7 0x10f1 0x60 0x8 0x10e6 0x60 0x9 0x10da 0x5f 0xa 0x10ce 0x60 0xb 0x10c2 0x60 0xc 0x10bc 0x60 0xd 0x10b6 0x60 0xe 0x10aa 0x60 0xf 0x109d 0x60 0x10 0x1091 0x60 0x11 0x1084 0x60 0x12 0x1078 0x5f 0x13 0x106c 0x5f 0x14 0x1060 0x5f 0x15 0x1054 0x5f 0x16 0x1048 0x5f 0x17 0x103c 0x5f 0x18 0x1030 0x5f 0x19 0x1025 0x5f 0x1a 0x1019 0x5f 0x1b 0x100e 0x5f 0x1c 0x1003 0x5f 0x1d 0xff8 0x5f 0x1e 0xfed 0x5f 0x1f 0xfe2 0x5f 0x20 0xfd8 0x5f 0x21 0xfcd 0x5f 0x22 0xfc3 0x5e 0x23 0xfb9 0x5e 0x24 0xfaf 0x5e 0x25 0xfaa 0x5e 0x26 0xfa5 0x5f 0x27 0xf9c 0x5f 0x28 0xf92 0x5f 0x29 0xf88 0x5f 0x2a 0xf7c 0x5f 0x2b 0xf6d 0x5f 0x2c 0xf5e 0x5f 0x2d 0xf52 0x5f 0x2e 0xf48 0x5f 0x2f 0xf3f 0x5f 0x30 0xf37 0x5f 0x31 0xf30 0x5e 0x32 0xf29 0x5e 0x33 0xf22 0x5e 0x34 0xf1c 0x5e 0x35 0xf16 0x5e 0x36 0xf11 0x5f 0x37 0xf0b 0x5f 0x38 0xf06 0x5f 0x39 0xf01 0x5f 0x3a 0xefc 0x5e 0x3b 0xef8 0x5f 0x3c 0xef4 0x5f 0x3d 0xeef 0x5f 0x3e 0xeed 0x5f 0x3f 0xeeb 0x5f 0x40 0xee8 0x5f 0x41 0xee4 0x5f 0x42 0xee0 0x60 0x43 0xedd 0x5e 0x44 0xed9 0x60 0x45 0xed6 0x60 0x46 0xed2 0x60 0x47 0xecf 0x60 0x48 0xeca 0x60 0x49 0xec5 0x60 0x4a 0xec0 0x60 0x4b 0xebb 0x60 0x4c 0xeb7 0x60 0x4d 0xeb1 0x60 0x4e 0xead 0x61 0x4f 0xea9 0x60 0x50 0xea5 0x61 0x51 0xea1 0x61 0x52 0xe9c 0x61 0x53 0xe95 0x61 0x54 0xe8f 0x61 0x55 0xe89 0x61 0x56 0xe83 0x61 0x57 0xe7e 0x61 0x58 0xe7a 0x62 0x59 0xe73 0x62 0x5a 0xe71 0x62 0x5b 0xe70 0x62 0x5c 0xe6f 0x62 0x5d 0xe6d 0x63 0x5e 0xe6b 0x62 0x5f 0xe66 0x62 0x60 0xe50 0x63 0x61 0xe26 0x63 0x62 0xdf0 0x65 0x63 0xda9 0x64 0x64 0xd45 0x67>;
			vivo_battery2_profile_t3_num = <0x65>;
			vivo_battery2_profile_t4 = <0x0 0x113d 0x5b 0x1 0x1132 0x5b 0x2 0x1128 0x5b 0x3 0x111e 0x5b 0x4 0x1114 0x5c 0x5 0x110a 0x5d 0x6 0x1100 0x5e 0x7 0x10f5 0x5e 0x8 0x10ea 0x5e 0x9 0x10df 0x5e 0xa 0x10d3 0x5e 0xb 0x10c8 0x5f 0xc 0x10bb 0x5f 0xd 0x10af 0x5f 0xe 0x10a9 0x5f 0xf 0x10a3 0x5e 0x10 0x1097 0x5f 0x11 0x108a 0x5f 0x12 0x107e 0x5f 0x13 0x1072 0x5f 0x14 0x1066 0x5f 0x15 0x105a 0x5f 0x16 0x104e 0x5f 0x17 0x1042 0x60 0x18 0x1036 0x5f 0x19 0x102a 0x5f 0x1a 0x101f 0x5f 0x1b 0x1013 0x60 0x1c 0x1008 0x5f 0x1d 0xffd 0x5f 0x1e 0xff2 0x5f 0x1f 0xfe7 0x5f 0x20 0xfdd 0x5f 0x21 0xfd3 0x5f 0x22 0xfc8 0x5f 0x23 0xfbe 0x5f 0x24 0xfb4 0x5f 0x25 0xfab 0x5f 0x26 0xfa1 0x5f 0x27 0xf97 0x5f 0x28 0xf8d 0x5f 0x29 0xf87 0x5f 0x2a 0xf82 0x5f 0x2b 0xf74 0x5f 0x2c 0xf65 0x5f 0x2d 0xf57 0x5f 0x2e 0xf4c 0x5e 0x2f 0xf43 0x5e 0x30 0xf3a 0x5f 0x31 0xf33 0x5e 0x32 0xf2c 0x5f 0x33 0xf25 0x5f 0x34 0xf1f 0x5f 0x35 0xf19 0x5f 0x36 0xf14 0x5f 0x37 0xf0e 0x5f 0x38 0xf09 0x5f 0x39 0xf04 0x60 0x3a 0xeff 0x60 0x3b 0xefa 0x60 0x3c 0xef6 0x60 0x3d 0xef2 0x60 0x3e 0xeed 0x60 0x3f 0xee9 0x60 0x40 0xee6 0x60 0x41 0xee2 0x61 0x42 0xede 0x60 0x43 0xedb 0x61 0x44 0xed9 0x61 0x45 0xed8 0x61 0x46 0xed4 0x60 0x47 0xed1 0x61 0x48 0xecc 0x60 0x49 0xec7 0x60 0x4a 0xec2 0x61 0x4b 0xebd 0x61 0x4c 0xeb8 0x61 0x4d 0xeb3 0x60 0x4e 0xeae 0x61 0x4f 0xea9 0x61 0x50 0xea6 0x61 0x51 0xea2 0x61 0x52 0xe9d 0x61 0x53 0xe97 0x61 0x54 0xe91 0x62 0x55 0xe8b 0x62 0x56 0xe85 0x62 0x57 0xe7d 0x62 0x58 0xe74 0x62 0x59 0xe71 0x62 0x5a 0xe70 0x62 0x5b 0xe6f 0x62 0x5c 0xe6e 0x63 0x5d 0xe6c 0x63 0x5e 0xe68 0x63 0x5f 0xe62 0x63 0x60 0xe5c 0x63 0x61 0xe38 0x64 0x62 0xe07 0x65 0x63 0xdc8 0x66 0x64 0xd71 0x67>;
			vivo_battery2_profile_t4_num = <0x65>;
			vivo_battery3_profile_t0 = <0x0 0x112f 0x189 0x1 0x111c 0x186 0x2 0x110d 0x181 0x3 0x1100 0x17d 0x4 0x10f3 0x178 0x5 0x10e6 0x173 0x6 0x10e0 0x171 0x7 0x10da 0x16f 0x8 0x10ce 0x16c 0x9 0x10c1 0x168 0xa 0x10b5 0x166 0xb 0x10a9 0x161 0xc 0x109d 0x15e 0xd 0x1090 0x15b 0xe 0x1084 0x157 0xf 0x1078 0x154 0x10 0x106c 0x152 0x11 0x1066 0x151 0x12 0x1060 0x150 0x13 0x1055 0x14d 0x14 0x1049 0x14c 0x15 0x103d 0x149 0x16 0x1032 0x146 0x17 0x1026 0x143 0x18 0x101b 0x143 0x19 0x100f 0x141 0x1a 0x1005 0x139 0x1b 0xffb 0x140 0x1c 0xff5 0x13f 0x1d 0xff0 0x13e 0x1e 0xfe5 0x13d 0x1f 0xfd9 0x13c 0x20 0xfcd 0x13a 0x21 0xfc1 0x139 0x22 0xfb5 0x138 0x23 0xfa9 0x138 0x24 0xf9d 0x138 0x25 0xf91 0x139 0x26 0xf85 0x13a 0x27 0xf7f 0x13a 0x28 0xf7a 0x13b 0x29 0xf6f 0x13b 0x2a 0xf63 0x13c 0x2b 0xf58 0x13e 0x2c 0xf4d 0x13f 0x2d 0xf43 0x13f 0x2e 0xf3a 0x140 0x2f 0xf32 0x143 0x30 0xf2a 0x143 0x31 0xf23 0x145 0x32 0xf1f 0x146 0x33 0xf1c 0x147 0x34 0xf15 0x147 0x35 0xf0f 0x148 0x36 0xf0a 0x14c 0x37 0xf04 0x14e 0x38 0xeff 0x150 0x39 0xefa 0x152 0x3a 0xef5 0x154 0x3b 0xef0 0x156 0x3c 0xeec 0x159 0x3d 0xee9 0x15a 0x3e 0xee7 0x15c 0x3f 0xee3 0x15d 0x40 0xedf 0x161 0x41 0xedc 0x163 0x42 0xed9 0x167 0x43 0xed6 0x16a 0x44 0xed4 0x16d 0x45 0xed1 0x16e 0x46 0xed0 0x171 0x47 0xece 0x174 0x48 0xecd 0x175 0x49 0xecc 0x177 0x4a 0xec9 0x178 0x4b 0xec7 0x17c 0x4c 0xec5 0x16c 0x4d 0xec2 0x185 0x4e 0xebf 0x188 0x4f 0xebb 0x18c 0x50 0xeb7 0x18f 0x51 0xeb2 0x195 0x52 0xead 0x199 0x53 0xea9 0x19b 0x54 0xea6 0x19e 0x55 0xe9f 0x1a5 0x56 0xe98 0x1ab 0x57 0xe91 0x1b1 0x58 0xe89 0x1b6 0x59 0xe81 0x1bd 0x5a 0xe77 0x1c5 0x5b 0xe70 0x1cd 0x5c 0xe6b 0x1d5 0x5d 0xe67 0x1df 0x5e 0xe65 0x1e3 0x5f 0xe63 0x1e8 0x60 0xe60 0x1f4 0x61 0xe1a 0x200 0x62 0xdd4 0x210 0x63 0xd8e 0x223 0x64 0xd48 0x233>;
			vivo_battery3_profile_t0_num = <0x65>;
			vivo_battery3_profile_t1 = <0x0 0x1128 0xae 0x1 0x1117 0xae 0x2 0x1109 0xae 0x3 0x10fd 0xaf 0x4 0x10f1 0xaf 0x5 0x10e5 0xaf 0x6 0x10da 0xaf 0x7 0x10d4 0xaf 0x8 0x10ce 0xaf 0x9 0x10c1 0xaf 0xa 0x10b5 0xae 0xb 0x10a9 0xae 0xc 0x109c 0xae 0xd 0x1090 0xac 0xe 0x1084 0xad 0xf 0x1077 0xac 0x10 0x106b 0xac 0x11 0x105f 0xac 0x12 0x1053 0xac 0x13 0x1047 0xab 0x14 0x1041 0xab 0x15 0x103c 0xab 0x16 0x1030 0xab 0x17 0x1025 0xab 0x18 0x1019 0xab 0x19 0x100e 0xab 0x1a 0x1003 0xab 0x1b 0xff8 0xab 0x1c 0xfee 0xac 0x1d 0xfe4 0xac 0x1e 0xfd9 0xab 0x1f 0xfce 0xab 0x20 0xfc3 0xab 0x21 0xfbd 0xac 0x22 0xfb8 0xac 0x23 0xfae 0xac 0x24 0xfa4 0xac 0x25 0xf99 0xad 0x26 0xf90 0xae 0x27 0xf85 0xae 0x28 0xf78 0xaf 0x29 0xf6a 0xaf 0x2a 0xf5b 0xaf 0x2b 0xf4f 0xb0 0x2c 0xf45 0xb2 0x2d 0xf3b 0xb2 0x2e 0xf37 0xb2 0x2f 0xf33 0xb2 0x30 0xf2c 0xb3 0x31 0xf25 0xb4 0x32 0xf1e 0xb5 0x33 0xf18 0xb6 0x34 0xf12 0xb6 0x35 0xf0d 0xb8 0x36 0xf07 0xb9 0x37 0xf02 0xba 0x38 0xefd 0xba 0x39 0xef8 0xbc 0x3a 0xeef 0xbe 0x3b 0xeeb 0xc0 0x3c 0xee7 0xc2 0x3d 0xee3 0xc3 0x3e 0xedf 0xc4 0x3f 0xedc 0xc6 0x40 0xed8 0xc7 0x41 0xed5 0xc9 0x42 0xed2 0xcb 0x43 0xecf 0xcc 0x44 0xecd 0xce 0x45 0xeca 0xcf 0x46 0xec8 0xd1 0x47 0xec7 0xd2 0x48 0xec3 0xd3 0x49 0xec0 0xd4 0x4a 0xebc 0xd6 0x4b 0xeb7 0xd7 0x4c 0xeb2 0xd8 0x4d 0xeae 0xd9 0x4e 0xea9 0xdb 0x4f 0xea3 0xde 0x50 0xe9b 0xe0 0x51 0xe94 0xe1 0x52 0xe8e 0xe3 0x53 0xe8a 0xe5 0x54 0xe86 0xe6 0x55 0xe7c 0xe9 0x56 0xe74 0xea 0x57 0xe70 0xed 0x58 0xe6d 0xef 0x59 0xe6a 0xf4 0x5a 0xe67 0xf9 0x5b 0xe63 0xfe 0x5c 0xe5b 0x105 0x5d 0xe43 0x10d 0x5e 0xe2b 0x111 0x5f 0xe14 0x117 0x60 0xdfc 0x11d 0x61 0xdd6 0x123 0x62 0xdb8 0x128 0x63 0xd8e 0x12c 0x64 0xd48 0x135>;
			vivo_battery3_profile_t1_num = <0x65>;
			vivo_battery3_profile_t2 = <0x0 0x1134 0x75 0x1 0x1126 0x73 0x2 0x111a 0x74 0x3 0x1110 0x74 0x4 0x1105 0x74 0x5 0x10fa 0x74 0x6 0x10ee 0x73 0x7 0x10e3 0x74 0x8 0x10d8 0x73 0x9 0x10d2 0x73 0xa 0x10cc 0x73 0xb 0x10c0 0x73 0xc 0x10b3 0x74 0xd 0x10a7 0x72 0xe 0x109b 0x73 0xf 0x108f 0x73 0x10 0x1083 0x72 0x11 0x1076 0x72 0x12 0x106a 0x72 0x13 0x105e 0x72 0x14 0x1052 0x71 0x15 0x1047 0x71 0x16 0x103b 0x72 0x17 0x102f 0x71 0x18 0x1024 0x71 0x19 0x1019 0x70 0x1a 0x100e 0x71 0x1b 0x1008 0x71 0x1c 0x1002 0x70 0x1d 0xff8 0x71 0x1e 0xfed 0x71 0x1f 0xfe3 0x71 0x20 0xfd9 0x72 0x21 0xfcf 0x71 0x22 0xfc4 0x72 0x23 0xfba 0x72 0x24 0xfb0 0x71 0x25 0xfa6 0x72 0x26 0xf9c 0x71 0x27 0xf93 0x71 0x28 0xf88 0x72 0x29 0xf7c 0x72 0x2a 0xf6d 0x71 0x2b 0xf5f 0x73 0x2c 0xf52 0x72 0x2d 0xf4d 0x72 0x2e 0xf48 0x73 0x2f 0xf3f 0x74 0x30 0xf36 0x73 0x31 0xf30 0x73 0x32 0xf29 0x74 0x33 0xf22 0x74 0x34 0xf1c 0x74 0x35 0xf16 0x75 0x36 0xf11 0x76 0x37 0xf0b 0x76 0x38 0xf06 0x77 0x39 0xf01 0x76 0x3a 0xefc 0x77 0x3b 0xef8 0x78 0x3c 0xef3 0x77 0x3d 0xeef 0x78 0x3e 0xeeb 0x79 0x3f 0xee9 0x79 0x40 0xee7 0x7a 0x41 0xee3 0x7a 0x42 0xedf 0x79 0x43 0xedc 0x7b 0x44 0xed9 0x7c 0x45 0xed6 0x7b 0x46 0xed3 0x7d 0x47 0xed0 0x7d 0x48 0xecc 0x7e 0x49 0xec9 0x7f 0x4a 0xec5 0x7e 0x4b 0xec1 0x80 0x4c 0xebc 0x7f 0x4d 0xeb7 0x80 0x4e 0xeb2 0x82 0x4f 0xeae 0x80 0x50 0xeab 0x82 0x51 0xea8 0x82 0x52 0xea6 0x83 0x53 0xea0 0x82 0x54 0xe99 0x81 0x55 0xe93 0x83 0x56 0xe8e 0x84 0x57 0xe86 0x84 0x58 0xe7d 0x85 0x59 0xe76 0x85 0x5a 0xe74 0x85 0x5b 0xe72 0x86 0x5c 0xe70 0x87 0x5d 0xe6e 0x88 0x5e 0xe6b 0x88 0x5f 0xe63 0x8b 0x60 0xe47 0x8b 0x61 0xe17 0x8c 0x62 0xdd9 0x8f 0x63 0xd8e 0x91 0x64 0xd48 0x92>;
			vivo_battery3_profile_t2_num = <0x65>;
			vivo_battery3_profile_t3 = <0x0 0x113c 0x55 0x1 0x112f 0x55 0x2 0x1124 0x55 0x3 0x111a 0x55 0x4 0x1110 0x56 0x5 0x1105 0x55 0x6 0x10fa 0x55 0x7 0x10ef 0x55 0x8 0x10e4 0x55 0x9 0x10d8 0x55 0xa 0x10cd 0x55 0xb 0x10c1 0x55 0xc 0x10b4 0x54 0xd 0x1086 0x55 0xe 0x10a9 0x55 0xf 0x109d 0x55 0x10 0x1090 0x55 0x11 0x1084 0x54 0x12 0x1078 0x55 0x13 0x106c 0x55 0x14 0x1060 0x54 0x15 0x1054 0x54 0x16 0x1049 0x55 0x17 0x103d 0x54 0x18 0x1031 0x54 0x19 0x1026 0x54 0x1a 0x101b 0x54 0x1b 0x100f 0x53 0x1c 0x1005 0x55 0x1d 0xffa 0x54 0x1e 0xfef 0x54 0x1f 0xfe5 0x54 0x20 0xfda 0x54 0x21 0xfd1 0x54 0x22 0xfc7 0x54 0x23 0xfbd 0x54 0x24 0xfb3 0x53 0x25 0xfa9 0x54 0x26 0xfa4 0x53 0x27 0xfa0 0x53 0x28 0xf97 0x54 0x29 0xf8d 0x54 0x2a 0xf82 0x54 0x2b 0xf76 0x55 0x2c 0xf68 0x55 0x2d 0xf59 0x53 0x2e 0xf4d 0x54 0x2f 0xf43 0x53 0x30 0xf3b 0x54 0x31 0xf34 0x54 0x32 0xf2d 0x54 0x33 0xf27 0x54 0x34 0xf21 0x54 0x35 0xf1b 0x54 0x36 0xf15 0x53 0x37 0xf10 0x54 0x38 0xf0b 0x54 0x39 0xf06 0x53 0x3a 0xf01 0x54 0x3b 0xefc 0x53 0x3c 0xef8 0x55 0x3d 0xef4 0x54 0x3e 0xeef 0x54 0x3f 0xeec 0x54 0x40 0xeea 0x54 0x41 0xee8 0x54 0x42 0xee5 0x55 0x43 0xee1 0x55 0x44 0xedd 0x54 0x45 0xeda 0x54 0x46 0xed7 0x54 0x47 0xed3 0x54 0x48 0xecf 0x55 0x49 0xeca 0x56 0x4a 0xec4 0x54 0x4b 0xec0 0x55 0x4c 0xebb 0x56 0x4d 0xeb6 0x55 0x4e 0xeb1 0x55 0x4f 0xeac 0x56 0x50 0xea8 0x55 0x51 0xea4 0x57 0x52 0xe9f 0x56 0x53 0xe99 0x56 0x54 0xe93 0x58 0x55 0xe8d 0x57 0x56 0xe86 0x56 0x57 0xe7f 0x57 0x58 0xe76 0x56 0x59 0xe74 0x56 0x5a 0xe73 0x57 0x5b 0xe71 0x57 0x5c 0xe70 0x56 0x5d 0xe6f 0x57 0x5e 0xe6d 0x58 0x5f 0xe68 0x57 0x60 0xe58 0x58 0x61 0xe30 0x57 0x62 0xdfb 0x58 0x63 0xda4 0x59 0x64 0xd48 0x5b>;
			vivo_battery3_profile_t3_num = <0x65>;
			vivo_battery3_profile_t4 = <0x0 0x1140 0x4b 0x1 0x1132 0x4b 0x2 0x1126 0x4b 0x3 0x111a 0x4b 0x4 0x110f 0x4a 0x5 0x1104 0x4a 0x6 0x10f9 0x4b 0x7 0x10ee 0x4a 0x8 0x10e3 0x4b 0x9 0x10d7 0x4b 0xa 0x10cb 0x4b 0xb 0x10c0 0x4b 0xc 0x10ba 0x4b 0xd 0x10b4 0x4b 0xe 0x10a8 0x4b 0xf 0x109c 0x4b 0x10 0x1090 0x4a 0x11 0x1084 0x4b 0x12 0x1077 0x4b 0x13 0x106c 0x4b 0x14 0x105f 0x4b 0x15 0x1054 0x4c 0x16 0x1048 0x4b 0x17 0x103c 0x4b 0x18 0x1031 0x4c 0x19 0x1025 0x4b 0x1a 0x101a 0x4a 0x1b 0x100f 0x4c 0x1c 0x1004 0x4c 0x1d 0xff9 0x4c 0x1e 0xfef 0x4c 0x1f 0xfe5 0x4c 0x20 0xfda 0x4b 0x21 0xfd0 0x4c 0x22 0xfc6 0x4c 0x23 0xfc1 0x4b 0x24 0xfbc 0x4a 0x25 0xfb3 0x4b 0x26 0xfaa 0x4c 0x27 0xfa0 0x4b 0x28 0xf98 0x4c 0x29 0xf8e 0x4c 0x2a 0xf84 0x4b 0x2b 0xf79 0x4c 0x2c 0xf6a 0x4c 0x2d 0xf5b 0x4c 0x2e 0xf4f 0x4b 0x2f 0xf46 0x4b 0x30 0xf3e 0x4a 0x31 0xf36 0x4a 0x32 0xf30 0x4b 0x33 0xf29 0x4b 0x34 0xf23 0x4b 0x35 0xf1d 0x4b 0x36 0xf17 0x4b 0x37 0xf12 0x4b 0x38 0xf0c 0x4b 0x39 0xf07 0x4a 0x3a 0xf04 0x4a 0x3b 0xf02 0x4b 0x3c 0xefd 0x4b 0x3d 0xef9 0x4b 0x3e 0xef4 0x4b 0x3f 0xef0 0x4b 0x40 0xeec 0x4b 0x41 0xee8 0x4a 0x42 0xee5 0x4b 0x43 0xee1 0x4b 0x44 0xedd 0x4b 0x45 0xed9 0x4b 0x46 0xed5 0x4b 0x47 0xed0 0x4b 0x48 0xec8 0x4b 0x49 0xebf 0x4c 0x4a 0xeb9 0x4b 0x4b 0xeb3 0x4b 0x4c 0xeae 0x4c 0x4d 0xea9 0x4a 0x4e 0xea4 0x4c 0x4f 0xe9f 0x4c 0x50 0xe9b 0x4c 0x51 0xe98 0x4c 0x52 0xe96 0x4c 0x53 0xe91 0x4b 0x54 0xe8b 0x4c 0x55 0xe84 0x4d 0x56 0xe7d 0x4c 0x57 0xe77 0x4d 0x58 0xe6f 0x4d 0x59 0xe67 0x4d 0x5a 0xe65 0x4d 0x5b 0xe64 0x4d 0x5c 0xe63 0x4d 0x5d 0xe61 0x4e 0x5e 0xe5f 0x4d 0x5f 0xe58 0x4e 0x60 0xe3d 0x4e 0x61 0xe12 0x4f 0x62 0xddb 0x50 0x63 0xd92 0x50 0x64 0xd48 0x52>;
			vivo_battery3_profile_t4_num = <0x65>;
			vivo_battery4_profile_t0;
			vivo_battery4_profile_t0_num = <0x65>;
			vivo_battery4_profile_t1;
			vivo_battery4_profile_t1_num = <0x65>;
			vivo_battery4_profile_t2;
			vivo_battery4_profile_t2_num = <0x65>;
			vivo_battery4_profile_t3;
			vivo_battery4_profile_t3_num = <0x65>;
			vivo_battery4_profile_t4;
			vivo_battery4_profile_t4_num = <0x65>;
		};
	};

	fragment@7 {
		target = <0xffffffff>;

		__overlay__ {

			ext_buck_vgpu@55 {
				regulator-max-microvolt = <0x13d620>;
				regulator-min-microvolt = <0x493e0>;
				regulator-name = "ext_buck_vgpu";
				vsel_pin = <0x2>;
			};
		};
	};

	fragment@70 {
		target = <0xffffffff>;

		__overlay__ {
			compatible = "vivo,charger-monitor-v2";
			status = "okay";

			single_charger_board {
				phandle = <0x84>;
				support-board-version = "xxxxxx";
				vivo,5v-parallel-fboff-tc-data = <0xffffdd48 0x22b8 0x0>;
				vivo,5v-parallel-fboff-tc-row-col = <0x1 0x3>;
				vivo,5v-parallel-fbon-tc-data = <0xffffdd48 0x22b8 0x0>;
				vivo,5v-parallel-fbon-tc-row-col = <0x1 0x3>;
				vivo,5v-primary-fboff-tc-data = <0x1e1 0x22b8 0x320 0x1c3 0x1e0 0x4b0 0x1af 0x1c2 0x5dc 0x191 0x1ae 0x708 0x173 0x190 0x7d0 0xffffdd48 0x172 0x8fc>;
				vivo,5v-primary-fboff-tc-row-col = <0x6 0x3>;
				vivo,5v-primary-fbon-tc-data = <0x209 0x22b8 0x12c 0x1eb 0x208 0x1f4 0x1e1 0x1ea 0x3e8 0x1cd 0x1e0 0x44c 0x1af 0x1cc 0x514 0x19b 0x1ae 0x640 0x17d 0x19a 0x708 0xffffdd48 0x17c 0x7d0>;
				vivo,5v-primary-fbon-tc-row-col = <0x8 0x3>;
				vivo,9v-2nd-parallel-fboff-tc-data = <0x1af 0x22b8 0x1f4 0x19b 0x1ae 0x2bc 0x17d 0x19a 0x316 0x173 0x17c 0x41a 0x15f 0x172 0x514 0xffffdd48 0x15e 0x5dc>;
				vivo,9v-2nd-parallel-fboff-tc-row-col = <0x6 0x3>;
				vivo,9v-2nd-parallel-fbon-tc-data = <0x191 0x22b8 0x200 0x182 0x190 0x320 0xffffdd48 0x181 0x3e8>;
				vivo,9v-2nd-parallel-fbon-tc-row-col = <0x3 0x3>;
				vivo,9v-parallel-fboff-tc-data = <0x1be 0x22b8 0x0 0x1b4 0x1bd 0x1f4 0x19b 0x1b3 0x320 0x187 0x19a 0x3e8 0x17d 0x186 0x4b0 0x173 0x17c 0x578 0xffffdd48 0x172 0x640>;
				vivo,9v-parallel-fboff-tc-row-col = <0x7 0x3>;
				vivo,9v-parallel-fbon-tc-data = <0x1cc 0x22b8 0x1f4 0x1b8 0x1cb 0x352 0x1a4 0x1b7 0x424 0x190 0x1a3 0x47e 0x17c 0x18f 0x514 0xffffdd48 0x17b 0x5dc>;
				vivo,9v-parallel-fbon-tc-row-col = <0x6 0x3>;
				vivo,9v-primary-fboff-tc-data = <0x1b4 0x22b8 0x12c 0x1aa 0x1b3 0x1f4 0x191 0x1a9 0x44c 0x17d 0x190 0x514 0x173 0x17c 0x5dc 0x169 0x172 0x708 0xffffdd48 0x168 0x7d0>;
				vivo,9v-primary-fboff-tc-row-col = <0x7 0x3>;
				vivo,9v-primary-fbon-tc-data = <0x1ea 0x22b8 0x1f4 0x1d6 0x1e9 0x1f4 0x1c2 0x1d5 0x384 0x1b3 0x1c1 0x410 0x19a 0x1b2 0x4b0 0x17c 0x199 0x514 0xffffdd48 0x17b 0x5dc>;
				vivo,9v-primary-fbon-tc-row-col = <0x7 0x3>;
				vivo,adapter-cooldown-data = <0x384 0x352 0xd48>;
				vivo,adapter-power-derate-enable;
				vivo,bat-det-method = <0x0>;
				vivo,bat-id-gpio = <0xffffffff 0x9f 0x0>;
				vivo,battery1-cycle-chg-data = <0x12c 0x0 0x63 0x9a6 0x0 0x0 0x0 0x0 0x0 0x0 0x0 0x113a 0x0 0x0 0x12c 0x64 0x95 0xd9d 0x0 0x0 0x0 0x0 0x0 0x0 0x0 0x113a 0x0 0x0 0x12c 0x96 0xc7 0x134c 0x0 0x0 0x0 0x0 0x0 0x0 0x0 0x113a 0x0 0x0 0x12c 0xc8 0x15d 0x134c 0x0 0x0 0x0 0x0 0x0 0x0 0x0 0x113a 0x0 0x0 0x12c 0x15e 0x1c1 0x134c 0x0 0x0 0x0 0x0 0x0 0x0 0x0 0x113a 0x0 0x0 0x12c 0x1c2 0x225 0x9a6 0x0 0x0 0x0 0x0 0x0 0x0 0x0 0x113a 0x0 0x0 0x1f4 0x0 0x63 0x9a6 0x0 0x0 0x0 0x0 0x0 0x0 0x0 0x1126 0x0 0x0 0x1f4 0x64 0x95 0xd9d 0x0 0x0 0x0 0x0 0x0 0x0 0x0 0x1126 0x0 0x0 0x1f4 0x96 0xc7 0x134c 0x0 0x0 0x0 0x0 0x0 0x0 0x0 0x118a 0x0 0x0 0x1f4 0xc8 0x15d 0x134c 0x0 0x0 0x0 0x0 0x0 0x0 0x0 0x1126 0x0 0x0 0x1f4 0x15e 0x1c1 0x134c 0x0 0x0 0x0 0x0 0x0 0x0 0x0 0x1126 0x0 0x0 0x1f4 0x1c2 0x225 0x9a6 0x0 0x0 0x0 0x0 0x0 0x0 0x0 0x1126 0x0 0x0 0x320 0x0 0x63 0x9a6 0x0 0x0 0x0 0x0 0x0 0x0 0x0 0x1112 0x0 0x0 0x320 0x64 0x95 0xd9d 0x0 0x0 0x0 0x0 0x0 0x0 0x0 0x1112 0x0 0x0 0x320 0x96 0xc7 0x134c 0x0 0x0 0x0 0x0 0x0 0x0 0x0 0x1112 0x0 0x0 0x320 0xc8 0x15d 0x134c 0x0 0x0 0x0 0x0 0x0 0x0 0x0 0x1112 0x0 0x0 0x320 0x15e 0x1c1 0x134c 0x0 0x0 0x0 0x0 0x0 0x0 0x0 0x1112 0x0 0x0 0x320 0x1c2 0x225 0x9a6 0x0 0x0 0x0 0x0 0x0 0x0 0x0 0x1112 0x0 0x0 0x3e8 0x0 0x63 0x7b8 0x1068 0x4a1 0x0 0x0 0x0 0x0 0x0 0x1112 0x0 0x0 0x3e8 0x64 0x95 0xace 0x1068 0x7b8 0x0 0x0 0x0 0x0 0x0 0x1112 0x0 0x0 0x3e8 0x96 0xc7 0xf70 0x1068 0xace 0x0 0x0 0x0 0x0 0x0 0x1112 0x0 0x0 0x3e8 0xc8 0x15d 0xf70 0x1068 0xace 0x0 0x0 0x0 0x0 0x0 0x1112 0x0 0x0 0x3e8 0x15e 0x1c1 0xf70 0x1068 0xace 0x0 0x0 0x0 0x0 0x0 0x1112 0x0 0x0 0x3e8 0x1c2 0x225 0x7b8 0x0 0x0 0x0 0x0 0x0 0x0 0x0 0x1112 0x0 0x0 0x270f 0x0 0x63 0x6c1 0x1068 0x40d 0x0 0x0 0x0 0x0 0x0 0x10e0 0x0 0x0 0x270f 0x64 0x95 0x974 0x1068 0x6c1 0x0 0x0 0x0 0x0 0x0 0x10e0 0x0 0x0 0x270f 0x96 0xc7 0xd82 0x1068 0x974 0x0 0x0 0x0 0x0 0x0 0x10e0 0x0 0x0 0x270f 0xc8 0x15d 0xd82 0x1068 0x974 0x0 0x0 0x0 0x0 0x0 0x10e0 0x0 0x0 0x270f 0x15e 0x1c1 0xd82 0x1068 0x974 0x0 0x0 0x0 0x0 0x0 0x10e0 0x0 0x0 0x270f 0x1c2 0x225 0x6c1 0x0 0x0 0x0 0x0 0x0 0x0 0x0 0x10e0 0x0 0x0>;
				vivo,battery1-cycle-chg-row-col = <0x1e 0xe>;
				vivo,battery2-cycle-chg-data = <0x0>;
				vivo,battery2-cycle-chg-row-col = <0x0 0x0>;
				vivo,battery3-cycle-chg-data = <0x0>;
				vivo,battery3-cycle-chg-row-col = <0x0 0x0>;
				vivo,battery4-cycle-chg-data = <0x0>;
				vivo,battery4-cycle-chg-row-col = <0x0 0x0>;
				vivo,battery5-cycle-chg-data = <0x0>;
				vivo,battery5-cycle-chg-row-col = <0x0 0x0>;
				vivo,battery6-cycle-chg-data = <0x0>;
				vivo,battery6-cycle-chg-row-col = <0x0 0x0>;
				vivo,calling-dchg-disable;
				vivo,calling-scale-data = <0x64 0xa>;
				vivo,calling-scale-enable;
				vivo,charge-param-judge-threshold = <0x5 0x2 0xdac 0x10cc 0x3e8 0x834 0x1388 0x2af8>;
				vivo,charge-test-param-data = <0x0 0x0 0x157c 0x0 0x0 0x157c 0x0 0x0 0x157c 0x1 0x14 0x28 0x1 0x14 0x2d 0x0 0x14 0x32 0x0 0x14 0x2d 0x0 0x14 0x2d 0x0 0x14 0x2d 0x0 0x14 0x32 0x0 0x14 0x32 0x0 0x14 0x32>;
				vivo,charge-test-param-row-col = <0xc 0x3>;
				vivo,charging-technology = <0x2>;
				vivo,chg-timeout-mins = <0x384>;
				vivo,dchg-ntc-protect-data = <0x2ee 0x320 0x352 0x352>;
				vivo,dchg-ntc-protect-enable;
				vivo,direct-charger-enable;
				vivo,dp-batt-temp-data = <0x64>;
				vivo,dp-batt-temp-enable;
				vivo,ex-bms-psy-name = "bq_bms";
				vivo,exhibition-mode-current-parallel = <0x0>;
				vivo,exhibition-mode-current-primary = <0x800>;
				vivo,fbon-scale-data = <0x2 0x64 0x64>;
				vivo,fixed-scale-data = <0x78 0xed8 0x0>;
				vivo,flash-charge-param-judge-threshold = <0xb 0x3 0xdac 0x1004 0x3e8 0x898 0xfa0 0x17d4>;
				vivo,flash-charge-test-param-data = <0x1 0x0 0x157c 0x1 0x0 0x157c 0x0 0x0 0x157c 0x1 0x14 0x28 0x1 0x14 0x2d 0x0 0x14 0x32 0x1 0x14 0x2d 0x0 0x14 0x2d 0x1 0x14 0x2d 0x0 0x14 0x32 0x0 0x14 0x32 0x0 0x14 0x32>;
				vivo,flash-charge-test-param-row-col = <0xc 0x3>;
				vivo,flash-normal-tc-data = <0x226 0x22b8 0x0 0x0 0x0 0x0 0x0 0x0 0x0 0x1c2 0x225 0x32 0x0 0x0 0x0 0x0 0x0 0x0 0x15e 0x1c1 0x7b 0x4398b0 0x57 0x0 0x0 0x0 0x0 0xc8 0x15d 0x7b 0x4398b0 0x57 0x0 0x0 0x0 0x0 0x96 0xc7 0x7b 0x419ce0 0x66 0x4398b0 0x50 0x0 0x0 0x64 0x95 0x64 0x0 0x0 0x0 0x0 0x0 0x0 0x32 0x63 0x46 0x401640 0x32 0x0 0x0 0x0 0x0 0x0 0x31 0x46 0x401640 0x32 0x0 0x0 0x0 0x0 0xffffffce 0xffffffff 0x0 0x0 0x0 0x0 0x0 0x0 0x0 0xffffdd48 0xffffffcd 0x0 0x0 0x0 0x0 0x0 0x0 0x0>;
				vivo,flash-normal-tc-row-col = <0xa 0x9>;
				vivo,htccc-data = <0x2d 0x37 0x3e8fa0 0x186a0>;
				vivo,htccc-enable;
				vivo,intell-charge-enable;
				vivo,normal-tc-data = <0x226 0x22b8 0x0 0x0 0x0 0x0 0x0 0x0 0x0 0x1c2 0x225 0x32 0x0 0x0 0x0 0x0 0x0 0x0 0xc8 0x1c1 0x64 0x401640 0x46 0x0 0x0 0x0 0x0 0x96 0xc7 0x64 0x401640 0x46 0x0 0x0 0x0 0x0 0x64 0x95 0x46 0x401640 0x32 0x0 0x0 0x0 0x0 0x32 0x63 0x32 0x401640 0x1e 0x0 0x0 0x0 0x0 0x0 0x31 0x32 0x401640 0x1e 0x0 0x0 0x0 0x0 0xffffdd48 0xffffffff 0x0 0x0 0x0 0x0 0x0 0x0 0x0 0xffffdd48 0xffffffff 0x0 0x0 0x0 0x0 0x0 0x0 0x0 0xffffdd48 0xffffffff 0x0 0x0 0x0 0x0 0x0 0x0 0x0>;
				vivo,normal-tc-row-col = <0xa 0x9>;
				vivo,parallel-fboff-tc-data = <0xffffdd48 0x22b8 0x0>;
				vivo,parallel-fboff-tc-row-col = <0x1 0x3>;
				vivo,parallel-fbon-tc-data = <0xffffdd48 0x22b8 0x0>;
				vivo,parallel-fbon-tc-row-col = <0x1 0x3>;
				vivo,parallel-temp-enable = <0x1 0x1>;
				vivo,primary-fboff-tc-data = <0x1c2 0x22b8 0x708 0x186 0x1c1 0xbb8 0x17c 0x185 0xd48 0x178 0x17b 0xe74 0x173 0x177 0x1004 0xffffdd48 0x172 0x1770>;
				vivo,primary-fboff-tc-row-col = <0x6 0x3>;
				vivo,primary-fbon-tc-data = <0x1cc 0x22b8 0x640 0x19a 0x1cb 0xa28 0x190 0x199 0xbb8 0x186 0x18f 0xce4 0x173 0x185 0xe74 0xffffdd48 0x172 0x1770>;
				vivo,primary-fbon-tc-row-col = <0x6 0x3>;
				vivo,switch-scale-data = <0x4b 0x35>;
				vivo,usb-conn-heat-protect-data = <0x104 0x22b8 0x29e 0x26c 0xffffdd48 0x103 0x23a 0x208>;
				vivo,usb-conn-heat-protect-data-row-col = <0x2 0x4>;
				vivo,usb-conn-pro-enable;
				vivo,usb-conn-pro-gpio = <0xffffffff 0x96 0x0>;
				vivo,usb-connecter-protect-enable = <0x1>;
				vivo,usb-id-protect-data = <0x44c 0x60b 0x1f4>;
				vivo,weixin-calling-scale-data = <0x64 0xa>;
				vivo,weixin-calling-scale-enable;
			};
		};
	};

	fragment@71 {
		target = <0xffffffff>;

		__overlay__ {
			compatible = "vivo,power_supply_lite";
			status = "okay";
		};
	};

	fragment@72 {
		target = <0xffffffff>;

		__overlay__ {
			chg-scheme = <0x2>;
			compatible = "vivo,fuelsummary";
			fboff-ibat = <0xfffffc18>;
			fbon-ibat = <0xfffffc7c>;
			fex-version = <0x3>;
			status = "okay";
			vivo,battery-aging-support = <0x2>;
		};
	};

	fragment@73 {
		target = <0xffffffff>;

		__overlay__ {
			#address-cells = <0x1>;
			#size-cells = <0x0>;
			clock-frequency = <0x186a0>;
			status = "okay";

			bq2560x@6B {
				charger_name = "primary_chg";
				compatible = "ti,bq25601";
				interrupt-parent = <0xffffffff>;
				interrupts = <0x7b 0x2>;
				reg = <0x6b>;
				ti,bq2560x,boost-current = <0x4b0>;
				ti,bq2560x,boost-voltage = <0x1386>;
				ti,bq2560x,charge-detect-enable;
				ti,bq2560x,enable_term;
				ti,bq2560x,precharge-current = <0x100>;
				ti,bq2560x,stat-pin-ctrl = <0x3>;
				ti,bq2560x,termination-current = <0x3c>;
				ti,bq2560x,usb-ichg = <0x1f4>;
				ti,bq2560x,usb-ilim = <0x1f4>;
				ti,bq2560x,usb-vlim = <0x11f8>;
				ti,bq2560x,usb-vreg = <0x1130>;
				ti,bq2560x,vac-ovp-threshold = <0x1964>;
				vivo,enable-gpio = <0xffffffff 0x9a 0x0>;
				vivo,int-gpio = <0xffffffff 0xb 0x0>;
			};

			bq25890h@6a {
				compatible = "ti,bq25890h";
				reg = <0x6a>;
				vivo,int-gpio = <0xffffffff 0xb 0x0>;
			};

			rt9467@5b {
				compatible = "richtek,rt9467";
				reg = <0x5b>;
				vivo,int-gpio = <0xffffffff 0xb 0x0>;
			};
		};
	};

	fragment@74 {
		target = <0xffffffff>;

		__overlay__ {
			fpc,enable-wakeup;
			interrupt-parent = <0xffffffff>;
			interrupts = <0x5 0x1 0x5 0x0>;
			status = "okay";
			vfp-supply = <0xffffffff>;
		};
	};

	fragment@75 {
		target = <0xffffffff>;

		__overlay__ {
			int-gpios = <0xffffffff 0x5 0x0>;
		};
	};

	fragment@76 {
		target = <0xffffffff>;

		__overlay__ {
			interrupt-parent = <0xffffffff>;
			interrupts = <0x2c 0x1 0x2c 0x1>;
			status = "okay";
		};
	};

	fragment@77 {
		target = <0xffffffff>;

		__overlay__ {
			interrupt-parent = <0xffffffff>;
			interrupts = <0x90 0x4 0x90 0x1>;
			status = "okay";
		};
	};

	fragment@78 {
		target = <0xffffffff>;

		__overlay__ {
			compatible = "mediatek,md1_sim1_hot_plug_eint-eint";
			debounce = <0x0 0x186a0>;
			dedicated = <0x0 0x0>;
			interrupts = <0x0 0x8>;
			sockettype = <0x0 0x0>;
			src_pin = <0x0 0x1>;
			status = "okay";
		};
	};

	fragment@79 {
		target = <0xffffffff>;

		__overlay__ {
			regulator-default-on = <0x2>;
			regulator-name = "vcama";
			status = "okay";
		};
	};

	fragment@8 {
		target = <0xffffffff>;

		__overlay__ {

			iddig_default {
				phandle = <0x59>;
			};

			iddig_gpio {
				phandle = <0x5a>;

				pins_cmd_dat {
					bias-disable;
					bias-pull-up = <0x1>;
					input-enable;
					pinmux = <0x2900>;
					slew-rate = <0x0>;
				};
			};

			iddig_gpio_pull_down {
				phandle = <0x5b>;

				pins_cmd_dat {
					bias-pull-down;
					input-enable;
					pinmux = <0x2900>;
					slew-rate = <0x0>;
				};
			};

			iddig_init {
				phandle = <0x62>;

				pins_cmd_dat {
					bias-disable;
					bias-pull-up = <0x1>;
					input-enable;
					pinmux = <0x2901>;
					slew-rate = <0x0>;
				};
			};

			otg167_pull1_high {
				phandle = <0x63>;

				pins_cmd_dat {
					bias-pull-up = <0x1>;
					output-high;
					pinmux = <0xa700>;
					slew-rate = <0x1>;
				};
			};

			otg167_pull1_in {
				phandle = <0x65>;

				pins_cmd_dat {
					bias-disable;
					input-enable;
					pinmux = <0xa700>;
					slew-rate = <0x0>;
				};
			};

			otg167_pull1_low {
				phandle = <0x64>;

				pins_cmd_dat {
					output-low;
					pinmux = <0xa700>;
					slew-rate = <0x1>;
				};
			};

			otg_pull1_high {
				phandle = <0x5f>;

				pins_cmd_dat {
					bias-pull-up = <0x1>;
					output-high;
					pinmux = <0xa400>;
					slew-rate = <0x1>;
				};
			};

			otg_pull1_in {
				phandle = <0x61>;

				pins_cmd_dat {
					bias-disable;
					input-enable;
					pinmux = <0xa400>;
					slew-rate = <0x0>;
				};
			};

			otg_pull1_low {
				phandle = <0x60>;

				pins_cmd_dat {
					output-low;
					pinmux = <0xa400>;
					slew-rate = <0x1>;
				};
			};

			otg_pull_high {
				phandle = <0x5c>;

				pins_cmd_dat {
					bias-pull-up = <0x1>;
					output-high;
					pinmux = <0x6e00>;
					slew-rate = <0x1>;
				};
			};

			otg_pull_in {
				phandle = <0x5e>;

				pins_cmd_dat {
					bias-disable;
					input-enable;
					pinmux = <0x6e00>;
					slew-rate = <0x0>;
				};
			};

			otg_pull_low {
				phandle = <0x5d>;

				pins_cmd_dat {
					output-low;
					pinmux = <0x6e00>;
					slew-rate = <0x1>;
				};
			};
		};
	};

	fragment@80 {
		target = <0xffffffff>;

		__overlay__ {
			regulator-default-on = <0x1>;
			regulator-name = "vsim1";
			status = "okay";
		};
	};

	fragment@81 {
		target = <0xffffffff>;

		__overlay__ {
			regulator-default-on = <0x1>;
			regulator-name = "vsim2";
			status = "okay";
		};
	};

	fragment@82 {
		target = <0xffffffff>;

		__overlay__ {
			regulator-default-on = <0x1>;
			regulator-name = "vcamd";
			status = "okay";
		};
	};

	fragment@83 {
		target = <0xffffffff>;

		__overlay__ {
			regulator-default-on = <0x1>;
			regulator-name = "vcamio";
			status = "okay";
		};
	};

	fragment@84 {
		target = <0xffffffff>;

		__overlay__ {
			regulator-always-on;
			regulator-boot-on;
			regulator-max-microvolt = <0x2dc6c0>;
			regulator-min-microvolt = <0x2dc6c0>;
			regulator-name = "vldo28";
			status = "okay";
		};
	};

	fragment@85 {
		target = <0xffffffff>;

		__overlay__ {
			regulator-default-on = <0x1>;
			regulator-name = "vio28";
			status = "okay";
		};
	};

	fragment@86 {
		target = <0xffffffff>;

		__overlay__ {
			cam0_enable_sensor = "hi1336qtechpd2140main_mipi_raw hi1336sunnypd2140main_mipi_raw gc08a3qtepd2140main_mipi_raw gc08a3sunpd2140main_mipi_raw imx258qtepd2140main_mipi_raw";
			cam0_vcamd-supply = <0xffffffff>;
			cam0_vcamio-supply = <0xffffffff>;
			cam1_enable_sensor = "hi556lcepd2140front_mipi_raw gc5035txdpd2140front_mipi_raw gc5035hltpd2140front_mipi_raw gc08a3qtepd2140front_mipi_raw gc08a3sunpd2140front_mipi_raw imx355sunpd2140front_mipi_raw";
			cam1_vcamd-supply = <0xffffffff>;
			cam1_vcamio-supply = <0xffffffff>;
			cam2_enable_sensor = "gc02m1pd2140_mipi_raw ov02b10lcepd2140macro_mipi_raw gc02m1hltpd2140macro_mipi_raw";
			cam2_vcamio-supply = <0xffffffff>;
			pmic = <0xffffffff>;
			status = "okay";
		};
	};

	fragment@87 {
		target = <0xffffffff>;

		__overlay__ {
			camaf_m1_pmic-supply = <0xffffffff>;
		};
	};

	fragment@88 {
		target = <0xffffffff>;

		__overlay__ {
			deb-gpios = <0xffffffff 0x6b 0x0>;
			debounce = <0x3e800>;
			interrupt-parent = <0xffffffff>;
			interrupts = <0x6b 0x1 0x6b 0x0>;
			status = "okay";
		};
	};

	fragment@89 {
		target = <0xffffffff>;

		__overlay__ {
			mediatek,kpd-hw-dl-key0 = <0x11>;
			mediatek,kpd-hw-dl-key1 = <0x0>;
			mediatek,kpd-hw-dl-key2 = <0x8>;
			mediatek,kpd-hw-factory-key = <0x0>;
			mediatek,kpd-hw-init-map = <0x73 0x0 0x0 0x0 0x0 0x0 0x0 0x0 0x0 0x0 0x0 0x0 0x0 0x0 0x0 0x0 0x0 0x0 0x0 0x0 0x0 0x0 0x0 0x0 0x0 0x0 0x0 0x0 0x0 0x0 0x0 0x0 0x0 0x0 0x0 0x0 0x0 0x0 0x0 0x0 0x0 0x0 0x0 0x0 0x0 0x0 0x0 0x0 0x0 0x0 0x0 0x0 0x0 0x0 0x0 0x0 0x0 0x0 0x0 0x0 0x0 0x0 0x0 0x0 0x0 0x0 0x0 0x0 0x0 0x0 0x0 0x0>;
			mediatek,kpd-hw-map-num = <0x48>;
			mediatek,kpd-hw-pwrkey = <0x8>;
			mediatek,kpd-hw-recovery-key = <0x11>;
			mediatek,kpd-hw-rstkey = <0x11>;
			mediatek,kpd-key-debounce = <0x400>;
			mediatek,kpd-pwkey-gpio-din = <0x0>;
			mediatek,kpd-pwrkey-eint-gpio = <0x0>;
			mediatek,kpd-sw-pwrkey = <0x74>;
			mediatek,kpd-sw-rstkey = <0x72>;
			mediatek,kpd-use-extend-type = <0x0>;
			status = "okay";
		};
	};

	fragment@9 {
		target = <0xffffffff>;

		__overlay__ {

			spi_driving_set {
				phandle = <0x71>;

				pin_cmd_dat {
					drive-strength = <0x2>;
					pinmux = <0x1100 0x1200 0x1300 0x1400>;
				};
			};
		};
	};

	fragment@90 {
		target = <0xffffffff>;

		__overlay__ {
			compatible-gpios = <0xffffffff 0xaf 0x0>;
		};
	};

	fragment@91 {
		target = <0xffffffff>;

		__overlay__ {
			vivo,vendor_project_cpu = "MT6765";
			vivo,vendor_project_cpunum = <0x8>;
			vivo,vendor_project_freq = "2.3";
			vivo,vendor_project_name = "PD2140IF_EX";
		};
	};

	fragment@92 {
		target = <0xffffffff>;

		__overlay__ {
			gpio_nums = <0xc>;
			gpios = <0xac 0x35 0x34 0x2a 0x4f 0x50 0xb0 0xb1 0xab 0x5a 0x2 0xa3>;
			pinctrl-0 = <0x66>;
			pinctrl-names = "default";
		};
	};

	fragment@93 {
		target = <0xffffffff>;

		__overlay__ {
			card-detect-sim1,gpios = <0xffffffff 0x2f 0x0>;
			card-detect-sim2,gpios = <0xffffffff 0x2f 0x0>;
			pinctrl-0 = <0x67>;
			pinctrl-names = "default";
			vivo,sim1-detect-high;
			vivo,sim1-need-detect;
			vivo,sim2-detect-high;
			vivo,sim2-need-detect;
		};
	};

	fragment@94 {
		target = <0xffffffff>;

		__overlay__ {

			card_sim_detect {
				phandle = <0x67>;

				pins_cmd0_dat {
					bias-disable;
					pinmux = <0x2f01>;
					slew-rate = <0x0>;
				};

				pins_cmd1_dat {
					bias-disable;
					pinmux = <0x2e00>;
					slew-rate = <0x0>;
				};

				pins_cmd2_dat {
					bias-disable;
					pinmux = <0x100>;
					slew-rate = <0x0>;
				};
			};

			hardware_board_version {
				phandle = <0x66>;

				pins_cmd0_dat {
					bias-pull-up = <0x1>;
					pinmux = <0xb200>;
					slew-rate = <0x0>;
				};

				pins_cmd1_dat {
					bias-pull-up = <0x1>;
					pinmux = <0xb100>;
					slew-rate = <0x0>;
				};

				pins_cmd2_dat {
					bias-pull-up = <0x1>;
					pinmux = <0xb000>;
					slew-rate = <0x0>;
				};

				pins_cmd3_dat {
					bias-pull-up = <0x1>;
					pinmux = <0xaf00>;
					slew-rate = <0x0>;
				};

				pins_cmd4_dat {
					bias-pull-up = <0x1>;
					pinmux = <0xae00>;
					slew-rate = <0x0>;
				};

				pins_cmd5_dat {
					bias-pull-up = <0x1>;
					pinmux = <0xad00>;
					slew-rate = <0x0>;
				};

				pins_cmd6_dat {
					bias-pull-up = <0x1>;
					pinmux = <0xab00>;
					slew-rate = <0x0>;
				};

				pins_cmd7_dat {
					bias-pull-up = <0x1>;
					pinmux = <0x700>;
					slew-rate = <0x0>;
				};

				pins_cmd8_dat {
					bias-pull-up = <0x1>;
					pinmux = <0xa400>;
					slew-rate = <0x0>;
				};
			};
		};
	};

	fragment@95 {
		target = <0xffffffff>;

		__overlay__ {

			msdc0@default {
				phandle = <0x43>;

				pins_clk {
					drive-strength = [05];
				};

				pins_cmd {
					drive-strength = [02];
				};

				pins_dat {
					drive-strength = [02];
				};

				pins_ds {
					drive-strength = [03];
				};

				pins_rst {
					drive-strength = [03];
				};
			};

			msdc0@hs200 {
				phandle = <0x45>;

				pins_clk {
					drive-strength = [05];
				};

				pins_cmd {
					drive-strength = [02];
				};

				pins_dat {
					drive-strength = [02];
				};

				pins_ds {
					drive-strength = [04];
				};

				pins_rst {
					drive-strength = [03];
				};
			};

			msdc0@hs400 {
				phandle = <0x44>;

				pins_clk {
					drive-strength = [05];
				};

				pins_cmd {
					drive-strength = [02];
				};

				pins_dat {
					drive-strength = [02];
				};

				pins_ds {
					drive-strength = [04];
				};

				pins_rst {
					drive-strength = [03];
				};
			};

			msdc0@register_default {
				cmd_edge = [00];
				phandle = <0x46>;
				rdata_edge = [00];
				wdata_edge = [00];
			};
		};
	};

	fragment@96 {
		target = <0xffffffff>;

		__overlay__ {
			mt6357-miso-driving = <0x8>;
		};
	};

	fragment@97 {
		target = <0xffffffff>;

		__overlay__ {

			vivo-audio-ktv@0 {
				compatible = "vivo,vivo-audio-ktv";
				status = "okay";
			};

			vivo-soc-codec@0 {
				compatible = "vivo,vivo-soc-codec";
				status = "okay";
			};
		};
	};

	fragment@98 {
		target = <0xffffffff>;

		__overlay__ {

			aw87xxx_i2c@58 {
				compatible = "awinic,aw87xxx_pa";
				reg = <0x58>;
				reset-gpio = <0xffffffff 0x9a 0x0>;
				status = "okay";
			};
		};
	};

	fragment@99 {
		target = <0xffffffff>;

		__overlay__ {
			compatible = "vivo,touchscreen-config";
			status = "okay";
			vivo,ts-anti-esd = <0x1>;
			vivo,ts-charger-conn-judge = <0x1>;
			vivo,ts-custom-gesture = <0x0>;
			vivo,ts-dclick-wake = <0x1>;
			vivo,ts-fw-upgrade-lcd-referrence = <0x0>;
			vivo,ts-gesture-mode = <0x1>;
			vivo,ts-gloves-mode = <0x0>;
			vivo,ts-large-obj-suppression = <0x1>;
			vivo,ts-module-id-methods = <0x2>;
			vivo,ts-module-smt-mode = <0x1>;
			vivo,ts-product-name = "PD2014";
			vivo,ts_vdd_mode = "gpio_mode";
			vivo,use-ic-list = "nt36525";

			tp_modue3 {
				compatible = "vivo,touch-panel-module";
				vts-dimention-x = <0x2d0>;
				vts-dimention-y = <0x640>;
				vts-gesture = <0x1>;
				vts-ic-number = <0x54>;
				vts-incell = <0x1>;
				vts-lcmid = <0x91>;
				vts-long-press = <0x0>;
				vts-module-vendor = <0xf0>;
				vts-need-caliberation = <0x0>;
				vts-no-flash = <0x1>;
				vts-rx-sensors = <0x20>;
				vts-tx-sensors = <0x12>;
				vts-type = <0x0>;
				vts-virtual-proximinity = <0x0>;
			};

			tp_moduel {
				compatible = "vivo,touch-panel-module";
				vts-dimention-x = <0x2d0>;
				vts-dimention-y = <0x640>;
				vts-gesture = <0x1>;
				vts-ic-number = <0x52>;
				vts-incell = <0x1>;
				vts-input-method = <0x1>;
				vts-lcmid = <0x31>;
				vts-long-press = <0x0>;
				vts-module-vendor = <0xf0>;
				vts-need-caliberation = <0x0>;
				vts-no-flash = <0x1>;
				vts-rx-sensors = <0x20>;
				vts-tx-sensors = <0x12>;
				vts-type = <0x0>;
				vts-virtual-proximinity = <0x0>;
			};

			tp_module2 {
				compatible = "vivo,touch-panel-module";
				vts-dimention-x = <0x2d0>;
				vts-dimention-y = <0x640>;
				vts-ic-number = <0x5a>;
				vts-incell = <0x1>;
				vts-lcmid = <0x13>;
				vts-long-press = <0x0>;
				vts-module-vendor = <0xf0>;
				vts-need-caliberation = <0x0>;
				vts-no-flash = <0x1>;
				vts-rx-sensors = <0x20>;
				vts-tx-sensors = <0x12>;
				vts-type = <0x0>;
				vts-virtual-proximinity = <0x0>;
			};

			tp_module4 {
				compatible = "vivo,touch-panel-module";
				vts-dimention-x = <0x2d0>;
				vts-dimention-y = <0x640>;
				vts-game-idle-time = <0xa>;
				vts-game-mode = <0x1>;
				vts-gesture = <0x1>;
				vts-ic-number = <0x6e>;
				vts-incell = <0x1>;
				vts-lcmid = <0x66>;
				vts-long-press = <0x0>;
				vts-module-vendor = <0xf0>;
				vts-need-caliberation = <0x0>;
				vts-no-flash = <0x1>;
				vts-no-flash-unique-code = <0x1>;
				vts-rx-sensors = <0x20>;
				vts-tx-sensors = <0x12>;
				vts-type = <0x0>;
				vts-virtual-proximinity = <0x0>;
			};

			tp_module5 {
				compatible = "vivo,touch-panel-module";
				vts-dimention-x = <0x2d0>;
				vts-dimention-y = <0x640>;
				vts-gesture = <0x1>;
				vts-ic-number = <0x27>;
				vts-incell = <0x1>;
				vts-lcmid = <0x81>;
				vts-long-press = <0x0>;
				vts-module-vendor = <0xf0>;
				vts-need-caliberation = <0x0>;
				vts-no-flash = <0x1>;
				vts-no-flash-unique-code = <0x1>;
				vts-rx-sensors = <0x20>;
				vts-tx-sensors = <0x12>;
				vts-type = <0x0>;
				vts-virtual-proximinity = <0x0>;
			};

			tp_module6 {
				compatible = "vivo,touch-panel-module";
				vts-dimention-x = <0x2d0>;
				vts-dimention-y = <0x640>;
				vts-gesture = <0x1>;
				vts-ic-number = <0x25>;
				vts-incell = <0x1>;
				vts-lcmid = <0x27>;
				vts-long-press = <0x0>;
				vts-module-vendor = <0xf0>;
				vts-need-caliberation = <0x0>;
				vts-no-flash = <0x1>;
				vts-no-flash-unique-code = <0x1>;
				vts-rx-sensors = <0x20>;
				vts-tx-sensors = <0x12>;
				vts-type = <0x0>;
				vts-virtual-proximinity = <0x0>;
			};
		};
	};
};
